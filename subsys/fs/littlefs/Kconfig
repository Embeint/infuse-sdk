## subsys/task_runner/tasks/Kconfig
```kconfig
# Task Runner tasks

config TASK_RUNNER_TASK_TDF_LOGGER
	bool "TDF logger task"

if TASK_RUNNER_TASK_TDF_LOGGER

config TASK_RUNNER_TASK_TDF_LOGGER_LTE_MODEM_MONITOR
	bool
	default y if INFUSE_MODEM_MONITOR

module = TASK_TDF_LOGGER
module-str = TDF logger task
source "subsys/logging/Kconfig.template.log_config"

config TASK_TDF_LOGGER_LOCATION_TIMEOUT_SEC
	int "Location sample age must be shorter than this to log"
	default 3600

config TASK_TDF_LOGGER_IMU_TIMEOUT_SEC
	int "IMU sample age must be shorter than this to log"
	default 3600

config TASK_TDF_LOGGER_ENVIRONMENTAL_TIMEOUT_SEC
	int "Environmental sample age must be shorter than this to log"
	default 3600

choice TASK_TDF_LOGGER_BATTERY_TYPE
	prompt "TDF type for battery logging"
	default TASK_TDF_LOGGER_BATTERY_TYPE_COMPLETE

config TASK_TDF_LOGGER_BATTERY_TYPE_COMPLETE
	bool "Log TDF_BATTERY_STATE (Voltage, Current, SoC)"

config TASK_TDF_LOGGER_BATTERY_TYPE_VOLTAGE
	bool "Log TDF_BATTERY_VOLTAGE (Voltage only)"

config TASK_TDF_LOGGER_BATTERY_TYPE_SOC
	bool "Log TDF_BATTERY_SOC (SoC only)"

endchoice

endif # TASK_RUNNER_TASK_TDF_LOGGER

config TASK_RUNNER_TASK_IMU
	bool "IMU task"
	select INFUSE_ZBUS_CHAN_IMU

if TASK_RUNNER_TASK_IMU

config TASK_RUNNER_TASK_IMU_STACK_SIZE
	int "Stack size of the task thread"
	default 4096 if COVERAGE
	default 2048

config TASK_RUNNER_TASK_IMU_MAX_FIFO
	int "Maximum number of samples that can be read"
	default INFUSE_IMU_MAX_FIFO_SAMPLES

choice TASK_RUNNER_TASK_IMU_LOG_TYPE
	prompt "TDF format to log IMU data as"

config TASK_RUNNER_TASK_IMU_LOG_TIME_ARRAY
	bool "Log IMU TDFs as TIME_ARRAY"

config TASK_RUNNER_TASK_IMU_LOG_IDX_ARRAY
	bool "Log IMU TDFs as IDX_ARRAY"

config TASK_RUNNER_TASK_IMU_LOG_DIFF_ARRAY
	bool "Log IMU TDFs as DIFF_ARRAY"
	depends on TDF_DIFF

endchoice

config TASK_RUNNER_TASK_IMU_ACC_MAGNITUDE_BROADCAST
	bool "Broadcast accelerometer magnitudes on a zbus channel"
	select INFUSE_ZBUS_CHAN_IMU_ACC_MAG

config TASK_RUNNER_TASK_IMU_ACC_MAGNITUDE_BROADCAST_MAX
	int "Maximum number of magnitudes that can be broadcast"
	depends on TASK_RUNNER_TASK_IMU_ACC_MAGNITUDE_BROADCAST
	default TASK_RUNNER_TASK_IMU_MAX_FIFO

module = TASK_IMU
module-str = IMU task
source "subsys/logging/Kconfig.template.log_config"

endif # TASK_RUNNER_TASK_IMU

config TASK_RUNNER_TASK_BATTERY
	bool "Battery sampling task"
	select INFUSE_ZBUS_CHAN_BATTERY
	depends on ZBUS

if TASK_RUNNER_TASK_BATTERY

module = TASK_BATTERY
module-str = Battery task
source "subsys/logging/Kconfig.template.log_config"

config TASK_RUNNER_TASK_BATTERY_VERBOSE_PRINT_PERIOD
	int "How often to output measured values at LOG_INF instead of LOG_DBG (seconds)"
	default 10
	help
	  Change the frequency of the battery state output printed to the console

config TASK_RUNNER_TASK_BATTERY_FALLBACK_SOC
	int "Default SoC to use internally if reading the SoC fails"
	default 50
	help
	  If the battery measurement hardware fails, reporting a SoC of 0% will likely
	  lead to a shutdown of most device functionality. This option controls the
	  value that is reported instead, allowing the device to continue operation in
	  the absence of external knowledge.

endif # TASK_RUNNER_TASK_BATTERY

config TASK_RUNNER_TASK_BT_SCANNER
	bool "Bluetooth scanner task"
	depends on EPACKET_INTERFACE_BT_ADV

if TASK_RUNNER_TASK_BT_SCANNER

module = TASK_BT_SCANNER
module-str = BT scanner task
source "subsys/logging/Kconfig.template.log_config"

config TASK_RUNNER_TASK_BT_SCANNER_MAX_DEVICES
	int "Maximum number of devices tracked by the task"
	default 16
	help
	  TASK_BT_SCANNER_FLAGS_FILTER_DUPLICATES and TASK_BT_SCANNER_FLAGS_DEFER_LOGGING
	  require tracking of observed devices by the task. This option limits the size
	  of the tracking when those flags are enabled.

endif # TASK_RUNNER_TASK_BT_SCANNER

config TASK_RUNNER_TASK_ENVIRONMENTAL
	bool "Environmental sensing task"
	select INFUSE_ZBUS_CHAN_AMBIENT_ENV
	depends on ZBUS

if TASK_RUNNER_TASK_ENVIRONMENTAL

module = TASK_ENVIRONMENTAL
module-str = Environmental task
source "subsys/logging/Kconfig.template.log_config"

endif # TASK_RUNNER_TASK_ENVIRONMENTAL

config TASK_RUNNER_TASK_GNSS
	bool "GNSS location task"
	depends on ZBUS

if TASK_RUNNER_TASK_GNSS

config TASK_RUNNER_TASK_GNSS_THREAD
	bool

config TASK_RUNNER_TASK_GNSS_WORKQUEUE
	bool

choice TASK_RUNNER_TASK_GNSS_BACKEND
	prompt "Hardware backend for GNSS task"

config TASK_RUNNER_TASK_GNSS_UBX
	bool "u-blox GNSS task"
	select TASK_RUNNER_TASK_GNSS_THREAD
	select INFUSE_ZBUS_CHAN_LOCATION
	select INFUSE_ZBUS_CHAN_UBX_NAV_PVT
	depends on GNSS_UBX_MODEM
	depends on GNSS

config TASK_RUNNER_TASK_GNSS_NRF9X
	bool "nRF9x GNSS task"
	select TASK_RUNNER_TASK_GNSS_WORKQUEUE
	select INFUSE_ZBUS_CHAN_LOCATION
	select INFUSE_ZBUS_CHAN_NRF9X_NAV_PVT
	depends on (GNSS_NRF9X && LTE_LINK_CONTROL) || GNSS_NRF9X_EMUL

endchoice

config TASK_RUNNER_TASK_GNSS_STACK_SIZE
	int "Stack size of the task thread"
	depends on TASK_RUNNER_TASK_GNSS_THREAD
	default 4096 if COVERAGE
	default 2048

config TASK_RUNNER_GNSS_SATELLITE_INFO
	bool "Display satellite information while running fixes"
	imply GNSS_U_BLOX_LARGE_MESSAGES

config TASK_RUNNER_GNSS_MINIMUM_ACCURACY_M
	int "Accuracies worse than this threshold are reported as (-181,-91)"
	default 100000

config TASK_RUNNER_GNSS_TIME_RESYNC_PERIOD_SEC
	int "Resynchronise time from GNSS every N seconds"
	default 3600
	help
	  When running continuously, the GNSS runner will resynchronise the local
	  clock from the GNSS modem every N seconds. Limiting how often this occurs
	  can minimise the number of time discontinuities when logging higher
	  frequency data (e.g. IMU samples). The default value is 1 hour.

config TASK_RUNNER_GNSS_TIME_COARSE_SYNC_PERIOD_SEC
	int "Perform an initial coarse time sync at this period"
	default 7200
	help
	  If the time knowledge of the device is older than this period, perform
	  an initial time sync as soon as time knowledge is obtained from the GNSS.
	  This ensures that even if a fine time sync is not obtained, the device RTC
	  still stays roughly in sync. The default value is 2 hours.

module = TASK_GNSS
module-str = GNSS task
source "subsys/logging/Kconfig.template.log_config"

endif # TASK_RUNNER_TASK_GNSS

config TASK_RUNNER_TASK_NETWORK_SCAN
	bool "LTE Cell scanning task"
	depends on LTE_LINK_CONTROL || WIFI
	select LTE_LC_NEIGHBOR_CELL_MEAS_MODULE if LTE_LINK_CONTROL

if TASK_RUNNER_TASK_NETWORK_SCAN

module = TASK_NETWORK_SCAN
module-str = NETWORK_SCAN task
source "subsys/logging/Kconfig.template.log_config"

config TASK_RUNNER_TASK_NETWORK_SCAN_LTE_MAX_NEIGHBOURS
	int "Maximum number of neighbour cells that can be recorded"
	depends on LTE_LINK_CONTROL
	range 1 16
	default 8

config TASK_RUNNER_TASK_NETWORK_SCAN_LTE_MAX_GCI
	int "Maximum number of global cells that can be recorded"
	depends on LTE_LINK_CONTROL
	range 1 15
	default 8

config TASK_RUNNER_TASK_NETWORK_SCAN_WIFI_MAX_APS
	int "Maximum number of Wi-Fi APs that can be recorded"
	depends on WIFI
	range 1 32
	default 8

configdefault WIFI_MGMT_SCAN_CHAN_MAX_MANUAL
	default 8

endif # TASK_RUNNER_TASK_NETWORK_SCAN
```

## subsys/tdf/Kconfig
```kconfig
# TDF configuration

config TDF
	bool "TDF subsystem"
	depends on NET_BUF

if TDF

config TDF_DIFF
	bool "TDF diff encoding support"

config TDF_UTIL_REBOOT_INFO_LOG
	bool
	default y if INFUSE_COMMON_BOOT

endif
```

## subsys/validation/Kconfig
```kconfig
# Infuse-IoT validation subsystem

config INFUSE_VALIDATION
	bool "Infuse-IoT hardware and driver validation libraries"

if INFUSE_VALIDATION

config INFUSE_VALIDATION_BUTTON
	bool "Infuse-IoT Button/GPIO validation"
	default y
	depends on DT_HAS_GPIO_KEYS_ENABLED

if INFUSE_VALIDATION_BUTTON

config INFUSE_VALIDATION_BUTTON_REQUIRE_MANUAL
	bool "Require manual hardware validation for the button"
	default n

config INFUSE_VALIDATION_BUTTON_ACTION_TIMEOUT
	int "Infuse-IoT Button timeout for action to occur (in seconds)"
	default 10

endif # INFUSE_VALIDATION_BUTTON

config INFUSE_VALIDATION_LEDS_GPIO
	bool "Infuse-IoT LEDs/GPIO validation"
	default y
	depends on DT_HAS_GPIO_LEDS_ENABLED

config INFUSE_VALIDATION_LEDS_CONTROLLER
	bool "Infuse-IoT LED validation through LED API"

if INFUSE_VALIDATION_LEDS_GPIO || INFUSE_VALIDATION_LEDS_CONTROLLER

config INFUSE_VALIDATION_LEDS_ACTION_DURATION
	int "Infuse-IoT LEDs/gpio on duration (in milliseconds)"
	default 500

endif # INFUSE_VALIDATION_LEDS_GPIO || INFUSE_VALIDATION_LEDS_CONTROLLER

if DISK_ACCESS

config INFUSE_VALIDATION_DISK_THROUGHPUT_BUFFER_SIZE
	int "Size in bytes of the throughput buffer"
	default 32768
	help
	  Increasing the size of this buffer should increase throughput
	  due to reducing transaction setup overhead.

endif # DISK_ACCESS

if NRF_MODEM_LIB

config INFUSE_VALIDATE_NRF_MODEM_GCI_SEARCH_TIMEOUT
	int "Maximum duration to scan for GCI cells (seconds)"
	default 10

config INFUSE_VALIDATE_NRF_MODEM_GCI_MIN_CELL
	int "Number of GCI cells expected to be scanned"
	default 0

endif # NRF_MODEM_LIB

if WIFI

config INFUSE_VALIDATE_WIFI_SSID
	string "Network SSID to connect to"
	default "example"

config INFUSE_VALIDATE_WIFI_PSK
	string "Network pre-shared-key to connect with"
	default "password"

config INFUSE_VALIDATION_SNTP_SERVER
	string "SNTP server address"
	default "pool.ntp.org"

endif # WIFI

config HEAP_MEM_POOL_ADD_SIZE_LTE_CELL_SCAN
	int "Extra stack size for LTE network scanning"
	depends on LTE_LINK_CONTROL
	default 1024

endif # INFUSE_VALIDATION
```

## subsys/zbus/Kconfig
```kconfig
# Infuse-IoT zbus channel configuration

config INFUSE_ZBUS_CHAN_BATTERY
	bool
	help
	  INFUSE_ZBUS_CHAN_BATTERY producer is compiled in

config INFUSE_ZBUS_CHAN_AMBIENT_ENV
	bool
	help
	  INFUSE_ZBUS_CHAN_AMBIENT_ENV producer is compiled in

config INFUSE_ZBUS_CHAN_IMU
	bool
	help
	  INFUSE_ZBUS_CHAN_IMU producer is compiled in

config INFUSE_ZBUS_CHAN_IMU_ACC_MAG
	bool
	help
	  INFUSE_ZBUS_CHAN_IMU_ACC_MAG producer is compiled in

config INFUSE_ZBUS_CHAN_LOCATION
	bool
	help
	  INFUSE_ZBUS_CHAN_LOCATION producer is compiled in

config INFUSE_ZBUS_CHAN_MOVEMENT_STD_DEV
	bool
	help
	  INFUSE_ZBUS_CHAN_MOVEMENT_STD_DEV producer is compiled in

config INFUSE_ZBUS_CHAN_TILT
	bool
	help
	  INFUSE_ZBUS_CHAN_TILT producer is compiled in

config INFUSE_ZBUS_CHAN_UBX_NAV_PVT
	bool
	help
	  INFUSE_ZBUS_CHAN_UBX_NAV_PVT producer is compiled in

config INFUSE_ZBUS_CHAN_NRF9X_NAV_PVT
	bool
	help
	  INFUSE_ZBUS_CHAN_NRF9X_NAV_PVT producer is compiled in

config INFUSE_ZBUS_CHAN_SOC_TEMPERATURE
	bool
	help
	  INFUSE_ZBUS_CHAN_SOC_TEMPERATURE producer is compiled in
```

## tests/bsim/bluetooth/epacket/Kconfig
```kconfig
# Test options

config INFUSE_LEGACY_ADV
	bool "Start legacy advertiser"

config CONN_TERMINATOR
	bool "Terminate connections after creation"

config INFUSE_REBOOT
	default y

config INFUSE_REBOOT_COMPILE
	default n

config INFUSE_REBOOT_RETURN
	default y

source "Kconfig.zephyr"
```

## tests/bsim/bluetooth/epacket/device/testcase.yaml
```yaml
common:
  build_only: true
  required_snippets:
    - infuse
  tags:
    - bluetooth
  platform_allow:
    - nrf52_bsim/native
    - nrf5340bsim/nrf5340/cpunet
  harness: bsim
tests:
  bluetooth.epacket.device:
    harness_config:
      bsim_exe_name: tests_bsim_bluetooth_epacket_device_prj_conf
  bluetooth.epacket.device.alt_network:
    harness_config:
      bsim_exe_name: tests_bsim_bluetooth_epacket_device_prj_alt_network_conf
    extra_args:
      - EXTRA_CONF_FILE=prj_alt_network.conf
  bluetooth.epacket.device.public:
    harness_config:
      bsim_exe_name: tests_bsim_bluetooth_epacket_device_prj_public_conf
    extra_args:
      - EXTRA_CONF_FILE=prj_public.conf
```

## tests/bsim/bluetooth/epacket/gateway/Kconfig
```kconfig
# Test options

config INFUSE_REBOOT
	default y

config INFUSE_REBOOT_COMPILE
	default n

config INFUSE_REBOOT_RETURN
	default y

configdefault INFUSE_LITTLEFS_CACHE_SIZE
	default 1024

source "Kconfig.zephyr"
```

## tests/bsim/bluetooth/epacket/gateway/testcase.yaml
```yaml
common:
  build_only: true
  required_snippets:
    - infuse
  tags:
    - bluetooth
  platform_allow:
    - nrf52_bsim/native
    - nrf5340bsim/nrf5340/cpunet
  harness: bsim
tests:
  bluetooth.epacket.gateway:
    harness_config:
      bsim_exe_name: tests_bsim_bluetooth_epacket_gateway_prj_conf
  bluetooth.epacket.gateway.grouping:
    harness_config:
      bsim_exe_name: tests_bsim_bluetooth_epacket_gateway_prj_grouping_conf
    extra_args:
      - EXTRA_CONF_FILE=prj_grouping.conf
  bluetooth.epacket.gateway.knows_alt:
    harness_config:
      bsim_exe_name: tests_bsim_bluetooth_epacket_gateway_prj_knows_alt_conf
    extra_args:
      - EXTRA_CONF_FILE=prj_knows_alt.conf
  bluetooth.epacket.gateway.sdc:
    harness_config:
      bsim_exe_name: tests_bsim_bluetooth_epacket_gateway_sdc_prj_conf
    extra_args:
      - DTC_OVERLAY_FILE="./app.overlay;./nrf_sdc.overlay"
      - EXTRA_CONF_FILE=prj_sdc.conf
```

## tests/bsim/bluetooth/epacket/legacy_adv/testcase.yaml
```yaml
common:
  build_only: true
  required_snippets:
    - infuse
  tags:
    - bluetooth
  platform_allow:
    - nrf52_bsim/native
    - nrf5340bsim/nrf5340/cpunet
  harness: bsim
tests:
  bluetooth.epacket.legacy_adv:
    harness_config:
      bsim_exe_name: tests_bsim_bluetooth_epacket_legacy_adv_prj_conf
    extra_args:
      - EXTRA_CONF_FILE=prj_hardcoded.conf
  bluetooth.epacket.legacy_adv.named:
    harness_config:
      bsim_exe_name: tests_bsim_bluetooth_epacket_legacy_adv_prj_named_conf
    extra_args:
      - EXTRA_CONF_FILE=prj_named.conf
```

## tests/bsim/bluetooth/epacket/terminator/testcase.yaml
```yaml
common:
  build_only: true
  required_snippets:
    - infuse
  tags:
    - bluetooth
  platform_allow:
    - nrf52_bsim/native
    - nrf54l15bsim/nrf54l15/cpuapp
    - nrf5340bsim/nrf5340/cpunet
  harness: bsim
tests:
  bluetooth.epacket.terminator:
    harness_config:
      bsim_exe_name: tests_bsim_bluetooth_epacket_terminator_prj_conf
  bluetooth.epacket.terminator.sdc:
    harness_config:
      bsim_exe_name: tests_bsim_bluetooth_epacket_terminator_sdc_prj_conf
    extra_args:
      - DTC_OVERLAY_FILE="./app.overlay;./nrf_sdc.overlay"
```
