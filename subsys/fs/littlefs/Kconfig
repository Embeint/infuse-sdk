## subsys/fs/littlefs/Kconfig
```kconfig
# Infuse-IoT SDK LittleFS integration

# Workaround for not being able to have commas in macro arguments
DT_CHOSEN_INFUSE_LITTLEFS_PARTITION := infuse,littlefs-partition

config INFUSE_LITTLEFS
	bool "Infuse-IoT LittleFS integration"
	depends on $(dt_chosen_enabled,$(DT_CHOSEN_INFUSE_LITTLEFS_PARTITION))
	select FILE_SYSTEM_LITTLEFS
	select FILE_SYSTEM_LIB_LINK
	default y

if INFUSE_LITTLEFS

config INFUSE_LITTLEFS_CACHE_SIZE
	int "Cache size for the LittleFS integration"
	default 256
	help
	  Each cache buffers a portion of a block in RAM. The littlefs
	  needs a read cache, a program cache, and one additional cache
	  per file. Larger caches can improve performance by storing
	  more data and reducing the number of disk accesses. Must be a
	  multiple of the read and program sizes of the underlying flash
	  device, and a factor of the block size.

config INFUSE_LITTLEFS_LOOKAHEAD_SIZE
	int "Lookahead buffer size for the LittleFS integration in bytes"
	default 64
	help
	  A larger lookahead buffer increases the number of blocks found
	  during an allocation pass. The lookahead buffer is stored as a
	  compact bitmap, so each byte of RAM can track 8 blocks.

module = INFUSE_LITTLEFS
module-str = Infuse-IoT LittleFS integration
source "subsys/logging/Kconfig.template.log_config"

endif # INFUSE_LITTLEFS
```

## subsys/fs/secure_storage/Kconfig
```kconfig
# Infuse-IoT SDK secure storage

choice MBEDTLS_PSA_ITS_BACKEND

config INFUSE_SECURE_STORAGE
	bool "Infuse-IoT KV store based secure storage"
	depends on !BUILD_WITH_TFM
	depends on KV_STORE
	select MBEDTLS
	select MBEDTLS_PSA_CRYPTO_C
	select HWINFO

endchoice

if INFUSE_SECURE_STORAGE

config INFUSE_SECURE_STORAGE_MAX_SIZE
	int "Maximum size of stored values"
	default 100

endif
```

## subsys/logging/backends/Kconfig
```kconfig
# Infuse-IoT logging backends

config LOG_BACKEND_EPACKET_BT
	bool "Use the ePacket Bluetooth peripheral as a logging backend"
	depends on EPACKET_INTERFACE_BT_PERIPHERAL
	depends on LOG
	default y

if LOG_BACKEND_EPACKET_BT

backend = EPACKET_BT
backend-str = epacket_bt
source "subsys/logging/Kconfig.template.log_format_config"

endif # LOG_BACKEND_EPACKET_BT
```

## subsys/memfault/Kconfig
```kconfig
# Infuse-IoT Memfault configuration

if MEMFAULT

config MEMFAULT_INFUSE_CONFIG
	bool "Use Infuse-IoT configuration files"
	default y

config MEMFAULT_METRICS_HEARTBEAT_INTERVAL_SECS
	int "Period of the Memfault metrics collection"
	depends on MEMFAULT_METRICS
	default 3600

endif # MEMFAULT
```

## subsys/mgmt/mcumgr/Kconfig
```kconfig
# Infuse-IoT mcumgr implementations

if MCUMGR

config MCUMGR_GRP_OS_INFUSE
	bool "Infuse-IoT mcumgr handlers for OS management"
	select MCUMGR_SMP_CBOR_MIN_DECODING_LEVEL_2
	depends on INFUSE_EPOCH_TIME

config MCUMGR_GRP_OS_INFUSE_RESET_MIN_UPTIME
	int "Minimum uptime for 'reset' command to be actioned"
	default 0
	depends on MCUMGR_GRP_OS_INFUSE
	depends on INFUSE_REBOOT
	help
	  Optional minimum uptime in seconds before the reset management
	  command will be actioned. Can be used to prevent malicious actors
	  from chain rebooting devices through the un-authenticated MCUMgr
	  protocol.

endif # MCUMGR

config MCUBOOT_UPGRADE_ONLY_AUTOMATIC
	bool "MCUBoot is compiled with MCUBOOT_UPGRADE_ONLY_AUTOMATIC"
	depends on MCUBOOT_BOOTLOADER_MODE_OVERWRITE_ONLY
	depends on MCUBOOT_BOOTLOADER_MODE_HAS_NO_DOWNGRADE
	help
	  When compiled with MCUBOOT_UPGRADE_ONLY_AUTOMATIC, writing swap
	  status to the new image is not required (and may not be possible).
	  Simply reboot to trigger the upgrade.
```

## subsys/modem/backends/Kconfig
```kconfig
# Infuse IoT custom modem backends

config MODEM_BACKEND_U_BLOX_I2C
	bool "u-blox I2C modem backend"
	select MODEM_PIPE
	select POLL
	select RING_BUFFER
	depends on I2C_RTIO

config MODEM_BACKEND_U_BLOX_SPI
	bool "u-blox SPI modem backend"
	select MODEM_PIPE
	select POLL
	select RING_BUFFER
	depends on SPI_ASYNC

if MODEM_BACKEND_U_BLOX_SPI

choice MODEM_BACKEND_U_BLOX_SPI_PM_MODE
	prompt "Mode of operation for SPI bus PM state"
	default MODEM_BACKEND_U_BLOX_SPI_PM_MODE_ALWAYS
	help
	  u-blox modems have internal pull-up resistors on IO pins. These resistors
	  also appear to be disabled in software backup mode, but the lines must
	  be held high to prevent transient current consumption. However, enabling
	  pull-up resistors on the SPI bus pins in sleep mode is undesirable when the
	  modem is powered down.

config MODEM_BACKEND_U_BLOX_SPI_PM_MODE_ALWAYS
	bool "SPI bus in active state while modem is powered"
	help
	  When this option is enabled, the SPI bus is kept in PM_STATE_ACTIVE while
	  the modem is powered. The bus is released when the modem goes to PM_STATE_OFF.
	  In this mode, pull-ups can be enabled in the "default" pinctl state, with
	  pull-downs enabled in the "sleep" pinctl state.

config MODEM_BACKEND_U_BLOX_SPI_PM_MODE_BURST
	bool "SPI bus in active state while comms are running"
	help
	  When this option is enabled, the SPI bus is only kept in PM_STATE_ACTIVE while
	  communications with the modem are running. This may be required if multiple
	  devices are on the same SPI bus.

endchoice # MODEM_BACKEND_U_BLOX_SPI_PM_MODE

endif # MODEM_BACKEND_U_BLOX_SPI
```

## subsys/net/Kconfig
```kconfig
# Infuse-IoT networking options

rsource "coap/Kconfig"
rsource "conn_mgr/Kconfig"
rsource "dns/Kconfig"
rsource "sntp/Kconfig"
```

## subsys/net/coap/Kconfig
```kconfig
# Infuse-IoT COAP helpers

config INFUSE_COAP
	bool "Infuse-IoT COAP helpers"
	depends on COAP

if INFUSE_COAP

config INFUSE_COAP_MAX_URI_SEGMENTS
	int "Maximum number of resource URI segments"
	default 4
	help
	  Maximum number of resource URI segments the library can
	  handle. For example "path/to/resource" has 3 segments.

config INFUSE_COAP_MAX_TIMEOUTS
	int "Maximum number of times to attempt reading a chunk"
	default 3
	help
	  When polling for a chunk times out, the library will retry the
	  download this many times before giving up.

choice INFUSE_COAP_BACKEND
	prompt "Infuse CoAP download implementation"
	default INFUSE_COAP_BACKEND_PARALLEL

config INFUSE_COAP_BACKEND_SERIAL
	bool "Reception of block request N is required before block N+1 requested"
	help
	  Basic backend that sends a single request and waits for the response before
	  taking further action.

config INFUSE_COAP_BACKEND_PARALLEL
	bool "Multiple block requests can be in-flight"
	help
	  More complicated implementation that requires a larger working memory array,
	  but can dramatically increase download throughputs.

endchoice

config INFUSE_COAP_BACKEND_PARALLEL_MAX_IN_FLIGHT
	int "Maximum number of requests that can be in-flight at once"
	depends on INFUSE_COAP_BACKEND_PARALLEL
	default 4
	help
	  This value is used for both the number of requests that can be in-flight and
	  the number of out-of-order payloads that can be buffered in RAM. Actual maximum
	  may be reduced based on provided working memory.

config INFUSE_COAP_TEST_PACKET_DROP_BITMASK
	int "Bitmask of received packets to drop while receiving to test retry logic"
	depends on ZTEST
	default 16389

module = INFUSE_COAP
module-str = infuse_coap
source "subsys/logging/Kconfig.template.log_config"

endif # INFUSE_COAP
```

## subsys/net/conn_mgr/Kconfig
```kconfig
# Infuse-IoT WiFi Connection Manager

config CONN_MGR_WIFI_KV_STORE
	bool "WiFi connection manager based on KV store"
	depends on KV_STORE
	depends on KV_STORE_KEY_WIFI_SSID
	depends on KV_STORE_KEY_WIFI_PSK

if CONN_MGR_WIFI_KV_STORE

config CONN_MGR_WIFI_KV_STORE_AUTO_CONNECT
	bool "WiFi connection should be created at boot"
	default y

config CONN_MGR_WIFI_KV_STORE_PERSISTENT
	bool "WiFi connection should be persistent"
	default y

config CONN_MGR_WIFI_KV_STORE_CONNECT_CALLER_CONTEXT
	bool "Run the initiating `NET_REQUEST_WIFI_CONNECT` call in the context of the caller"
	default y if WIFI_NM_WPA_SUPPLICANT
	help
	  Run the `NET_REQUEST_WIFI_CONNECT` call resulting from `conn_mgr_if_connect` in the
	  context of the caller of `conn_mgr_if_connect`, instead of deferring it to the system
	  workqueue. For some WiFi backends (WPA Supplicant) this call can block for excessive
	  durations due to crypto operations (>700ms on nRF54L15), which is suboptimal on the
	  system workqueue. Enabling this option requires that the original caller can afford to
	  block while the system workqueue can't.

config CONN_MGR_WIFI_KV_STORE_CACHE_LAST_FREQUENCY
	bool "Use the WiFi band and channel from the previous connection"
	help
	  When initiating a connection, explicitly specify the band and channel of
	  the previous connection that succeeded, if available. Cached information
	  is reset when the configuration changes or a connection fails. For WiFi
	  modems that limit scanning to the provided frequencies, this can dramatically
	  speed up subsequent connections at the cost of failing to connect on the first
	  time if the WiFi channel changes (Multi-AP scenario).

module = CONN_MGR_WIFI_KV_STORE
module-str = conn_mgr_wifi
source "subsys/logging/Kconfig.template.log_config"

endif
```

## subsys/net/dns/Kconfig
```kconfig
# DNS helpers

config INFUSE_DNS
	bool "Helper to synchronise DNS queries between modules"
	depends on NET_SOCKETS
	depends on DNS_RESOLVER || NET_SOCKETS_OFFLOAD
	default y
	help
	  The DNS library can only handle `DNS_NUM_CONCUR_QUERIES`
	  queries at once, returning errors otherwise. This library
	  mediates access to the shared resource, blocking until a
	  query slot is available before running.

config INFUSE_DNS_ASYNC
	bool "Asynchronous variant of INFUSE_DNS"
	depends on INFUSE_DNS
	depends on DNS_RESOLVER
	default y
```

## subsys/net/sntp/Kconfig
```kconfig
# Automatic SNTP time synchronisation

config SNTP_AUTO
	bool "Automatically synchronise device time through SNTP"
	select NET_SOCKETS_SERVICE
	depends on NET_CONNECTION_MANAGER
	depends on INFUSE_EPOCH_TIME
	depends on INFUSE_DNS
	depends on KV_STORE
	depends on SNTP
	default y

if SNTP_AUTO

config SNTP_AUTO_DEFAULT_SERVER
	string "Default SNTP server"
	default "time.cloudflare.com"

config SNTP_AUTO_QUERY_TIMEOUT_MS
	int "Maximum duration to wait for response from SNTP server"
	default 4000

config SNTP_AUTO_RESYNC_AGE
	int "Resynchronise time from SNTP once time sync is this far out of date"
	default 86400
	help
	   SNTP is typically going to be the least accurate time sync source. We
	   don't want to override other sync sources, and there is little value in
	   resynchronising at a high frequency. Therefore set the default period
	   to 24 hours.

config SNTP_AUTO_RETRY_PERIOD_MS
	int "How long to wait before retrying a failed SNTP query"
	default 2000

config SNTP_AUTO_RETRY_LIMIT
	int "Maximum number of times to attempt a SNTP query"
	default 3
	help
	  If the SNTP query fails this many times, it is halted until the next
	  triggering event.

choice SNTP_AUTO_MODE
	prompt "When to send SNTP queries"
	default SNTP_AUTO_IMMEDIATELY

config SNTP_AUTO_IMMEDIATELY
	bool "Run SNTP queries immediately upon timeout"
	help
	  Run the SNTP query as roon as the re-sync timer expires.

config SNTP_AUTO_SYNC_POINTS
	bool "Only run SNTP queries when triggered by the application"
	help
	  Instead of automatically running SNTP queries as soon as the re-sync
	  timer expires, wait for the application to signal that the query can
	  occur. This is useful for networking backends which may be in an idle
	  state and have a high overhead to reconnect.

endchoice

module = SNTP_AUTO
module-str = sntp_auto
source "subsys/logging/Kconfig.template.log_config"

endif # SNTP_AUTO
```

## subsys/rpc/Kconfig
```kconfig
# Infuse Remote Procedure Calls

config INFUSE_RPC
	bool "Infuse-IoT Remote Procedure Call support"
	depends on EPACKET

if INFUSE_RPC

module = INFUSE_RPC
module-str = Infuse rpc
source "subsys/logging/Kconfig.template.log_config"

config INFUSE_RPC_CLIENT
	bool "Support for running commands on remote devices"

if INFUSE_RPC_CLIENT

config INFUSE_RPC_CLIENT_MAX_IN_FLIGHT
	int "Maximum number of RPC commands that can be pending at once"
	range 1 255
	default 3

config INFUSE_RPC_CLIENT_ALLOW_DEFAULT_HANDLER
	bool
	help
	  Allow the default interface packet handler to run on RPC_DATA and
	  RPC_RSP packets that the client initiated. Intended for certain tests.

endif # INFUSE_RPC_CLIENT

config INFUSE_RPC_SERVER_WATCHDOG
	bool "Install watchdog on the RPC server thread"
	depends on INFUSE_WATCHDOG
	default y

config INFUSE_RPC_SERVER_STACK_SIZE
	int "Server thread stack size"
	default 8192 if COVERAGE
	default 4096 if NETWORKING
	default 2048

config INFUSE_RPC_SERVER_THREAD_PRIORITY
	int "Thread priority for the server thread"
	default 10

config INFUSE_RPC_COMMON_NET_QUERY
	bool
	default INFUSE_RPC_COMMAND_WIFI_STATE || INFUSE_RPC_COMMAND_LTE_STATE

config INFUSE_RPC_COMMON_FILE_ACTIONS
	bool
	default INFUSE_RPC_COMMAND_COAP_DOWNLOAD || INFUSE_RPC_COMMAND_FILE_WRITE_BASIC
	select STREAM_FLASH if FLASH_HAS_PAGE_LAYOUT

config INFUSE_RPC_COMMON_FILE_ACTIONS_WRITE_BUFFER
	int "Size of write buffer for ensuring aligned writes to flash devices"
	default 256

config INFUSE_RPC_SERVER_WORKING_MEMORY
	int "Size of working memory for commands"
	default 4160 if INFUSE_RPC_COMMAND_COAP_DOWNLOAD && INFUSE_COAP_BACKEND_PARALLEL
	default 1088 if INFUSE_RPC_COMMAND_COAP_DOWNLOAD
	default 512 if INFUSE_RPC_COMMAND_FILE_WRITE_BASIC
	default 512 if INFUSE_RPC_COMMAND_DATA_LOGGER_READ
	default 16

rsource "commands/Kconfig"

endif # INFUSE_RPC
```

## subsys/task_runner/Kconfig
```kconfig
# Infuse-IoT Task Runner

config TASK_RUNNER
	bool "Infuse-IoT Task Runner"
	select INFUSE_APPLICATION_STATES
	select INFUSE_MATH
	select INFUSE_WORKQ
	select POLL

if TASK_RUNNER

config TASK_RUNNER_DEFAULT_SCHEDULES_ID
	int "Increment in order to reset saved schedules to default values"
	default 0
	depends on KV_STORE

config TASK_RUNNER_CUSTOM_TASK_DEFINITIONS
	bool "Enable custom task definitions in `struct task_schedule`"

config TASK_RUNNER_CUSTOM_TASK_DEFINITIONS_PATH
	string "Path to custom task definition header"
	depends on TASK_RUNNER_CUSTOM_TASK_DEFINITIONS
	help
	  Path to a `.h` file that defines a type `union custom_task_arguments`
	  compatible with `union infuse_task_arguments`.

config TASK_RUNNER_INFUSE_WATCHDOG
	bool "Install watchdog on the Task Runner iteration function"
	depends on INFUSE_WATCHDOG
	default y

config TASK_RUNNER_AUTO_ITERATE
	bool "Enable the auto iteration functions"
	depends on INFUSE_EPOCH_TIME
	depends on ZBUS
	depends on ZBUS_CHANNEL_PUBLISH_STATS

config TASK_RUNNER_WORKQ_STACK_SIZE
	int "Stack size of the Task Runner workqueue"
	default 8192 if COVERAGE
	default 2048

config TASK_RUNNER_PER_SCHEDULE_STORAGE
	int "Persistent per-schedule storage available for tasks"
	default 4

rsource "tasks/Kconfig"

module = TASK_RUNNER
module-str = Task Runner
source "subsys/logging/Kconfig.template.log_config"

endif # TASK_RUNNER
```
