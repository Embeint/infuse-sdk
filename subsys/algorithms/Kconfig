## subsys/algorithms/Kconfig
```kconfig
# Infuse-IoT algorithm abstraction

config INFUSE_ALGORITHMS
	bool "Infuse-IoT algorithm abstraction"
	depends on ZBUS_CHANNEL_ID
	select INFUSE_WORKQ
	help
	  Subsystem to handle running arbitrary algorithms. Also optionally
	  includes building and packaging algorithms to be dynamically deployed
	  and loading at runtime.

if INFUSE_ALGORITHMS

config ALGORITHM_RUNNER
	bool "Infuse-IoT algorithm runner"
	default y


config ALGORITHM_LOADER
	bool "Infuse-IoT packaged algorithm loader"
	default y if LLEXT

endif # INFUSE_ALGORITHMS

rsource "loader/Kconfig"
rsource "packager/Kconfig"
rsource "runner/Kconfig"
rsource "samples/Kconfig"
```

## subsys/algorithms/loader/Kconfig
```kconfig
# Infuse-IoT packaged algorithm loader

config ALGORITHM_LOADER
	bool "Infuse-IoT packaged algorithm loader"
	depends on INFUSE_ALGORITHMS
	depends on LLEXT
	default y

if ALGORITHM_LOADER

config ALGORITHM_LOADER_LLEXT_LITTLEFS_LOADER
	bool
	depends on INFUSE_LITTLEFS
	depends on LLEXT
	default y
	help
	  Load LLEXT algorithms dynamically from the Infuse LittleFS
	  filesystem.

config ALGORITHM_LOADER_EXPOSE_SYMBOLS
	bool "Expose required symbols for packaged algorithms when loaded"
	select LLEXT_EXPORT_SYMBOL_GROUP_LIBC
	default y
	help
	  Expose required symbols used for packaged algorithms when they're loaded.

if ALGORITHM_LOADER_EXPOSE_SYMBOLS
config LLEXT_EXPORT_SYMBOL_GROUP_INFUSE_ALG
	bool "Infuse-IoT algorithm runner exports"
	default y
	help
	  Export symbols (under the INFUSE_ALG group) for packaged algorithms.

config LLEXT_EXPORT_SYMBOL_GROUP_FP_SOFT
	bool "Software floating point library exports"
	default y
	help
	  Export symbols (under the FP_SOFT group) for packaged algorithms.

endif # ALGORITHM_LOADER_EXPOSE_SYMBOLS

module = ALGORITHM_LOADER
module-str = Algorithm Loader
source "subsys/logging/Kconfig.template.log_config"

endif # ALGORITHM_LOADER
```

## subsys/algorithms/packager/Kconfig
```kconfig
# Infuse-IoT algorithm packager

config ALGORITHM_PACKAGER
	bool "Infuse-IoT algorithm packaging support & symbol export"
	depends on INFUSE_ALGORITHMS
	depends on LLEXT
	default y

if ALGORITHM_PACKAGER

# config INFUSE_ALGORITHM_LLEXT_BUILTIN
# 	bool
# 	help
# 	  Application includes an LLEXT algorithm.

# config INFUSE_ALGORITHM_LLEXT_NATIVE
# 	bool
# 	help
# 	  Application includes an LLEXT algorithm running
# 	  natively (not loaded through LLEXT).

config INFUSE_ALGORITHM_CPU_NAME
	string
	default "cortex_m0" if CPU_CORTEX_M0
	default "cortex_m3" if CPU_CORTEX_M3
	default "cortex_m4" if CPU_CORTEX_M4
	default "cortex_m33" if CPU_CORTEX_M33
	help
	  Hidden helper option to calculate the library path

config INFUSE_ALGORITHM_FLOAT_ABI_DIR
	string
	default "hard" if FPU && FP_HARDABI
	default "softfp" if FPU && FP_SOFTABI
	default "soft"
	help
	  Hidden helper option to calculate the library path

endif # ALGORITHM_PACKAGER
```

## subsys/cpatch/Kconfig
```kconfig
# Infuse-IoT constrained binary patching libraries

config INFUSE_CPATCH
	bool "Infuse-IoT constrained binary patching"
	depends on STREAM_FLASH
	depends on CRC

config INFUSE_CPATCH_ENCODER_SHORTEST_PATH
	bool "CPatch shortest-path encoder based patches"
	depends on INFUSE_CPATCH
	select INFUSE_CPATCH_VERSION_1
	select INFUSE_CPATCH_VERSION_2
	default y

config INFUSE_CPATCH_ENCODER_STREAM_THUMB2
	bool "CPatch stream-thumb2 encoder based patches"
	depends on INFUSE_CPATCH
	select INFUSE_CPATCH_VERSION_3
	select INFUSE_CPATCH_READ_AHEAD
	default y if ISA_THUMB2
	help
	  Patches generated by the stream-thumb2 encoder, for Cortex-M images,
	  where copies relocate the Thumb-2 branches and pointers they contain. Patches are on average
	  35% smaller than shortest-path patches using PATCH_DELTA.

config INFUSE_CPATCH_READ_AHEAD
	bool
	help
	  Read the input and patch files through 64 byte read-ahead caches,
	  reducing the number of flash reads when applying a patch. Required by
	  stream encoders, which read the patch file a byte at a time. Requires
	  an additional 144 bytes of stack while applying a patch.

config INFUSE_CPATCH_VERSION_1
	bool
	help
	  Original set of patching instructions

config INFUSE_CPATCH_VERSION_2
	bool
	help
	  Addition of the PATCH_DELTA instruction. This reduces patch
	  sizes by an average of 35%.

config INFUSE_CPATCH_VERSION_3
	bool
	help
	  Relocation preamble followed by an element stream.
	  Patch applier allocates ~1kB of static RAM as caches with default settings.

if INFUSE_CPATCH_ENCODER_STREAM_THUMB2

config INFUSE_CPATCH_STREAM_THUMB2_REGIONS_MAX
	int "Maximum pointer regions outside of the input image"
	default 4
	range 0 255
	help
	  Patches can relocate pointers into address regions outside of the
	  input image, such as RAM. Patches with more regions are rejected.
	  Each region requires 16 bytes of RAM.

config INFUSE_CPATCH_STREAM_THUMB2_MAP_INDEX_SIZE
	int "Relocation map index entries"
	default 64
	range 8 4096
	help
	  Number of relocation map entry offsets held in RAM, shared between
	  all maps of a patch. Map lookups that miss the cache read a single
	  block of ceil(entries / index size) map entries from the patch file
	  instead of binary searching the map. Each entry requires 4 bytes of
	  RAM. Must be larger than the number of maps (regions + 1). Larger
	  indices provide little benefit on real firmware updates, as the
	  index is populated from the patch file when patching starts.

config INFUSE_CPATCH_STREAM_THUMB2_MAP_CACHE_SIZE
	int "Relocation map entries cached"
	default 32
	range 1 255
	help
	  Number of recently used relocation map entries held in RAM.
	  Consecutive relocation sites tend to reference the same map entries,
	  on real firmware updates 16 entries avoid 91% of map lookups and 32
	  entries avoid 94%. Each entry requires 12 bytes of RAM.

endif # INFUSE_CPATCH_ENCODER_STREAM_THUMB2

if INFUSE_CPATCH

module = CPATCH
module-str = cpatch
source "subsys/logging/Kconfig.template.log_config"

endif
```

## subsys/usb/Kconfig
```kconfig
# Copyright (c) 2026 Embeint Holdings Pty Ltd
# SPDX-License-Identifier: FSL-1.1-ALv2

menu "Infuse-IoT USB support"

menuconfig INFUSE_CDC_ACM_SERIAL_INITIALIZE_AT_BOOT
	bool "Initialize USB device and CDC ACM UART at boot"
	depends on USBD_CDC_ACM_CLASS
	depends on !CDC_ACM_SERIAL_INITIALIZE_AT_BOOT
	help
	  Infuse-owned equivalent of CDC_ACM_SERIAL_INITIALIZE_AT_BOOT.
	  This is intended for applications that use the USB device-next CDC
	  ACM UART as a serial backend and need Infuse to observe USB and CDC
	  ACM state changes.

if INFUSE_CDC_ACM_SERIAL_INITIALIZE_AT_BOOT

config INFUSE_CDC_ACM_SERIAL_ENABLE_AT_BOOT
	bool "USB device will be enabled at boot"
	default y
	help
	  When disabled, the application is responsible for enabling/disabling
	  the USB device.

config INFUSE_CDC_ACM_SERIAL_MANUFACTURER_STRING
	string "USB device manufacturer string descriptor"
	default "Embeint"
	help
	  USB device manufacturer string descriptor.

config INFUSE_CDC_ACM_SERIAL_PRODUCT_STRING
	string "USB device product string descriptor"
	default "Infuse-IoT Generic"
	help
	  USB device product string descriptor.

config INFUSE_CDC_ACM_SERIAL_VID
	hex "USB device Vendor ID"
	default 0x2fe3
	help
	  USB vendor identifier. Zephyr default for development. MUST be changed
	  for released products.

config INFUSE_CDC_ACM_SERIAL_PID
	hex "USB device Product ID"
	default 0x0004
	help
	  USB product identifier.

config INFUSE_CDC_ACM_SERIAL_SELF_POWERED
	bool "USB device Self-powered attribute"
	help
	  Set the Self-powered attribute in the configuration.

config INFUSE_CDC_ACM_SERIAL_MAX_POWER
	int "USB device bMaxPower value"
	default 125
	range 0 250
	help
	  bMaxPower value in the configuration in 2 mA units.

endif # INFUSE_CDC_ACM_SERIAL_INITIALIZE_AT_BOOT

endmenu
```

## sysbuild/Kconfig
```kconfig
# Infuse-IoT sysbuild integration

BOARD_QUALIFIERS_LAST_THREE := $(substring,$(BOARD_QUALIFIERS),-3)

config INFUSE_INTEGRATION
	bool "Sysbuild compilation according to Infuse-IoT"

config INFUSE_INTEGRATION_BT_CTLR
	bool "Application expects infuse-bt-ctlr snippet instead of infuse"

config INFUSE_INTEGRATION_IS_NS
	bool
	default "$(BOARD_QUALIFIERS_LAST_THREE)" = "/ns"

choice BOOTLOADER
	default BOOTLOADER_NONE if INFUSE_INTEGRATION_IS_NS
	default BOOTLOADER_MCUBOOT if INFUSE_INTEGRATION
endchoice

config INFUSE_MCUBOOT_MULTITHREADING
	bool "Force multithreading on in MCUboot"
	default y
	depends on INFUSE_INTEGRATION && BOOTLOADER_MCUBOOT
	help
	  External flash drivers and USB support in MCUboot depend on
	  multithreading. Disable for internal-flash-only bootloaders to
	  reduce ROM usage.

config BT_HCI_IPC_BOARD_TARGET_CPUCLUSTER
	string
	default "cpunet" if SOC_NRF5340_CPUAPP

choice BOOT_SIGNATURE_TYPE
	default BOOT_SIGNATURE_TYPE_ECDSA_P256 if SOC_FAMILY_ESPRESSIF_ESP32
endchoice
```

## tests/bsim/bluetooth/gatt/testcase.yaml
```yaml
common:
  tags:
    - bluetooth
    - auto
    - data_logger
    - epacket
    - kv_store
    - logging
    - math
    - rpc
    - states
    - task_runner
    - tdf
  build_only: true
  required_snippets:
    - infuse
  platform_allow:
    - nrf52_bsim/native
    - nrf54l15bsim/nrf54l15/cpuapp
    - nrf5340bsim/nrf5340/cpunet
  harness: bsim
tests:
  bluetooth.gatt:
    harness_config:
      bsim_exe_name: tests_bsim_bluetooth_gatt_prj_conf
  bluetooth.gatt.sdc:
    harness_config:
      bsim_exe_name: tests_bsim_bluetooth_gatt_sdc_prj_conf
    extra_args:
      - DTC_OVERLAY_FILE="./app.overlay;./nrf_sdc.overlay"
```

## tests/bsim/ieee802154/basic/testcase.yaml
```yaml
common:
  tags:
    - ieee802154
    - epacket
    - kv_store
    - math
    - net
    - rpc
    - states
    - task_runner
    - tdf
  build_only: true
  required_snippets:
    - infuse
  platform_allow:
    - nrf52_bsim/native
  harness: bsim
tests:
  ieee802154.basic:
    harness_config:
      bsim_exe_name: tests_bsim_ieee802154_basic_prj_conf
```

## tests/drivers/build_all/testcase.yaml
```yaml
common:
  tags:
    - drivers
    - charger
    - fuel_gauge
    - gnss
    - imu
    - led
    - modem
    - sensor
    - shared_device
  platform_allow:
    - native_sim
  integration_platforms:
    - native_sim
  build_only: true
tests:
  infuse.build: {}
  infuse.build.pm:
    extra_configs:
      - CONFIG_PM_DEVICE=y
```

## tests/drivers/cyw43_transport/testcase.yaml
```yaml
tests:
  drivers.bluetooth.cyw43_transport:
    tags: drivers bluetooth
    platform_allow: [mps2/an385]
    integration_platforms: [mps2/an385]
```

## tests/drivers/gnss/testcase.yaml
```yaml
sample:
  description: GNSS
  name: GNSS

common:
  tags:
    - gnss
    - epacket
    - kv_store
    - logging
    - modem
    - rpc
    - shared_device
    - states
    - tdf
tests:
  sample.gnss.sparkfun_sam_m10q:
    build_only: true
    sysbuild: true
    extra_args:
      - gnss_SHIELD=sparkfun_sam_m10
    platform_allow:
      - nrf52840dk/nrf52840
    integration_platforms:
      - nrf52840dk/nrf52840
```

## tests/drivers/imu/resample/testcase.yaml
```yaml
common:
  tags: imu
tests:
  lib.imu.resample:
    integration_platforms:
      - native_sim
      - qemu_cortex_m3
```

## tests/drivers/sensor/bq25798/testcase.yaml
```yaml
common:
  tags:
    - drivers
    - sensor
    - bq25798
  platform_allow:
    - native_sim
    - qemu_cortex_m3
  integration_platforms:
    - native_sim
    - qemu_cortex_m3
tests:
  drivers.sensor.bq25798: {}
  drivers.sensor.bq25798.no_status_retry:
    extra_configs:
      - CONFIG_BQ25798_FETCH_STATUS_CHECKS=n
      - CONFIG_BQ25798_FETCH_POOR_SOURCE_RETRY=n
```

## tests/drivers/watchdog_sw_multichannel/testcase.yaml
```yaml
common:
  tags: watchdog
  min_flash: 64
  min_ram: 32
tests:
  drivers.watchdog.sw_multichannel:
    platform_allow:
      - mps2/an385
    integration_platforms:
      - mps2/an385
```

## tests/drivers/watchdog_warning/testcase.yaml
```yaml
common:
  tags: watchdog
  min_flash: 64
  min_ram: 32
tests:
  drivers.watchdog.software_warning:
    platform_allow:
      - mps2/an385
    integration_platforms:
      - mps2/an385
```

## tests/lib/application_states/testcase.yaml
```yaml
common:
  tags:
    - states
    - kv_store
tests:
  libraries.application_states:
    integration_platforms:
      - native_sim
      - qemu_cortex_m3
    min_flash: 64
    min_ram: 32
```

## tests/lib/auto/charge_accumulator/testcase.yaml
```yaml
common:
  tags:
    - auto
    - data_logger
    - tdf
    - time
    - zbus
tests:
  libraries.auto.charge_accumulator:
    platform_allow:
      - native_sim
    integration_platforms:
      - native_sim
    min_flash: 64
    min_ram: 32
```

## tests/lib/auto/charger_control/testcase.yaml
```yaml
common:
  tags:
    - auto
    - data_logger
    - epacket
    - kv_store
    - tdf
    - time
    - zbus
tests:
  libraries.auto.charge_control:
    platform_allow:
      - native_sim
    integration_platforms:
      - native_sim
    min_flash: 64
    min_ram: 32
```

## tests/lib/auto/kv_update_log/testcase.yaml
```yaml
common:
  tags:
    - auto
    - data_logger
    - epacket
    - kv_store
    - tdf
    - time
tests:
  libraries.auto.kv_update_log:
    platform_allow:
      - native_sim
    integration_platforms:
      - native_sim
    min_flash: 64
    min_ram: 32
```

## tests/lib/auto/location_timezone/testcase.yaml
```yaml
common:
  tags:
    - auto
    - math
    - tdf
    - time
    - zbus
tests:
  libraries.auto.location_timezone:
    platform_allow:
      - native_sim
    integration_platforms:
      - native_sim
    min_flash: 64
    min_ram: 32
```

## tests/lib/auto/lte_control/testcase.yaml
```yaml
common:
  tags:
    - auto
    - data_logger
    - epacket
    - kv_store
    - modem_monitor
    - states
    - tdf
    - time
tests:
  libraries.auto.lte_control:
    platform_allow:
      - native_sim
    integration_platforms:
      - native_sim
    min_flash: 64
    min_ram: 32
```

## tests/lib/auto/soc_device_control/testcase.yaml
```yaml
common:
  tags:
    - auto
    - tdf
    - zbus
tests:
  libraries.auto.soc_device_control:
    platform_allow:
      - native_sim
    integration_platforms:
      - native_sim
    min_flash: 64
    min_ram: 32
```

## tests/lib/auto/time_sync_log/testcase.yaml
```yaml
common:
  tags:
    - auto
    - data_logger
    - epacket
    - kv_store
    - reboot
    - tdf
    - time
tests:
  libraries.auto.time_sync_log:
    integration_platforms:
      - native_sim
      - qemu_cortex_m3
    min_flash: 64
    min_ram: 32
```

## tests/lib/epoch_time/testcase.yaml
```yaml
common:
  tags:
    - time
    - kv_store
    - states
tests:
  libraries.epoch_time:
    integration_platforms:
      - native_sim
      - qemu_cortex_m3
    min_flash: 64
    min_ram: 32
```

## tests/lib/espressif_identifiers/testcase.yaml
```yaml
# Copyright (c) 2026 Embeint Holdings Pty Ltd
# SPDX-License-Identifier: FSL-1.1-ALv2
tests:
  libraries.espressif_identifiers:
    tags: infuse
    platform_allow:
      - qemu_cortex_m3
      - native_sim/native/64
    integration_platforms:
      - qemu_cortex_m3
```
