## Kconfig.defaults.bluetooth
```kconfig
# Infuse-IoT SDK Bluetooth defaults

if BT

# Cannot connect to Nordic Softdevice from iOS
# https://devzone.nordicsemi.com/f/nordic-q-a/113141/softdevice-extended-advertising-ios-connection
choice BT_LL_CHOICE
	default BT_LL_SW_SPLIT
endchoice

# Extended advertising is a requirement
configdefault BT_EXT_ADV
	default y

# TX Bluetooth advertising packets
configdefault BT_BROADCASTER
	default y
# RX Bluetooth Advertising packets
configdefault BT_OBSERVER
	default y
# Support being the target of a connection
configdefault BT_PERIPHERAL
	default y

# While extended advertising can support 255 bytes, iOS only supports 124 bytes
configdefault BT_CTLR_ADV_DATA_LEN_MAX
	default 124

endif # BT
```

## Kconfig.defaults.core
```kconfig
# Infuse-IoT SDK core defaults

# Picolibc is smaller and more performant
choice LIBC_IMPLEMENTATION
	default PICOLIBC if !NATIVE_BUILD
endchoice

configdefault MAIN_STACK_SIZE
	default 2048

# Reboot state storage
configdefault REBOOT
	default y
configdefault HWINFO
	default y
configdefault INFUSE_REBOOT
	default y if !ZTEST
configdefault RETENTION
	default y
configdefault RETENTION_MUTEX_FORCE_DISABLE
	default y
configdefault RETAINED_MEM
	default y
configdefault RETAINED_MEM_MUTEX_FORCE_DISABLE
	default y

# Power management
configdefault PM_DEVICE
	default y
configdefault PM_DEVICE_RUNTIME
	default y

# Watchdog
configdefault WATCHDOG
	default y if !ZTEST
configdefault INFUSE_WATCHDOG
	default y if !ZTEST

# Zephyr bus
configdefault ZBUS
	default y
configdefault ZBUS_CHANNEL_ID
	default y
configdefault ZBUS_CHANNEL_PUBLISH_STATS
	default y

# ePacket API
configdefault EPACKET
	default y
configdefault POLL
	default y
configdefault NET_BUF
	default y
configdefault EVENTS
	default y
configdefault UART_INTERRUPT_DRIVEN
	default y

# Remote Procedure Calls
configdefault INFUSE_RPC
	default y

configdefault TDF
	default y

configdefault DATA_LOGGER
	default y
configdefault FILE_SYSTEM_RAW_API
	default y

configdefault INFUSE_EPOCH_TIME
	default y

# Application management
configdefault STREAM_FLASH
	default y if BOOTLOADER_MCUBOOT
configdefault IMG_MANAGER
	default y if BOOTLOADER_MCUBOOT

# KV store
configdefault FLASH
	default y
configdefault FLASH_MAP
	default y
configdefault NVS
	default y
configdefault KV_STORE
	default y
configdefault KV_STORE_REBOOTS
	default y

# Power Management
configdefault POWER_DOMAIN
	default y

# Random numbers
configdefault ENTROPY_GENERATOR
	default y
choice RNG_GENERATOR_CHOICE
	# PSA API adds significant overhead for standard random numbers.
	# Cryptographically secure random numbers directly from PSA
	# can still be obtained with sys_csrand_get.
	default XOSHIRO_RANDOM_GENERATOR if ENTROPY_PSA_CRYPTO_RNG
endchoice

# Trusted-Firmware M
configdefault TFM_MCUBOOT_IMAGE_NUMBER
	# A single image reduces upgrade complexity
	default 1
configdefault TFM_DEVICETREE_LAYOUT
	# Only a subset of boards currently support this
	default y if BOARD_THINGY53_NRF5340_CPUAPP_NS
	default y if BOARD_NRF5340DK_NRF5340_CPUAPP_NS
	default y if BOARD_NRF7002DK_NRF5340_CPUAPP_NS
	default y if BOARD_NRF9151DK_NRF9151_NS
	default y if BOARD_NRF9161DK_NRF9161_NS
configdefault TFM_BL2_SPI_NOR_FLASH
	default y if $(dt_has_compat,$(DT_COMPAT_JEDEC_SPI_NOR)) && TFM_DEVICETREE_LAYOUT
configdefault TFM_BL2_QSPI_FLASH
	default y if $(dt_has_compat,$(DT_COMPAT_NORDIC_QSPI_NOR)) && TFM_DEVICETREE_LAYOUT

# MbedTLS through the PSA API
configdefault MBEDTLS
	default y
configdefault MBEDTLS_ENABLE_HEAP
	default y
configdefault MBEDTLS_HEAP_SIZE
	default 8192
configdefault MBEDTLS_USER_CONFIG_ENABLE
	default y
configdefault MBEDTLS_USER_CONFIG_FILE
	default "infuse/crypto/mbedtls/infuse_user_config.h"
configdefault MBEDTLS_PSA_CRYPTO_C
	default y

choice MBEDTLS_PSA_CRYPTO_RND_SOURCE
	default MBEDTLS_PSA_CRYPTO_EXTERNAL_RNG if NRF_CC3XX_PLATFORM
endchoice
configdefault MBEDTLS_ENTROPY_ENABLED
	default y
configdefault MBEDTLS_ZEPHYR_ENTROPY
	default y if !NRF_CC3XX_PLATFORM
# Key derivation
configdefault PSA_WANT_ALG_HKDF
	default y
configdefault PSA_WANT_ALG_ECDH
	default y
configdefault PSA_WANT_ECC_MONTGOMERY_255
	default y
configdefault PSA_WANT_KEY_TYPE_ECC_PUBLIC_KEY
	default y
configdefault PSA_WANT_KEY_TYPE_ECC_KEY_PAIR_GENERATE
	default y
configdefault INFUSE_SECURE_STORAGE
	default y
# chacha20-poly1305 AEAD
configdefault PSA_WANT_KEY_TYPE_CHACHA20
	default y
configdefault PSA_WANT_ALG_CHACHA20_POLY1305
	default y

# Logging
configdefault PRINTK
	default y
configdefault LOG
	default y
configdefault LOG_PRINTK
	default y

# Debug options
configdefault DEBUG_INFO
	default y
configdefault DEBUG_THREAD_INFO
	default y
configdefault OUTPUT_DISASSEMBLY
	default y if !ZTEST
```

## Kconfig.defaults.log
```kconfig
# Infuse-IoT SDK log defaults

configdefault USB_CDC_ACM_LOG_LEVEL
	default 0

configdefault NVS_LOG_LEVEL
	default 2

configdefault BT_LOG_LEVEL
	default 2
```

## Kconfig.defaults.net
```kconfig
# Infuse-IoT SDK networking defaults

if NETWORKING

if WIFI
choice WIFI_USAGE_MODE
	prompt "Desired application usage of the Wi-Fi driver"
	default WIFI_USAGE_MODE_STA

config WIFI_USAGE_MODE_STA
	bool "Wi-Fi interface acts as a Station"

config WIFI_USAGE_MODE_AP
	bool "Wi-Fi interface acts as an Access Point"

config WIFI_USAGE_MODE_STA_AP
	bool "Wi-Fi interface acts as an Access Point and Station"

config WIFI_USAGE_MODE_SCAN_ONLY
	bool "Wi-Fi interface used for SSID scanning only"

endchoice # WIFI_USAGE_MODE
endif # WIFI

# Core Protocols
configdefault NET_UDP
	default y
configdefault NET_IPV4
	default y
configdefault NET_IPV6
	# Disabled due to IPV6 addresses not being removed on network down
	default n if !NRF_MODEM_LIB

configdefault NET_MAX_CONN
	# DNS + SNTP + UDP + WPA_SUPP consume the default 4
	default 6

# DNS support
configdefault DNS_RESOLVER
	default y
configdefault DNS_RESOLVER_AUTO_INIT
	default y
configdefault DNS_SERVER_IP_ADDRESSES
	default y
configdefault DNS_SERVER1
	default "8.8.8.8"
configdefault DNS_NUM_CONCUR_QUERIES
	# Both libraries do DNS queries immediately upon connection
	default 2 if SNTP_AUTO && EPACKET_INTERFACE_UDP

# SNTP time sync
configdefault SNTP
	default y
configdefault SNTP_AUTO
	default y

# IP assignment
configdefault NET_DHCPV4
	default y

# Sockets
configdefault NET_SOCKETS
	default y

# Infuse-IoT COAP
configdefault COAP
	default y
configdefault INFUSE_COAP
	default y
if INFUSE_COAP && !NRF_MODEM_LIB
configdefault TLS_CREDENTIALS
	default y
configdefault NET_SOCKETS_SOCKOPT_TLS
	default y
configdefault NET_SOCKETS_ENABLE_DTLS
	default y
configdefault MBEDTLS_KEY_EXCHANGE_PSK_ENABLED
	default y
configdefault PSA_WANT_ALG_TLS12_PSK_TO_MS
	default y
configdefault PSA_WANT_ALG_TLS12_PRF
	default y
configdefault PSA_WANT_ALG_ECDSA
	default y if !BUILD_WITH_TFM
configdefault PSA_WANT_ALG_JPAKE
	default y if !BUILD_WITH_TFM
endif # INFUSE_COAP && !NRF_MODEM_LIB

# Zephyr networking
configdefault NET_CONNECTION_MANAGER
	default y
configdefault NET_CONNECTION_MANAGER_CONNECTIVITY_WIFI_MGMT
	default y if (WIFI_USAGE_MODE_STA || WIFI_USAGE_MODE_STA_AP)
configdefault CONN_MGR_WIFI_KV_STORE
	default y if (WIFI_USAGE_MODE_STA || WIFI_USAGE_MODE_STA_AP)

endif # NETWORKING
```

## Kconfig.defaults.nrf
```kconfig
# Infuse-IoT SDK Nordic defaults

if SOC_FAMILY_NRF

configdefault NRF_CC3XX_PLATFORM
	default y

# Oberon backend
configdefault NRF_OBERON
	default y if !BUILD_WITH_TFM

# LTE defaults
configdefault NET_IPV6_MLD
	default n if NRF_MODEM_LIB
configdefault NET_IPV6_NBR_CACHE
	default n if NRF_MODEM_LIB
configdefault NRF_MODEM_LIB_NET_IF
	default y
configdefault NRF_MODEM_LIB_NET_IF_APPLICATION_ERROR_HANDLER
	default y
choice NRF_MODEM_LIB_ON_FAULT
	default NRF_MODEM_LIB_ON_FAULT_APPLICATION_SPECIFIC
endchoice
# Sleep mode notifications
configdefault LTE_LC_MODEM_SLEEP_NOTIFICATIONS
	default y
configdefault LTE_LC_MODEM_SLEEP_PRE_WARNING_TIME_MS
	default 500
configdefault LTE_LC_MODEM_SLEEP_NOTIFICATIONS_THRESHOLD_MS
	default 10240
# Default PSM mode
configdefault LTE_PSM_REQ
	default y
# Bits 5 to 1 represent the binary coded timer value.
# Bits 6 to 8 defines the timer value unit for the GPRS timer as follows:
# Bits
# 8 7 6
# 0 0 0  value is incremented in multiples of 2 seconds
# 0 0 1  value is incremented in multiples of 1 minute
# 0 1 0  value is incremented in multiples of decihours
# 1 1 1  value indicates that the timer is deactivated.
configdefault LTE_PSM_REQ_RAT
	default "00000001"
# Bits 5 to 1 represent the binary coded timer value.
# Bits 6 to 8 defines the timer value unit for the GPRS timer as follows:
# Bits
# 8 7 6
# 0 0 0 value is incremented in multiples of 10 minutes
# 0 0 1 value is incremented in multiples of 1 hour
# 0 1 0 value is incremented in multiples of 10 hours
# 0 1 1 value is incremented in multiples of 2 seconds
# 1 0 0 value is incremented in multiples of 30 seconds
# 1 0 1 value is incremented in multiples of 1 minute
# 1 1 0 value is incremented in multiples of 320 hours (NOTE 1)
# 1 1 1 value indicates that the timer is deactivated (NOTE 2).
configdefault LTE_PSM_REQ_RPTAU
	default "00101100"

# WiFi defaults
configdefault WIFI_NRF700X
	default y if WIFI
configdefault NET_L2_ETHERNET
	default y if WIFI_NRF700X
configdefault WPA_SUPP
	default y if WIFI_NRF700X
configdefault NET_CONNECTION_MANAGER_MONITOR_STACK_SIZE
	default 4096 if NRF700X_STA_MODE
	default 1024 if NRF_MODEM_LIB_NET_IF
configdefault NRF_WIFI_IF_AUTO_START
	default n

# MbedTLS requirements for WiFi connectivity
configdefault MBEDTLS_ECP_ALL_ENABLED
	default y if NRF700X_STA_MODE
configdefault MBEDTLS_ECP_C
	default y if NRF700X_STA_MODE
configdefault MBEDTLS_MAC_CMAC_ENABLED
	default y if NRF700X_STA_MODE
configdefault MBEDTLS_CIPHER_AES_ENABLED
	default y if NRF700X_STA_MODE
configdefault MBEDTLS_CIPHER_MODE_CTR_ENABLED
	default y if NRF700X_STA_MODE

# UART0 is the standard serial port on Nordic boards
configdefault UART_0_NRF_TX_BUFFER_SIZE
	default 1024 if EPACKET_INTERFACE_SERIAL

endif # SOC_FAMILY_NRF
```

## Kconfig.defaults.sensor
```kconfig
# Infuse-IoT SDK sensor defaults

configdefault SENSOR
	default y
configdefault INFUSE_IMU
	default y if "$(dt_alias_enabled,imu0)"
configdefault GNSS
	default y if "$(dt_alias_enabled,gnss)"
configdefault FUEL_GAUGE
	default y if "$(dt_alias_enabled,fuel-gauge0)"

# We want to use UBX messages directly
configdefault GNSS_U_BLOX_NO_API_COMPAT
	default y
configdefault GNSS_U_BLOX_CONSTELLATION_API_COMPAT
	default y

# We want to trigger samples, not run sampling permanently
choice BME280_MODE
	default BME280_MODE_FORCED
endchoice

# Bring SD card init forward so it occurs before data loggers
configdefault SDHC_INIT_PRIORITY
	default 75
configdefault SD_INIT_PRIORITY
	default 76
```

## Kconfig.defaults.stm32
```kconfig
# Infuse-IoT SDK STM32 defaults

if SOC_FAMILY_STM32

configdefault FLASH_EX_OP_ENABLED
	default y if INFUSE_COMMON_BOOT_DEBUG_PORT_DISABLE
configdefault FLASH_STM32_READOUT_PROTECTION
	default y if INFUSE_COMMON_BOOT_DEBUG_PORT_DISABLE

endif # SOC_FAMILY_STM32
```

## Kconfig.defaults.ztest
```kconfig
# Test defaults for Infuse-IoT libraries

if INFUSE_SECURITY

configdefault MAIN_STACK_SIZE
	default 2048
configdefault ZTEST_STACK_SIZE
	default 2048
configdefault MBEDTLS_ZEPHYR_ENTROPY
	default y if !NRF_CC3XX_PLATFORM

endif # INFUSE_SECURITY

configdefault MCUMGR_TRANSPORT_WORKQUEUE_STACK_SIZE
	default 8192 if COVERAGE_GCOV
```

## Kconfig.eis
```kconfig
# Embedded Intelligence SDK options

config EIS_SDK
	bool "Build application with EIS"

rsource "lib/Kconfig"
rsource "subsys/Kconfig"

# EIS defaults
rsource "Kconfig.defaults.core"
rsource "Kconfig.defaults.net"
```

## Kconfig.infuse
```kconfig
# Infuse-IoT SDK options

config INFUSE_SDK
	bool "Build application with Infuse-IoT SDK"

rsource "drivers/Kconfig"
rsource "lib/Kconfig"
rsource "subsys/Kconfig"
rsource "snippets/infuse/Kconfig"

config INFUSE_DEFS_GENERATED_DOWNSTREAM
	bool "TDF, RPC and KV store definitions are provided by downstream"

if !INFUSE_DEFS_GENERATED_DOWNSTREAM
rsource "generated/Kconfig.kv_keys"
rsource "generated/Kconfig.rpc_commands"
endif # !INFUSE_DEFS_GENERATED_DOWNSTREAM

# Infuse-IoT SDK defaults
if INFUSE_SDK

config INFUSE_APPLICATION_ID
	hex "Unique application identifier"
	default 0x00

config INFUSE_APPLICATION_NAME
	string "Application name"
	default "dev"
	help
	  Typically set by the `release-build` scripts.

rsource "kconfig/Kconfig.defaults.core"
rsource "kconfig/Kconfig.defaults.nrf"
rsource "kconfig/Kconfig.defaults.stm32"
rsource "kconfig/Kconfig.defaults.sensor"
rsource "kconfig/Kconfig.defaults.log"

endif # INFUSE_SDK

rsource "kconfig/Kconfig.defaults.802154"
rsource "kconfig/Kconfig.defaults.bluetooth"
rsource "kconfig/Kconfig.defaults.net"

if ZTEST
rsource "kconfig/Kconfig.defaults.ztest"
endif
```

## boards/embeint/auroch/Kconfig.auroch
```kconfig
# Auroch nRF9151 board configuration

# Copyright (c) 2025 Embeint Holdings Pty Ltd
# SPDX-License-Identifier: Apache-2.0

config BOARD_AUROCH
	select SOC_NRF9151_LACA if BOARD_AUROCH_NRF9151 || BOARD_AUROCH_NRF9151_NS
	select SOC_NRF54L15_CPUAPP if BOARD_AUROCH_NRF54L15_CPUAPP
```

## boards/embeint/auroch/Kconfig.defconfig
```kconfig
# Auroch nRF9151 board configuration

# Copyright (c) 2025 Embeint Holdings Pty Ltd
# SPDX-License-Identifier: Apache-2.0

if BOARD_AUROCH_NRF9151 || BOARD_AUROCH_NRF9151_NS

# For the secure version of the board the firmware is linked at the beginning
# of the flash, or into the code-partition defined in DT if it is intended to
# be loaded by MCUboot. If the secure firmware is to be combined with a non-
# secure image (TRUSTED_EXECUTION_SECURE=y), the secure FW image shall always
# be restricted to the size of its code partition.
# For the non-secure version of the board, the firmware
# must be linked into the code-partition (non-secure) defined in DT, regardless.
# Apply this configuration below by setting the Kconfig symbols used by
# the linker according to the information extracted from DT partitions.

# Workaround for not being able to have commas in macro arguments
DT_CHOSEN_Z_CODE_PARTITION := zephyr,code-partition

config FLASH_LOAD_SIZE
	default $(dt_chosen_reg_size_hex,$(DT_CHOSEN_Z_CODE_PARTITION))
	depends on BOARD_NRF9151DK_NRF9151 && TRUSTED_EXECUTION_SECURE

if BOARD_AUROCH_NRF9151_NS

config FLASH_LOAD_OFFSET
	default $(dt_chosen_reg_addr_hex,$(DT_CHOSEN_Z_CODE_PARTITION))

config FLASH_LOAD_SIZE
	default $(dt_chosen_reg_size_hex,$(DT_CHOSEN_Z_CODE_PARTITION))

configdefault TFM_LOG_LEVEL_SILENCE
	default y

endif # BOARD_AUROCH_NRF9151_NS

# BQ25798 sampling takes some time
configdefault FUEL_GAUGE_COMPOSITE_DATA_VALIDITY_MS
	default 500

endif

if BOARD_AUROCH_NRF54L15_CPUAPP

configdefault ROM_START_OFFSET
	default 0x800 if BOOTLOADER_MCUBOOT

endif # BOARD_AUROCH_NRF54L15_CPUAPP
```

## boards/embeint/auroch/auroch_nrf54l15_cpuapp_0_1_0_defconfig
```kconfig
# Copyright (c) 2025 Embeint Holdings Pty Ltd
# SPDX-License-Identifier: Apache-2.0

CONFIG_UART_20_INTERRUPT_DRIVEN=n
CONFIG_UART_20_ASYNC=y
CONFIG_NRF_SW_LPUART_INT_DRIVEN=y
CONFIG_NRF_SW_LPUART_INT_DRV_TX_BUF_SIZE=256
CONFIG_NRF_SW_LPUART_MAX_PACKET_SIZE=1024

# LFXTAL is causing issues with Bluetooth connections
# Use the internal RC oscillator until the root cause can be resolved
CONFIG_CLOCK_CONTROL_NRF_K32SRC_RC=y
CONFIG_CLOCK_CONTROL_NRF_K32SRC_XTAL=n
```

## boards/embeint/auroch/auroch_nrf54l15_cpuapp_defconfig
```kconfig
# Copyright (c) 2025 Embeint Holdings Pty Ltd
# SPDX-License-Identifier: Apache-2.0

# Enable GPIO
CONFIG_GPIO=y

# Enable MPU
CONFIG_ARM_MPU=y

# Enable hardware stack protection
CONFIG_HW_STACK_PROTECTION=y

# Enable uart driver
CONFIG_SERIAL=y

# Enable console
CONFIG_CONSOLE=y
CONFIG_USE_SEGGER_RTT=y
CONFIG_UART_CONSOLE=y
CONFIG_LOG_BACKEND_RTT=n
CONFIG_RTT_CONSOLE=n
```
