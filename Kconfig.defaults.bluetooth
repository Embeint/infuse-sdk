## boards/embeint/auroch/auroch_nrf9151_ns_0_1_0_defconfig
```kconfig
# Copyright (c) 2025 Embeint Holdings Pty Ltd
# SPDX-License-Identifier: Apache-2.0

CONFIG_UART_0_INTERRUPT_DRIVEN=n
CONFIG_UART_0_ASYNC=y
CONFIG_NRF_SW_LPUART_INT_DRIVEN=y
CONFIG_NRF_SW_LPUART_INT_DRV_TX_BUF_SIZE=256
CONFIG_NRF_SW_LPUART_MAX_PACKET_SIZE=1024
```

## boards/embeint/auroch/board.yml
```yaml
board:
  name: auroch
  vendor: embeint
  socs:
  - name: nrf9151
    variants:
    - name: 'ns'
  - name: nrf54l15
  revision:
    format: major.minor.patch
    default: "1.0.0"
    revisions:
    - name: "0.1.0"
    - name: "1.0.0"
```

## boards/embeint/kudu/Kconfig.kudu
```kconfig
# Copyright (c) 2025 Embeint Inc
# SPDX-License-Identifier: Apache-2.0

config BOARD_KUDU_NRF54L15_CPUAPP
	select SOC_NRF54L15_CPUAPP if BOARD_KUDU_NRF54L15_CPUAPP
```

## boards/embeint/kudu/board.yml
```yaml
board:
  name: kudu
  full_name: Kudu CAT1 LTE Gateway
  vendor: embeint
  socs:
  - name: nrf54l15
```

## boards/embeint/tauro/Kconfig.defconfig
```kconfig
# Tauro nRF9151 board configuration

# Copyright (c) 2024 Embeint Holdings Pty Ltd
# SPDX-License-Identifier: Apache-2.0

if BOARD_TAURO_NRF9151 || BOARD_TAURO_NRF9151_NS

# For the secure version of the board the firmware is linked at the beginning
# of the flash, or into the code-partition defined in DT if it is intended to
# be loaded by MCUboot. If the secure firmware is to be combined with a non-
# secure image (TRUSTED_EXECUTION_SECURE=y), the secure FW image shall always
# be restricted to the size of its code partition.
# For the non-secure version of the board, the firmware
# must be linked into the code-partition (non-secure) defined in DT, regardless.
# Apply this configuration below by setting the Kconfig symbols used by
# the linker according to the information extracted from DT partitions.

# Workaround for not being able to have commas in macro arguments
DT_CHOSEN_Z_CODE_PARTITION := zephyr,code-partition

config FLASH_LOAD_SIZE
	default $(dt_chosen_reg_size_hex,$(DT_CHOSEN_Z_CODE_PARTITION))
	depends on BOARD_NRF9151DK_NRF9151 && TRUSTED_EXECUTION_SECURE

if BOARD_TAURO_NRF9151_NS

config FLASH_LOAD_OFFSET
	default $(dt_chosen_reg_addr_hex,$(DT_CHOSEN_Z_CODE_PARTITION))

config FLASH_LOAD_SIZE
	default $(dt_chosen_reg_size_hex,$(DT_CHOSEN_Z_CODE_PARTITION))

configdefault TFM_LOG_LEVEL_SILENCE
	default y

endif # BOARD_TAURO_NRF9151_NS

endif

if BOARD_TAURO_NRF52840

endif # BOARD_TAURO_NRF52840
```

## boards/embeint/tauro/Kconfig.tauro
```kconfig
# Tauro nRF9151 board configuration

# Copyright (c) 2024 Embeint Holdings Pty Ltd
# SPDX-License-Identifier: Apache-2.0

config BOARD_TAURO
	select SOC_NRF9151_LACA if BOARD_TAURO_NRF9151 || BOARD_TAURO_NRF9151_NS
	select SOC_NRF52840_QIAA if BOARD_TAURO_NRF52840
```

## boards/embeint/tauro/board.yml
```yaml
board:
  name: tauro
  full_name: Tauro
  vendor: embeint
  socs:
  - name: nrf9151
    variants:
    - name: 'ns'
  - name: nrf52840
```

## boards/embeint/tauro2/Kconfig.tauro2
```kconfig
# Tauro2 nRF9151 board configuration

# Copyright (c) 2026 Embeint Holdings Pty Ltd
# SPDX-License-Identifier: Apache-2.0

config BOARD_TAURO2
	select SOC_NRF9151_LACA if BOARD_TAURO2_NRF9151 || BOARD_TAURO2_NRF9151_NS
	select SOC_NRF54L15_CPUAPP if BOARD_TAURO2_NRF54L15_CPUAPP
```
