## CMakeLists.txt
```
# SPDX-License-Identifier: Apache-2.0

set(EXTRA_CONF_FILE "../../infuse_security.conf")

cmake_minimum_required(VERSION 3.20.0)
find_package(Zephyr REQUIRED HINTS $ENV{ZEPHYR_BASE})
project(security)

target_sources(app PRIVATE
  src/main.c
)
```

## prj.conf
```kconfig
CONFIG_ZTEST=y
CONFIG_ENTROPY_GENERATOR=y
CONFIG_TEST_RANDOM_GENERATOR=y
CONFIG_NET_BUF=y
CONFIG_NET_BUF_POOL_USAGE=y
CONFIG_POLL=y

CONFIG_INFUSE_SECURITY_TEST_CREDENTIALS=n
CONFIG_INFUSE_SECURITY_LOG_LEVEL_DBG=y

# Don't commit network parameters to your repo for non-test applications!
CONFIG_INFUSE_SECURITY_SECONDARY_NETWORK_ENABLE=y
CONFIG_INFUSE_SECURITY_SECONDARY_NETWORK="test_network.yaml"
```

## src/main.c
```c
/**
 * @file
 * @copyright 2024 Embeint Holdings Pty Ltd
 * @author Jordan Yates <jordan@embeint.com>
 *
 * SPDX-License-Identifier: FSL-1.1-ALv2
 */

#include <string.h>

#include <zephyr/ztest.h>
#include <zephyr/kernel.h>
#include <zephyr/random/random.h>

#include <psa/internal_trusted_storage.h>

#include <infuse/security.h>
#include <infuse/fs/kv_store.h>
#include <infuse/fs/kv_types.h>
#include <infuse/cloud_public_key.h>

/* Copied from the security module's internal storage ID sequence. */
#define INFUSE_CLOUD_PUBLIC_KEY_FINGERPRINT_ID (KV_KEY_SECURE_STORAGE_RESERVED + 6)

static int psa_free_infuse_init(void)
{
	/* Reset PSA configuration */
	mbedtls_psa_crypto_free();

	return infuse_security_init();
}

static void default_init(void)
{
	(void)psa_free_infuse_init();

	/* Refresh network keys to default state */
	(void)infuse_security_network_key_write(0, NULL);
	(void)infuse_security_secondary_network_key_write(0, NULL);
	infuse_security_network_keys_unload();
	infuse_security_network_keys_load();
}

static void assert_network_ids(uint32_t primary_id, uint32_t secondary_id)
{
	struct kv_network_id_primary primary;
	struct kv_network_id_secondary secondary;

	zassert_equal(primary_id, infuse_security_network_key_identifier());
	zassert_equal(secondary_id, infuse_security_secondary_network_key_identifier());

	zassert_equal(sizeof(primary), KV_STORE_READ(KV_KEY_NETWORK_ID_PRIMARY, &primary));
	zassert_equal(sizeof(secondary), KV_STORE_READ(KV_KEY_NETWORK_ID_SECONDARY, &secondary));
	zassert_equal(primary_id, primary.id);
	zassert_equal(secondary_id, secondary.id);
}

ZTEST(security, test_network_ids)
{
	default_init();

	/* Default network IDs */
	assert_network_ids(0x000000, 0xFFFFFF);
}

ZTEST(security, test_root_reset)
{
	uint8_t root_public_key_initial[32];
	uint8_t root_public_key_check[32];
	uint32_t root_key_id_initial;
	int rc;

	default_init();

	/* Read out the initial root key information */
	root_key_id_initial = infuse_security_device_key_identifier();
	rc = infuse_security_device_public_key(root_public_key_initial);
	zassert_equal(0, rc);

	/* Re-initialise once, should be no change */
	rc = infuse_security_init();
	zassert_equal(0, rc);
	rc = infuse_security_device_public_key(root_public_key_check);
	zassert_equal(0, rc);
	zassert_equal(root_key_id_initial, infuse_security_device_key_identifier());
	rc = memcmp(root_public_key_initial, root_public_key_check,
		    sizeof(root_public_key_initial));
	zassert_equal(0, rc);

	/* Run the reset functionality */
	rc = infuse_security_device_root_reset();
	zassert_equal(0, rc);

	/* Re-initialise the security module (simulating reboot) */
	rc = psa_free_infuse_init();
	zassert_equal(0, rc);

	/* Check new keypair being used */
	rc = infuse_security_device_public_key(root_public_key_check);
	zassert_equal(0, rc);
	zassert_not_equal(root_key_id_initial, infuse_security_device_key_identifier());
	rc = memcmp(root_public_key_initial, root_public_key_check,
		    sizeof(root_public_key_initial));
	zassert_not_equal(0, rc);
}

ZTEST(security, test_cloud_key_fingerprint_rotation)
{
	uint64_t fingerprint = INFUSE_CLOUD_PUBLIC_KEY_FINGERPRINT ^ 1;
	uint64_t fingerprint_readback;
	uint8_t root_public_key_initial[32];
	uint8_t root_public_key_check[32];
	uint32_t root_key_id_initial;
	size_t olen;
	int rc;

	default_init();

	root_key_id_initial = infuse_security_device_key_identifier();
	zassert_equal(0, infuse_security_device_public_key(root_public_key_initial));

	/* Simulate an upgrade from firmware built with a different cloud public key. */
	zassert_equal(PSA_SUCCESS,
		      psa_its_set(INFUSE_CLOUD_PUBLIC_KEY_FINGERPRINT_ID, sizeof(fingerprint),
				  &fingerprint, PSA_STORAGE_FLAG_NONE));
	zassert_equal(0, psa_free_infuse_init());

	/* The root identity and derived key identifier must have changed. */
	zassert_equal(0, infuse_security_device_public_key(root_public_key_check));
	zassert_not_equal(root_key_id_initial, infuse_security_device_key_identifier());
	zassert_not_equal(0, memcmp(root_public_key_initial, root_public_key_check,
				    sizeof(root_public_key_initial)));

	/* The current fingerprint is committed after successful initialisation. */
	zassert_equal(PSA_SUCCESS,
		      psa_its_get(INFUSE_CLOUD_PUBLIC_KEY_FINGERPRINT_ID, 0,
				  sizeof(fingerprint_readback), &fingerprint_readback, &olen));
	zassert_equal(sizeof(fingerprint_readback), olen);
	zassert_equal(INFUSE_CLOUD_PUBLIC_KEY_FINGERPRINT, fingerprint_readback);

	/* A subsequent boot with the same fingerprint retains the new identity. */
	root_key_id_initial = infuse_security_device_key_identifier();
	memcpy(root_public_key_initial, root_public_key_check, sizeof(root_public_key_initial));
	zassert_equal(0, psa_free_infuse_init());
	zassert_equal(0, infuse_security_device_public_key(root_public_key_check));
	zassert_equal(root_key_id_initial, infuse_security_device_key_identifier());
	rc = memcmp(root_public_key_initial, root_public_key_check,
		    sizeof(root_public_key_initial));
	zassert_equal(0, rc);
}

ZTEST(security, test_cloud_key_fingerprint_default_adoption)
{
	uint64_t fingerprint_readback;
	uint8_t root_public_key_initial[32];
	uint8_t root_public_key_check[32];
	uint32_t root_key_id_initial;
	size_t olen;

	default_init();

	root_key_id_initial = infuse_security_device_key_identifier();
	zassert_equal(0, infuse_security_device_public_key(root_public_key_initial));

	/* Firmware predating fingerprint persistence has an identity but no marker. */
	zassert_equal(PSA_SUCCESS, psa_its_remove(INFUSE_CLOUD_PUBLIC_KEY_FINGERPRINT_ID));
	zassert_equal(0, psa_free_infuse_init());

	zassert_equal(0, infuse_security_device_public_key(root_public_key_check));
#if INFUSE_CLOUD_PUBLIC_KEY_FINGERPRINT == INFUSE_CLOUD_PUBLIC_KEY_DEFAULT_FINGERPRINT
	/* Hosted devices adopt existing identities derived from the default cloud key. */
	zassert_equal(root_key_id_initial, infuse_security_device_key_identifier());
	zassert_equal(0, memcmp(root_public_key_initial, root_public_key_check,
				sizeof(root_public_key_initial)));
#else
	/* A device jumping directly to another key must still rotate its identity. */
	zassert_not_equal(root_key_id_initial, infuse_security_device_key_identifier());
	zassert_not_equal(0, memcmp(root_public_key_initial, root_public_key_check,
				    sizeof(root_public_key_initial)));
#endif
	zassert_equal(PSA_SUCCESS,
		      psa_its_get(INFUSE_CLOUD_PUBLIC_KEY_FINGERPRINT_ID, 0,
				  sizeof(fingerprint_readback), &fingerprint_readback, &olen));
	zassert_equal(sizeof(fingerprint_readback), olen);
	zassert_equal(INFUSE_CLOUD_PUBLIC_KEY_FINGERPRINT, fingerprint_readback);
}

ZTEST(security, test_network_key_update)
{
	uint8_t key_material[32];
	uint32_t key_id_1 = 0xA5A5A5;
	uint32_t key_id_2 = 0x8B8B8B;
	uint32_t val = 0x12345678;
	int rc;

	default_init();

	sys_rand_get(key_material, sizeof(key_material));

	/* Write new network keys */
	rc = infuse_security_network_key_write(key_id_1, key_material);
	zassert_equal(0, rc);
	rc = infuse_security_secondary_network_key_write(key_id_2, key_material);
	zassert_equal(0, rc);

	/* By default nothing changes with the loaded values */
	zassert_equal(0x000000, infuse_security_network_key_identifier());
	zassert_equal(0xFFFFFF, infuse_security_secondary_network_key_identifier());

	/* Once the init function runs again, new keys are used */
	infuse_security_network_keys_unload();
	infuse_security_network_keys_load();

	assert_network_ids(key_id_1, key_id_2);

	/* Writing NULL deletes the key information */
	rc = infuse_security_network_key_write(key_id_1, NULL);
	zassert_equal(0, rc);
	rc = infuse_security_secondary_network_key_write(key_id_2, NULL);
	zassert_equal(0, rc);
	rc = infuse_security_network_key_write(key_id_1, NULL);
	zassert_not_equal(0, rc);
	rc = infuse_security_secondary_network_key_write(key_id_2, NULL);
	zassert_not_equal(0, rc);

	infuse_security_network_keys_unload();
	infuse_security_network_keys_load();
	assert_network_ids(0x000000, 0xFFFFFF);

	/* Manually write bad data to the keys */
	rc = psa_its_set(KV_KEY_SECURE_STORAGE_RESERVED + 3, sizeof(val), &val,
			 PSA_STORAGE_FLAG_NONE);
	zassert_equal(0, rc);
	rc = psa_its_set(KV_KEY_SECURE_STORAGE_RESERVED + 4, sizeof(val), &val,
			 PSA_STORAGE_FLAG_NONE);
	zassert_equal(0, rc);

	/* Initialisation should fail and fallback to defaults */
	infuse_security_network_keys_unload();
	infuse_security_network_keys_load();
	assert_network_ids(0x000000, 0xFFFFFF);
}

ZTEST(security, test_secondary_shared_secret)
{
#ifdef CONFIG_INFUSE_SECURITY_SECONDARY_REMOTE_ENABLE
	struct kv_secondary_remote_public_key remote;
	uint8_t secondary_readback[32];
	psa_key_id_t primary_psa_id;
	psa_key_id_t secondary_psa_id;
	psa_key_id_t secondary_sign_psa_id;
	uint32_t primary_key_id;
	uint32_t secondary_key_id;

	default_init();

	primary_key_id = infuse_security_device_key_identifier();
	primary_psa_id = infuse_security_device_root_key();

	/* No secondary public key exists, values are NULL */
	secondary_key_id = infuse_security_secondary_device_key_identifier();
	secondary_psa_id = infuse_security_secondary_device_root_key();
	secondary_sign_psa_id = infuse_security_secondary_device_sign_key();
	zassert_not_equal(0, infuse_security_secondary_remote_public_key(secondary_readback));
	zassert_equal(0x00, secondary_key_id);
	zassert_equal(PSA_KEY_ID_NULL, secondary_psa_id);
	zassert_equal(PSA_KEY_ID_NULL, secondary_sign_psa_id);
	zassert_equal(-ENOENT, infuse_security_secondary_device_key_reset());

	/* Secondary public key written to KV store */
	sys_rand_get(remote.public_key, sizeof(remote.public_key));
	zassert_equal(sizeof(remote), KV_STORE_WRITE(KV_KEY_SECONDARY_REMOTE_PUBLIC_KEY, &remote));

	/* Shared secret not automatically generated */
	secondary_key_id = infuse_security_secondary_device_key_identifier();
	secondary_psa_id = infuse_security_secondary_device_root_key();
	secondary_sign_psa_id = infuse_security_secondary_device_sign_key();
	zassert_equal(0x00, secondary_key_id);
	zassert_equal(PSA_KEY_ID_NULL, secondary_psa_id);
	zassert_equal(PSA_KEY_ID_NULL, secondary_sign_psa_id);

	/* Generated after init */
	psa_free_infuse_init();

	secondary_key_id = infuse_security_secondary_device_key_identifier();
	secondary_psa_id = infuse_security_secondary_device_root_key();
	secondary_sign_psa_id = infuse_security_secondary_device_sign_key();
	zassert_equal(0, infuse_security_secondary_remote_public_key(secondary_readback));
	zassert_not_equal(0x00, secondary_key_id);
	zassert_not_equal(primary_key_id, secondary_key_id);
	zassert_not_equal(PSA_KEY_ID_NULL, secondary_psa_id);
	zassert_not_equal(PSA_KEY_ID_NULL, secondary_sign_psa_id);
	zassert_not_equal(primary_psa_id, secondary_psa_id);
	zassert_not_equal(primary_psa_id, secondary_sign_psa_id);
	zassert_mem_equal(remote.public_key, secondary_readback, sizeof(secondary_readback));

	/* Should use cached value on next init */
	psa_free_infuse_init();

	secondary_key_id = infuse_security_secondary_device_key_identifier();
	secondary_psa_id = infuse_security_secondary_device_root_key();
	secondary_sign_psa_id = infuse_security_secondary_device_sign_key();
	zassert_equal(0, infuse_security_secondary_remote_public_key(secondary_readback));
	zassert_not_equal(0x00, secondary_key_id);
	zassert_not_equal(PSA_KEY_ID_NULL, secondary_psa_id);
	zassert_not_equal(PSA_KEY_ID_NULL, secondary_sign_psa_id);
	zassert_mem_equal(remote.public_key, secondary_readback, sizeof(secondary_readback));

	/* Can delete cached device key */
	zassert_equal(0, infuse_security_secondary_device_key_reset());
	zassert_equal(-ENOENT, infuse_security_secondary_device_key_reset());
#else
	ztest_test_skip();
#endif /* CONFIG_INFUSE_SECURITY_SECONDARY_REMOTE_ENABLE */
}

ZTEST_SUITE(security, NULL, NULL, NULL, NULL, NULL);
```
