## tests/lib/filters/testcase.yaml
```yaml
common:
  tags: math
tests:
  lib.math.filters:
    integration_platforms:
      - native_sim
      - qemu_cortex_m3
```

## tests/lib/geodesy/testcase.yaml
```yaml
common:
  tags: math
tests:
  lib.math.geodesy:
    integration_platforms:
      - native_sim
      - qemu_cortex_m3
```

## tests/lib/memfault/testcase.yaml
```yaml
common:
  tags:
    - memfault
    - common_boot
    - epacket
    - kv_store
    - modem_monitor
    - reboot
    - rpc
    - states
    - tdf
    - time
    - zbus
  arch_allow: arm
  min_flash: 64
  min_ram: 32
tests:
  lib.memfault:
    ignore_faults: true
    expect_reboot: true
    platform_exclude:
      - native_sim
      - nrf52_bsim
    required_snippets:
      - infuse
    integration_platforms:
      - mps2/an385
```

## tests/lib/provisioning_rpi_pico/testcase.yaml
```yaml
tests:
  lib.provisioning.rpi_pico:
    tags: provisioning identifiers
    platform_allow:
      - mps2/an385
    integration_platforms:
      - mps2/an385
```

## tests/lib/security/testcase.yaml
```yaml
common:
  tags:
    - security
    - crypto
    - kv_store
    - secure_storage
    - tdf
  min_flash: 64
  min_ram: 32
  platform_allow:
    - mps2/an385
  integration_platforms:
    - mps2/an385
tests:
  lib.security: {}
  lib.security.alternate_cloud:
    extra_configs:
      - CONFIG_INFUSE_SECURITY_CLOUD_PUBLIC_KEY_FILE="alternate_cloud_public_key.yaml"
  lib.security.secondary_remote:
    extra_configs:
      - CONFIG_INFUSE_SECURITY_SECONDARY_REMOTE_ENABLE=y
```

## tests/lib/version/testcase.yaml
```yaml
common:
  tags: version
tests:
  libraries.version:
    integration_platforms:
      - native_sim
      - qemu_cortex_m3
```

## tests/net/auto_sntp/immediate/testcase.yaml
```yaml
common:
  tags:
    - net
    - epacket
    - kv_store
    - modem_monitor
    - rpc
    - states
    - tdf
    - time
  min_flash: 64
  min_ram: 32
tests:
  net.auto_sntp.immediate.wifi:
    build_only: true
    integration_platforms:
      - nrf7002dk/nrf5340/cpuapp
    required_snippets:
      - infuse
    depends_on:
      - netif
      - wifi
  net.auto_sntp.immediate.native.sync:
    platform_allow:
      - native_sim
    integration_platforms:
      - native_sim
    timeout: 120
    extra_configs:
      - CONFIG_NATIVE_SIM_SLOWDOWN_TO_REAL_TIME=y
      - CONFIG_SNTP_AUTO_QUERY_TIMEOUT_MS=2000
      - CONFIG_INFUSE_DNS_ASYNC=n
      # Local SNTP server provided by pytest/conftest.py
      - CONFIG_SNTP_AUTO_DEFAULT_SERVER="127.0.0.1"
      - CONFIG_TEST_SNTP_UNRESPONSIVE_SERVER="127.0.0.2"
      - CONFIG_SNTP_AUTO_SERVER_PORT=12301
    extra_args:
      - OVERLAY_CONFIG="overlay-nsos.conf"
    harness: pytest
  net.auto_sntp.immediate.native.async:
    platform_allow:
      - native_sim
    integration_platforms:
      - native_sim
    timeout: 120
    extra_configs:
      - CONFIG_NATIVE_SIM_SLOWDOWN_TO_REAL_TIME=y
      - CONFIG_SNTP_AUTO_QUERY_TIMEOUT_MS=2000
      - CONFIG_INFUSE_DNS_ASYNC=y
      # Local SNTP server provided by pytest/conftest.py
      - CONFIG_SNTP_AUTO_DEFAULT_SERVER="127.0.0.1"
      - CONFIG_TEST_SNTP_UNRESPONSIVE_SERVER="127.0.0.2"
      - CONFIG_SNTP_AUTO_SERVER_PORT=12302
    extra_args:
      - OVERLAY_CONFIG="overlay-nsos.conf"
    harness: pytest
```

## tests/net/auto_sntp/triggered/testcase.yaml
```yaml
common:
  tags:
    - net
    - epacket
    - kv_store
    - modem_monitor
    - rpc
    - states
    - tdf
    - time
  min_flash: 64
  min_ram: 32
tests:
  net.auto_sntp.triggered.native.sync:
    platform_allow:
      - native_sim
    integration_platforms:
      - native_sim
    extra_configs:
      - CONFIG_NATIVE_SIM_SLOWDOWN_TO_REAL_TIME=y
      - CONFIG_INFUSE_DNS_ASYNC=n
      - CONFIG_SNTP_AUTO_LOG_LEVEL_DBG=y
      # Local SNTP server provided by pytest/conftest.py
      - CONFIG_SNTP_AUTO_DEFAULT_SERVER="127.0.0.1"
      - CONFIG_TEST_SNTP_UNRESPONSIVE_SERVER="127.0.0.2"
      - CONFIG_SNTP_AUTO_SERVER_PORT=12303
    extra_args:
      - OVERLAY_CONFIG="overlay-nsos.conf"
    harness: pytest
  net.auto_sntp.triggered.native.async:
    platform_allow:
      - native_sim
    integration_platforms:
      - native_sim
    extra_configs:
      - CONFIG_NATIVE_SIM_SLOWDOWN_TO_REAL_TIME=y
      - CONFIG_INFUSE_DNS_ASYNC=y
      - CONFIG_SNTP_AUTO_LOG_LEVEL_DBG=y
      # Local SNTP server provided by pytest/conftest.py
      - CONFIG_SNTP_AUTO_DEFAULT_SERVER="127.0.0.1"
      - CONFIG_TEST_SNTP_UNRESPONSIVE_SERVER="127.0.0.2"
      - CONFIG_SNTP_AUTO_SERVER_PORT=12304
    extra_args:
      - OVERLAY_CONFIG="overlay-nsos.conf"
    harness: pytest
```

## tests/net/coap/general/testcase.yaml
```yaml
common:
  tags:
    - net
    - epacket
    - kv_store
    - modem_monitor
    - rpc
    - states
    - tdf
  min_flash: 64
  min_ram: 32
tests:
  net.coap.general.wifi:
    build_only: true
    integration_platforms:
      - nrf7002dk/nrf5340/cpuapp
    required_snippets:
      - infuse
    depends_on:
      - netif
      - wifi
  net.coap.general.native:
    platform_allow:
      - native_sim
    integration_platforms:
      - native_sim
    extra_configs:
      # Local CoAP server provided by pytest/conftest.py
      - CONFIG_TEST_COAP_SERVER="127.0.0.1"
      - CONFIG_TEST_COAP_SERVER_PORT=15683
    extra_args:
      - OVERLAY_CONFIG="overlay-nsos.conf"
    harness: pytest
  net.coap.general.native.serial:
    platform_allow:
      - native_sim
    integration_platforms:
      - native_sim
    extra_configs:
      - CONFIG_INFUSE_COAP_BACKEND_SERIAL=y
      # Local CoAP server provided by pytest/conftest.py
      - CONFIG_TEST_COAP_SERVER="127.0.0.1"
      - CONFIG_TEST_COAP_SERVER_PORT=15686
    extra_args:
      - OVERLAY_CONFIG="overlay-nsos.conf"
    harness: pytest
```

## tests/net/conn_mgr/wifi_kv_store/testcase.yaml
```yaml
common:
  tags:
    - net
    - kv_store
    - modem_monitor
    - tdf
    - wifi
tests:
  net.conn_mgr.wifi_kv_store:
    platform_allow:
      - native_sim
    integration_platforms:
      - native_sim
```

## tests/net/dns/testcase.yaml
```yaml
common:
  tags:
    - net
    - epacket
    - kv_store
    - modem_monitor
    - rpc
    - states
    - tdf
  min_flash: 64
  min_ram: 32
tests:
  net.dns.wifi:
    build_only: true
    integration_platforms:
      - nrf7002dk/nrf5340/cpuapp
    required_snippets:
      - infuse
    depends_on:
      - netif
      - wifi
  net.dns.native:
    platform_allow:
      - native_sim
    integration_platforms:
      - native_sim
    extra_configs:
      # Local DNS server provided by pytest/conftest.py
      - CONFIG_DNS_SERVER1="127.0.0.1:15353"
    extra_args:
      - OVERLAY_CONFIG="overlay-nsos.conf"
    harness: pytest
```

## tests/subsys/algorithm/algorithms/movement_threshold/testcase.yaml
```yaml
common:
  tags:
    - algorithm_runner
    - algorithms
    - data_logger
    - epacket
    - gnss
    - imu
    - kv_store
    - littlefs
    - math
    - reboot
    - rpc
    - states
    - task_runner
    - tdf
    - zbus
  min_flash: 64
  min_ram: 32
tests:
  algorithm_runner.algorithms.movement_threshold:
    required_snippets:
      - infuse
    integration_platforms:
      - mps2/an385
```

## tests/subsys/algorithm/algorithms/tilt/testcase.yaml
```yaml
common:
  tags:
    - algorithm_runner
    - algorithms
    - data_logger
    - epacket
    - gnss
    - imu
    - kv_store
    - littlefs
    - math
    - reboot
    - rpc
    - states
    - task_runner
    - tdf
    - time
    - zbus
  min_flash: 64
  min_ram: 32
tests:
  algorithm_runner.algorithms.tilt:
    required_snippets:
      - infuse
    integration_platforms:
      - mps2/an385
```

## tests/subsys/algorithm/runner/builtin/testcase.yaml
```yaml
common:
  tags:
    - algorithm_runner
    - algorithms
    - data_logger
    - epacket
    - imu
    - kv_store
    - littlefs
    - math
    - reboot
    - states
    - tdf
    - zbus
  min_flash: 64
  min_ram: 32
tests:
  algorithm.runner.builtin:
    platform_allow:
      - native_sim
      - mps2/an385
    integration_platforms:
      - native_sim
      - mps2/an385
```

## tests/subsys/algorithm/runner/llext/testcase.yaml
```yaml
common:
  tags:
    - algorithm_runner
    - algorithms
    - data_logger
    - kv_store
    - littlefs
    - reboot
    - tdf
    - zbus
  min_flash: 64
  min_ram: 32
  platform_allow:
    - mps2/an385
  integration_platforms:
    - mps2/an385
tests:
  algorithm.runner.llext: {}
```

## tests/subsys/cpatch/testcase.yaml
```yaml
common:
  tags: infuse
tests:
  cpatch.patch:
    platform_allow:
      - native_sim
    integration_platforms:
      - native_sim
  cpatch.patch.shortest_path_only:
    platform_allow:
      - native_sim
    integration_platforms:
      - native_sim
    extra_configs:
      - CONFIG_INFUSE_CPATCH_ENCODER_STREAM_THUMB2=n
  cpatch.patch.stream_thumb2_minimal_cache:
    platform_allow:
      - native_sim
    integration_platforms:
      - native_sim
    extra_configs:
      - CONFIG_INFUSE_CPATCH_STREAM_THUMB2_MAP_CACHE_SIZE=1
      - CONFIG_INFUSE_CPATCH_STREAM_THUMB2_MAP_INDEX_SIZE=8
  cpatch.patch.stream_thumb2_no_regions:
    platform_allow:
      - native_sim
    integration_platforms:
      - native_sim
    extra_configs:
      - CONFIG_INFUSE_CPATCH_STREAM_THUMB2_REGIONS_MAX=0
```

## tests/subsys/data_logger/backends/disk_access/testcase.yaml
```yaml
common:
  tags:
    - data_logger
    - kv_store
    - tdf
    - watchdog
  min_flash: 64
  min_ram: 32
tests:
  data_logger.disk_access:
    platform_allow:
      - native_sim
    integration_platforms:
      - native_sim
```

## tests/subsys/data_logger/high_level/tdf_exfat/testcase.yaml
```yaml
common:
  tags:
    - data_logger
    - epacket
    - kv_store
    - tdf
    - watchdog
  min_flash: 64
  min_ram: 32
tests:
  data_logger.tdf.exfat:
    platform_allow:
      - native_sim
    integration_platforms:
      - native_sim
```

## tests/subsys/definitions_extend/testcase.yaml
```yaml
common:
  tags:
    - definitions
    - data_logger
    - epacket
    - gnss
    - imu
    - kv_store
    - rpc
    - states
    - task_runner
    - tdf
tests:
  subsys.definitions_extend:
    platform_allow:
      - mps2/an385
    integration_platforms:
      - mps2/an385
    required_snippets:
      - infuse
    min_flash: 64
    min_ram: 32
```

## tests/subsys/dfu/exfat/testcase.yaml
```yaml
common:
  tags:
    - dfu
    - data_logger
    - kv_store
    - version
  min_flash: 64
  min_ram: 32
tests:
  dfu.exfat:
    platform_allow:
      - native_sim
    integration_platforms:
      - native_sim
```

## tests/subsys/epacket/common/testcase.yaml
```yaml
common:
  tags:
    - epacket
    - kv_store
    - reboot
    - rpc
    - security
    - states
    - tdf
    - time
    - watchdog
  min_flash: 64
  min_ram: 32
tests:
  epacket.common:
    integration_platforms:
      - native_sim
      - mps2/an385
```

## tests/subsys/epacket/interfaces/dummy/testcase.yaml
```yaml
common:
  tags:
    - epacket
    - reboot
    - rpc
    - security
    - states
    - watchdog
  min_flash: 64
  min_ram: 32
tests:
  epacket.interface.dummy:
    integration_platforms:
      - native_sim
      - qemu_cortex_m3
```

## tests/subsys/epacket/interfaces/serial/testcase.yaml
```yaml
common:
  tags:
    - epacket
    - kv_store
    - reboot
    - rpc
    - security
    - states
    - tdf
    - time
    - watchdog
  min_flash: 64
  min_ram: 32
tests:
  epacket.interface.serial:
    platform_allow:
      - native_sim
      - mps2/an385
    integration_platforms:
      - native_sim
      - mps2/an385
```

## tests/subsys/epacket/interfaces/udp_ack/testcase.yaml
```yaml
common:
  tags:
    - epacket
    - kv_store
    - net
    - reboot
    - rpc
    - security
    - states
    - tdf
    - time
    - watchdog
  min_flash: 64
  min_ram: 32
  run_sequential: true
tests:
  epacket.interface.udp.ack:
    tags: external_service
    platform_allow:
      - native_sim
    integration_platforms:
      - native_sim
    extra_args:
      - OVERLAY_CONFIG="overlay-nsos.conf"
```

## tests/subsys/epacket/interfaces/udp_crypt/testcase.yaml
```yaml
common:
  tags:
    - epacket
    - kv_store
    - reboot
    - rpc
    - security
    - states
    - tdf
    - time
    - watchdog
  min_flash: 64
  min_ram: 32
tests:
  epacket.interface.udp_crypt:
    platform_allow:
      - native_sim
      - mps2/an385
    integration_platforms:
      - native_sim
      - mps2/an385
  epacket.interface.udp_crypt.network_auth:
    platform_allow:
      - native_sim
    integration_platforms:
      - native_sim
    extra_configs:
      - CONFIG_EPACKET_INTERFACE_UDP_DEVICE_AUTH_PREFERRED=n
```
