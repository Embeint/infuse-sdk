## CMakeLists.txt
```
# SPDX-License-Identifier: Apache-2.0

cmake_minimum_required(VERSION 3.20.0)
find_package(Zephyr REQUIRED HINTS $ENV{ZEPHYR_BASE})
project(infuse_dns)

target_sources(app PRIVATE
  src/main.c
)
```

## prj.conf
```kconfig
CONFIG_ZTEST=y
CONFIG_TEST_RANDOM_GENERATOR=y
CONFIG_NETWORKING=y
CONFIG_INFUSE_SDK_NETWORKING=y
CONFIG_NET_IPV6=y
CONFIG_SNTP=n
CONFIG_SNTP_AUTO=n

CONFIG_NET_LOG=y
```

## overlay-nsos.conf
```kconfig
CONFIG_ETH_NATIVE_TAP=n
CONFIG_NET_DRIVERS=y
CONFIG_NET_SOCKETS=y
CONFIG_NET_SOCKETS_OFFLOAD=y
CONFIG_NET_NATIVE_OFFLOADED_SOCKETS=y

CONFIG_NATIVE_SIM_SLOWDOWN_TO_REAL_TIME=y
CONFIG_SYS_CLOCK_TICKS_PER_SEC=1000
```

## src/main.c
```c
/**
 * @file
 * @copyright 2024 Embeint Holdings Pty Ltd
 * @author Jordan Yates <jordan@embeint.com>
 *
 * SPDX-License-Identifier: FSL-1.1-ALv2
 */

#include <time.h>

#include <zephyr/ztest.h>
#include <zephyr/net/net_if.h>
#include <zephyr/net/conn_mgr_monitor.h>
#include <zephyr/net/conn_mgr_connectivity.h>
#include <zephyr/net/socket_offload.h>

#include <infuse/fs/kv_store.h>
#include <infuse/fs/kv_types.h>
#include <infuse/net/dns.h>

#ifdef CONFIG_WIFI
#define IF_DELAY K_SECONDS(20)
#else
#define IF_DELAY K_SECONDS(5)
#endif

#define GOOGLE_HOSTNAME  "google.com."
#define INVALID_HOSTNAME "does-not-exist.invalid."

K_SEM_DEFINE(l4_up, 0, 1);

static void l4_event_handler(uint64_t mgmt_event, struct net_if *iface, void *info,
			     size_t info_length, void *user_data)
{
	ARG_UNUSED(iface);
	ARG_UNUSED(info);
	ARG_UNUSED(info_length);
	ARG_UNUSED(user_data);

	if (mgmt_event == NET_EVENT_L4_CONNECTED) {
		k_sem_give(&l4_up);
	}
}

/* Statically registered so that connectivity gained during boot is not missed */
NET_MGMT_REGISTER_EVENT_HANDLER(l4_events, NET_EVENT_L4_CONNECTED, l4_event_handler, NULL);

ZTEST(infuse_dns, test_dns_query)
{
	struct net_sockaddr address;
	net_socklen_t address_len;

	/* IPv4 lookups */
	zassert_equal(0, infuse_sync_dns(GOOGLE_HOSTNAME, 80, AF_INET, SOCK_STREAM, &address,
					 &address_len));
	zassert_equal(sizeof(struct net_sockaddr_in), address_len);

	zassert_not_equal(0, infuse_sync_dns(INVALID_HOSTNAME, 80, AF_INET, SOCK_STREAM, &address,
					     &address_len));

	/* Not working on WiFi network, not sure how to validate at runtime if this should work */
#if defined(CONFIG_NET_IPV6) && !defined(CONFIG_WIFI)
	/* IPv6 lookups */
	zassert_equal(0, infuse_sync_dns(GOOGLE_HOSTNAME, 80, AF_INET6, SOCK_STREAM, &address,
					 &address_len));
	zassert_equal(sizeof(struct net_sockaddr_in6), address_len);

	zassert_not_equal(0, infuse_sync_dns(INVALID_HOSTNAME, 80, AF_INET6, SOCK_STREAM, &address,
					     &address_len));
#endif /* defined(CONFIG_NET_IPV6) && !defined(CONFIG_WIFI) */
}

#ifdef CONFIG_INFUSE_DNS_ASYNC

static K_SEM_DEFINE(async_success, 0, 1);
static K_SEM_DEFINE(async_complete, 0, 1);
static K_SEM_DEFINE(async_failure, 0, 1);

static void async_dns_cb(int result, struct net_sockaddr *addr, net_socklen_t addrlen,
			 struct infuse_async_dns_context *cb_ctx)
{
	net_socklen_t *address_len;

	zassert_not_null(cb_ctx);

	address_len = cb_ctx->user_data;
	if (result == INFUSE_ASYNC_DNS_RESULT) {
		/* Completion event has not occurred (Previous results may have been provided) */
		zassert_equal(-EBUSY, k_sem_take(&async_complete, K_NO_WAIT));
		/* Address is provided */
		zassert_not_null(addr);
		zassert_not_equal(0, addrlen);
		/* Store/notify result */
		*address_len = addrlen;
		k_sem_give(&async_success);
	} else if (result == INFUSE_ASYNC_DNS_COMPLETE) {
		zassert_is_null(addr);
		zassert_equal(0, addrlen);
		k_sem_give(&async_complete);
	} else {
		zassert_is_null(addr);
		zassert_equal(0, addrlen);
		k_sem_give(&async_failure);
	}
}

ZTEST(infuse_dns, test_dns_query_async)
{
	net_socklen_t address_len;
	struct infuse_async_dns_context cb_ctx = {
		.cb = async_dns_cb,
		.user_data = &address_len,
	};

	/* Invalid address families */
	zassert_equal(-EINVAL, infuse_async_dns(GOOGLE_HOSTNAME, AF_UNSPEC, &cb_ctx, 2000));
	zassert_equal(-EINVAL, infuse_async_dns(GOOGLE_HOSTNAME, AF_PACKET, &cb_ctx, 2000));
	zassert_equal(-EINVAL, infuse_async_dns(GOOGLE_HOSTNAME, AF_CAN, &cb_ctx, 2000));
	zassert_equal(-EINVAL, infuse_async_dns(GOOGLE_HOSTNAME, AF_NET_MGMT, &cb_ctx, 2000));
	zassert_equal(-EINVAL, infuse_async_dns(GOOGLE_HOSTNAME, AF_LOCAL, &cb_ctx, 2000));
	zassert_equal(-EINVAL, infuse_async_dns(GOOGLE_HOSTNAME, AF_UNIX, &cb_ctx, 2000));

	/* IPv4 lookups */
	zassert_equal(0, infuse_async_dns(GOOGLE_HOSTNAME, AF_INET, &cb_ctx, 2000));
	zassert_equal(0, k_sem_take(&async_success, K_SECONDS(2)));
	zassert_equal(0, k_sem_take(&async_complete, K_MSEC(100)));
	zassert_equal(-EBUSY, k_sem_take(&async_failure, K_NO_WAIT));
	zassert_equal(sizeof(struct net_sockaddr_in), address_len);

	zassert_equal(0, infuse_async_dns(INVALID_HOSTNAME, AF_INET, &cb_ctx, 2000));
	zassert_equal(0, k_sem_take(&async_failure, K_SECONDS(2)));
	zassert_equal(-EBUSY, k_sem_take(&async_success, K_NO_WAIT));
	zassert_equal(-EBUSY, k_sem_take(&async_complete, K_NO_WAIT));

	/* Not working on WiFi network, not sure how to validate at runtime if this should work */
#if defined(CONFIG_NET_IPV6) && !defined(CONFIG_WIFI)
	/* IPv6 lookups */
	zassert_equal(0, infuse_async_dns(GOOGLE_HOSTNAME, AF_INET6, &cb_ctx, 2000));
	zassert_equal(0, k_sem_take(&async_success, K_SECONDS(2)));
	zassert_equal(0, k_sem_take(&async_complete, K_MSEC(100)));
	zassert_equal(-EBUSY, k_sem_take(&async_failure, K_NO_WAIT));
	zassert_equal(sizeof(struct net_sockaddr_in6), address_len);

	zassert_equal(0, infuse_async_dns(INVALID_HOSTNAME, AF_INET6, &cb_ctx, 2000));
	zassert_equal(0, k_sem_take(&async_failure, K_SECONDS(2)));
	zassert_equal(-EBUSY, k_sem_take(&async_success, K_NO_WAIT));
	zassert_equal(-EBUSY, k_sem_take(&async_complete, K_NO_WAIT));
#endif /* defined(CONFIG_NET_IPV6) && !defined(CONFIG_WIFI) */
}

#else

ZTEST(infuse_dns, test_dns_query_async)
{
	ztest_test_skip();
}

#endif /* CONFIG_INFUSE_DNS_ASYNC */

void *test_init(void)
{
#ifdef CONFIG_WIFI
	KV_STRING_CONST(ssid, CONFIG_WIFI_SSID);
	KV_STRING_CONST(psk, CONFIG_WIFI_PSK);

	kv_store_write(KV_KEY_WIFI_SSID, &ssid, sizeof(ssid));
	kv_store_write(KV_KEY_WIFI_PSK, &psk, sizeof(psk));
#endif /* CONFIG_WIFI */

#ifdef CONFIG_NET_NATIVE_OFFLOADED_SOCKETS
	/* Resolve through the Zephyr DNS resolver (and therefore `CONFIG_DNS_SERVER1`) instead of
	 * the host `getaddrinfo`, so that queries can be directed at the local test server.
	 */
	socket_offload_dns_enable(false);

	/* Bring the interface up to trigger NET_EVENT_L4_CONNECTED */
	net_if_up(net_if_get_default());
#else
	/* Turn on all interfaces */
	conn_mgr_all_if_up(true);
	conn_mgr_all_if_connect(true);
#endif /* CONFIG_NET_NATIVE_OFFLOADED_SOCKETS */

	/* Wait for the interface to come up before running any tests */
	zassert_equal(0, k_sem_take(&l4_up, IF_DELAY), "Timed out waiting for L4 connectivity");

	return NULL;
}

ZTEST_SUITE(infuse_dns, NULL, test_init, NULL, NULL, NULL);
```
