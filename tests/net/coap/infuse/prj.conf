## CMakeLists.txt
```
# SPDX-License-Identifier: Apache-2.0

set(EXTRA_CONF_FILE "../../../infuse_security.conf")

cmake_minimum_required(VERSION 3.20.0)
find_package(Zephyr REQUIRED HINTS $ENV{ZEPHYR_BASE})
project(coap_general)

target_sources(app PRIVATE
  src/main.c
)
```

## Kconfig
```
# Build as SDK application on real hardware
configdefault INFUSE_SDK
	default y if SOC_FAMILY_NORDIC_NRF

configdefault INFUSE_REBOOT
	default y if SOC_FAMILY_NORDIC_NRF

config TEST_COAP_SERVER
	string "CoAP server to download test resources from"
	default "coap.dev.infuse-iot.com"

config TEST_COAP_SERVER_PORT
	int "CoAP server DTLS port"
	default 5684

config WIFI_SSID
	string "WiFi SSID"
	depends on WIFI
	default "TechnoCore"

config WIFI_PSK
	string "WiFi PSK"
	depends on WIFI
	default "tachyonfatline"

if !NRF_MODEM_LIB
configdefault TLS_CREDENTIALS
	default y
configdefault MBEDTLS_KEY_EXCHANGE_PSK_ENABLED
	default y
configdefault NET_SOCKETS_SOCKOPT_TLS
	default y
configdefault NET_SOCKETS_ENABLE_DTLS
	default y
# Required PSA algorithms
configdefault PSA_WANT_ALG_TLS12_PSK_TO_MS
	default y
configdefault PSA_WANT_ALG_TLS12_PRF
	default y
endif

source "Kconfig.zephyr"
```

## prj.conf
```kconfig
CONFIG_ZTEST=y
CONFIG_ZTEST_STACK_SIZE=4096
CONFIG_TEST_RANDOM_GENERATOR=y
CONFIG_NETWORKING=y
CONFIG_INFUSE_SDK_NETWORKING=y
CONFIG_NET_IPV6=y
CONFIG_SNTP=n
CONFIG_SNTP_AUTO=n

# Drop received packets to exercise the retry logic
CONFIG_INFUSE_COAP_TEST_PACKET_DROP_BITMASK=16389
```

## src/main.c
```c
/**
 * @file
 * @copyright 2024 Embeint Holdings Pty Ltd
 * @author Jordan Yates <jordan@embeint.com>
 *
 * SPDX-License-Identifier: FSL-1.1-ALv2
 */

#include <time.h>

#include <zephyr/ztest.h>
#include <zephyr/net/net_if.h>
#include <zephyr/net/conn_mgr_monitor.h>
#include <zephyr/net/conn_mgr_connectivity.h>
#include <zephyr/net/tls_credentials.h>
#include <zephyr/net/socket.h>

#include <infuse/identifiers.h>
#include <infuse/fs/kv_store.h>
#include <infuse/fs/kv_types.h>
#include <infuse/net/coap.h>
#include <infuse/net/dns.h>
#include <infuse/security.h>

#ifdef CONFIG_WIFI
#define IF_DELAY K_SECONDS(20)
#else
#define IF_DELAY K_SECONDS(5)
#endif

K_SEM_DEFINE(l4_up, 0, 1);

const char *const coap_test_server = CONFIG_TEST_COAP_SERVER;

/* Hardcoded authentication that only has access to test files */
const uint8_t test_identity[8] = {0xfd, 0xff, 0xff, 0xff, 0xff, 0xff, 0xff, 0xff};
const uint8_t test_psk[32] = {0xfd, 0xff, 0xff, 0xff, 0xff, 0xff, 0xff, 0xff, 0xff, 0xff, 0xff,
			      0xff, 0xff, 0xff, 0xff, 0xff, 0xff, 0xff, 0xff, 0xff, 0xff, 0xff,
			      0xff, 0xff, 0xff, 0xff, 0xff, 0xff, 0xff, 0xff, 0xff, 0xff};
uint8_t work_area[4096];

struct cb_ctx {
	const char *expected_data;
	uint32_t expected_offset;
	uint32_t cb_count;
};

static void l4_event_handler(uint64_t mgmt_event, struct net_if *iface, void *info,
			     size_t info_length, void *user_data)
{
	ARG_UNUSED(iface);
	ARG_UNUSED(info);
	ARG_UNUSED(info_length);
	ARG_UNUSED(user_data);

	if (mgmt_event == NET_EVENT_L4_CONNECTED) {
		k_sem_give(&l4_up);
	}
}

/* Statically registered so that connectivity gained during boot is not missed */
NET_MGMT_REGISTER_EVENT_HANDLER(l4_events, NET_EVENT_L4_CONNECTED, l4_event_handler, NULL);

static int data_cb(uint32_t offset, const uint8_t *data, uint16_t data_len, void *context)
{
	struct cb_ctx *ctx = context;

	zassert_equal(ctx->expected_offset, offset);
	if (ctx->expected_data) {
		zassert_mem_equal(ctx->expected_data + offset, data, data_len);
	}
	ctx->expected_offset += data_len;
	ctx->cb_count += 1;

	return 0;
}

static int socket_setup(void)
{
	const sec_tag_t sec_tls_tags[] = {
		infuse_security_coap_dtls_tag(),
	};
	struct net_sockaddr address;
	net_socklen_t address_len;
	int sock;
	int rc;

	/* IPv4 lookup */
	zassert_equal(0, infuse_sync_dns(coap_test_server, CONFIG_TEST_COAP_SERVER_PORT, AF_INET,
					 SOCK_DGRAM, &address, &address_len));

	/* Create socket */
	sock = zsock_socket(address.sa_family, SOCK_DGRAM, IPPROTO_DTLS_1_2);
	zassert_true(sock >= 0);

	/* Assign DTLS security tags */
	zassert_equal(0, zsock_setsockopt(sock, SOL_TLS, TLS_SEC_TAG_LIST, sec_tls_tags,
					  sizeof(sec_tls_tags)));

	/* Complete DTLS handshake */
	rc = zsock_connect(sock, &address, address_len);
	if (rc != 0) {
		zsock_close(sock);
	}
	zassert_equal(0, rc);
	return sock;
}

ZTEST(infuse_coap, test_bad_params)
{
	int sock = 0, rc;

	/* No data callback handler */
	rc = infuse_coap_download(sock, "test", 0, NULL, NULL, work_area, sizeof(work_area), 0,
				  1000);
	zassert_equal(-EINVAL, rc);

	/* Path with too many components */
	rc = infuse_coap_download(sock, "a/b/c/d/e/f/g/h/i/g", 0, data_cb, NULL, work_area,
				  sizeof(work_area), 0, 1000);
	zassert_equal(-EINVAL, rc);

	/* Path that is way too long for a 128 byte work area */
	const char *long_uri =
		"this_path_is_way_too_long_and_should_trigger_the_append_resource_path_error "
		"this_path_is_way_too_long_and_should_trigger_the_append_resource_path_error";

	rc = infuse_coap_download(sock, long_uri, 0, data_cb, NULL, work_area, 128, 0, 1000);
	zassert_equal(-EINVAL, rc);
}

ZTEST(infuse_coap, test_invalid_work_area)
{
	struct cb_ctx context;
	int sock = 0, rc;

	rc = infuse_coap_download(sock, "file/small_file", 0, data_cb, &context, work_area, 32, 0,
				  1000);
	zassert_equal(-ENOMEM, rc);
}

ZTEST(infuse_coap, test_bad_socket)
{
	struct cb_ctx context;
	int sock = -1, rc;

	/* Download from bad socket */
	rc = infuse_coap_download(sock, "file/small_file", 0, data_cb, &context, work_area,
				  sizeof(work_area), 0, 1000);
	zassert_equal(-EBADF, rc);
}

ZTEST(infuse_coap, test_timeout)
{
	struct cb_ctx context;
	int sock;
	int rc;

	/* Open socket */
	sock = socket_setup();

	/* Request a packet with a timeout that can't be met */
	context.expected_data = NULL;
	context.expected_offset = 0;
	rc = infuse_coap_download(sock, "file/med_file", 0, data_cb, &context, work_area,
				  sizeof(work_area), 0, 1);
	zassert_equal(-ETIMEDOUT, rc);

	/* Request another resource, "world" response should be discarded due to token mismatch */
	context.expected_data = "hello_world\n";
	context.expected_offset = 0;
	rc = infuse_coap_download(sock, "file/small_file", 0, data_cb, &context, work_area,
				  sizeof(work_area), 0, 1000);

	/* Close socket */
	zassert_equal(0, zsock_close(sock));
}

static int socket_to_close;

void async_socket_close(struct k_work *work)
{
	(void)zsock_close(socket_to_close);
}

ZTEST(infuse_coap, test_socket_close)
{
	struct k_work_delayable work;
	struct cb_ctx context;
	int sock;
	int rc;

	k_work_init_delayable(&work, async_socket_close);

	/* Open socket */
	sock = socket_setup();

	/* Schedule socket to be closed in 10ms */
	socket_to_close = sock;
	k_work_reschedule(&work, K_MSEC(10));

	/* Send a request with the knowledge the socket will close */
	context.expected_data = "hello_world\n";
	context.expected_offset = 0;
	rc = infuse_coap_download(sock, "file/small_file", 0, data_cb, &context, work_area,
				  sizeof(work_area), 0, 1000);
	zassert_equal(-EBADF, rc);
}

ZTEST(infuse_coap, test_download)
{
	struct cb_ctx context;
	int sock;
	int rc;

	/* Open socket */
	sock = socket_setup();

	/* Short retrieval: file/small_file -> hello_world\n */
	context.expected_data = "hello_world\n";
	context.expected_offset = 0;
	context.cb_count = 0;
	rc = infuse_coap_download(sock, "file/small_file", 0, data_cb, &context, work_area, 128, 0,
				  1000);
	zassert_equal(strlen(context.expected_data), rc);
	zassert_equal(1, context.cb_count);

	/* Medium retrieval: file/med_file -> 10030 bytes == 10 packets at 1024 block size */
	context.expected_data = NULL;
	context.expected_offset = 0;
	context.cb_count = 0;
	rc = infuse_coap_download(sock, "file/med_file", 0, data_cb, &context, work_area,
				  sizeof(work_area), 1024, 1000);
	zassert_equal(10030, rc);
	zassert_equal(10, context.cb_count);

	/* Medium retrieval with known size: file/med_file */
	context.expected_data = NULL;
	context.expected_offset = 0;
	context.cb_count = 0;
	rc = infuse_coap_download(sock, "file/med_file", 10030, data_cb, &context, work_area,
				  sizeof(work_area), 1024, 1000);
	zassert_equal(10030, rc);
	zassert_equal(10, context.cb_count);

	/* Medium retrieval: file/med_file -> 10030 bytes == 20 packets at 512 block size */
	context.expected_data = NULL;
	context.expected_offset = 0;
	context.cb_count = 0;
	rc = infuse_coap_download(sock, "file/med_file", 0, data_cb, &context, work_area,
				  sizeof(work_area), 512, 1000);
	zassert_equal(10030, rc);
	zassert_equal(20, context.cb_count);

	/* Medium retrieval: file/med_file -> 10030 bytes == 40 packets at 256 block size */
	context.expected_data = NULL;
	context.expected_offset = 0;
	context.cb_count = 0;
	rc = infuse_coap_download(sock, "file/med_file", 0, data_cb, &context, work_area,
				  sizeof(work_area), 256, 1000);
	zassert_equal(10030, rc);
	zassert_equal(40, context.cb_count);

	/* Close socket */
	zassert_equal(0, zsock_close(sock));
}

static int early_term_cb(uint32_t offset, const uint8_t *data, uint16_t data_len, void *context)
{
	return -ECHILD;
}

ZTEST(infuse_coap, test_download_early_terminate)
{
	struct cb_ctx context;
	int sock;
	int rc;

	/* Open socket */
	sock = socket_setup();

	/* Attempt to download, error should match that from callback */
	rc = infuse_coap_download(sock, "file/med_file", 0, early_term_cb, &context, work_area,
				  sizeof(work_area), 0, 1000);
	zassert_equal(-ECHILD, rc);

	/* Close socket */
	zassert_equal(0, zsock_close(sock));
}

void *test_init(void)
{
#ifndef CONFIG_INFUSE_COMMON_BOOT
	infuse_security_init();
#endif

#ifdef CONFIG_WIFI
	KV_STRING_CONST(ssid, CONFIG_WIFI_SSID);
	KV_STRING_CONST(psk, CONFIG_WIFI_PSK);

	kv_store_write(KV_KEY_WIFI_SSID, &ssid, sizeof(ssid));
	kv_store_write(KV_KEY_WIFI_PSK, &psk, sizeof(psk));
#endif /* CONFIG_WIFI */

#ifdef CONFIG_NET_NATIVE_OFFLOADED_SOCKETS
	/* Bring the interface up to trigger NET_EVENT_L4_CONNECTED */
	net_if_up(net_if_get_default());
#else
	/* Turn on all interfaces */
	conn_mgr_all_if_up(true);
	conn_mgr_all_if_connect(true);
#endif /* CONFIG_NET_NATIVE_OFFLOADED_SOCKETS */

	/* Wait for the interface to come up before running any tests */
	zassert_equal(0, k_sem_take(&l4_up, IF_DELAY), "Timed out waiting for L4 connectivity");

	return NULL;
}

ZTEST_SUITE(infuse_coap, NULL, test_init, NULL, NULL, NULL);
```
