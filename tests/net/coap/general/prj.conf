## CMakeLists.txt
```
# SPDX-License-Identifier: Apache-2.0

cmake_minimum_required(VERSION 3.20.0)
find_package(Zephyr REQUIRED HINTS $ENV{ZEPHYR_BASE})
project(coap_general)

target_sources(app PRIVATE
  src/main.c
)
```

## Kconfig
```
# Build as SDK application on real hardware
configdefault INFUSE_SDK
	default y if SOC_FAMILY_NORDIC_NRF

config TEST_COAP_SERVER
	string "CoAP server to run tests against"
	default "coap.me"
	help
	  Server providing the resources of the public coap.me test server.

config TEST_COAP_SERVER_PORT
	int "CoAP server UDP port"
	default 5683

config WIFI_SSID
	string "WiFi SSID"
	depends on WIFI
	default "test_ssid"

config WIFI_PSK
	string "WiFi PSK"
	depends on WIFI
	default "test_psk"

source "Kconfig.zephyr"
```

## prj.conf
```kconfig
CONFIG_ZTEST=y
CONFIG_TEST_RANDOM_GENERATOR=y
CONFIG_NETWORKING=y
CONFIG_INFUSE_SDK_NETWORKING=y
CONFIG_NET_IPV6=y

# Drop received packets to exercise the retry logic
CONFIG_INFUSE_COAP_TEST_PACKET_DROP_BITMASK=16389
```

## overlay-nsos.conf
```kconfig
CONFIG_ETH_NATIVE_TAP=n
CONFIG_NET_DRIVERS=y
CONFIG_NET_SOCKETS=y
CONFIG_NET_SOCKETS_OFFLOAD=y
CONFIG_NET_NATIVE_OFFLOADED_SOCKETS=y
# Tests bring the interface up when they are ready for connectivity
CONFIG_NET_NATIVE_OFFLOADED_SOCKETS_NO_AUTO_START=y
CONFIG_NET_IPV4_MTU=1500

CONFIG_NATIVE_SIM_SLOWDOWN_TO_REAL_TIME=y
CONFIG_SYS_CLOCK_TICKS_PER_SEC=1000
```

## src/main.c
```c
/**
 * @file
 * @copyright 2024 Embeint Holdings Pty Ltd
 * @author Jordan Yates <jordan@embeint.com>
 *
 * SPDX-License-Identifier: FSL-1.1-ALv2
 */

#include <time.h>

#include <zephyr/ztest.h>
#include <zephyr/net/net_if.h>
#include <zephyr/net/conn_mgr_monitor.h>
#include <zephyr/net/conn_mgr_connectivity.h>
#include <zephyr/net/socket.h>

#include <infuse/net/coap.h>
#include <infuse/net/dns.h>
#include <infuse/fs/kv_store.h>
#include <infuse/fs/kv_types.h>

#ifdef CONFIG_WIFI
#define IF_DELAY K_SECONDS(20)
#else
#define IF_DELAY K_SECONDS(5)
#endif

K_SEM_DEFINE(l4_up, 0, 1);

/* Server providing the resources of the coap.me test server run by TZI */
const char *const coap_test_server = CONFIG_TEST_COAP_SERVER;
uint8_t work_area[4096];
/* Content of the "large" resources */
uint8_t large_data[1700];

struct cb_ctx {
	const char *expected_data;
	uint32_t expected_offset;
	uint32_t cb_count;
};

static void l4_event_handler(uint64_t mgmt_event, struct net_if *iface, void *info,
			     size_t info_length, void *user_data)
{
	ARG_UNUSED(iface);
	ARG_UNUSED(info);
	ARG_UNUSED(info_length);
	ARG_UNUSED(user_data);

	if (mgmt_event == NET_EVENT_L4_CONNECTED) {
		k_sem_give(&l4_up);
	}
}

/* Statically registered so that connectivity gained during boot is not missed */
NET_MGMT_REGISTER_EVENT_HANDLER(l4_events, NET_EVENT_L4_CONNECTED, l4_event_handler, NULL);

int data_cb(uint32_t offset, const uint8_t *data, uint16_t data_len, void *context)
{
	struct cb_ctx *ctx = context;

	printk("%d: %d %d\n", ctx->cb_count, ctx->expected_offset, offset);

	zassert_equal(ctx->expected_offset, offset);
	if (ctx->expected_data) {
		zassert_mem_equal(ctx->expected_data + offset, data, data_len);
	}
	ctx->expected_offset += data_len;
	ctx->cb_count += 1;

	return 0;
}

static int socket_setup(void)
{
	struct net_sockaddr address;
	net_socklen_t address_len;
	int sock;

	/* IPv4 lookup */
	zassert_equal(0, infuse_sync_dns(coap_test_server, CONFIG_TEST_COAP_SERVER_PORT, AF_INET,
					 SOCK_STREAM, &address, &address_len));

	/* Create socket */
	sock = zsock_socket(address.sa_family, SOCK_DGRAM, IPPROTO_UDP);
	zassert_true(sock >= 0);
	zassert_equal(0, zsock_connect(sock, &address, address_len));

	return sock;
}

ZTEST(infuse_coap, test_resource_errors)
{
	struct cb_ctx context;
	int sock;
	int rc;

	/* Open socket */
	sock = socket_setup();

	/* 401 response: secret */
	context.expected_data = NULL;
	context.expected_offset = 0;
	rc = infuse_coap_download(sock, "secret", 0, data_cb, &context, work_area,
				  sizeof(work_area), 0, 1000);
	zassert_equal(-401, rc);

	/* 404 response: invalid-path */
	context.expected_data = NULL;
	context.expected_offset = 0;
	rc = infuse_coap_download(sock, "invalid-path", 0, data_cb, &context, work_area,
				  sizeof(work_area), 0, 1000);
	zassert_equal(-404, rc);

	/* 405 response: location-query */
	context.expected_data = NULL;
	context.expected_offset = 0;
	rc = infuse_coap_download(sock, "location-query", 0, data_cb, &context, work_area,
				  sizeof(work_area), 0, 1000);
	zassert_equal(-405, rc);

	/* Close socket */
	zassert_equal(0, zsock_close(sock));
}

ZTEST(infuse_coap, test_download)
{
	struct cb_ctx context;
	int sock;
	int rc;

	/* Open socket */
	sock = socket_setup();

	/* Short retrieval: hello -> world */
	context.expected_data = "world";
	context.expected_offset = 0;
	rc = infuse_coap_download(sock, "hello", 0, data_cb, &context, work_area, 128, 0, 1000);
	zassert_equal(strlen(context.expected_data), rc);

	/* Multi component URI: seg1/seg2/seg3 -> Matroshka */
	context.expected_data = "Matroshka";
	context.expected_offset = 0;
	rc = infuse_coap_download(sock, "seg1/seg2/seg3", 0, data_cb, &context, work_area, 200, 0,
				  1000);
	zassert_equal(strlen(context.expected_data), rc);

	/* Long retrieval: large -> 1700 bytes == 2 packets at 1024 block size */
	context.expected_data = NULL;
	context.expected_offset = 0;
	context.cb_count = 0;
	rc = infuse_coap_download(sock, "large", 0, data_cb, &context, work_area, sizeof(work_area),
				  0, 1000);
	zassert_equal(1700, rc);
	zassert_equal(2, context.cb_count);

	/* Long retrieval: large -> 1700 bytes == 4 packets at 512 block size */
	context.expected_data = NULL;
	context.expected_offset = 0;
	context.cb_count = 0;
	rc = infuse_coap_download(sock, "large", 0, data_cb, &context, work_area, 700, 0, 1000);
	zassert_equal(1700, rc);
	zassert_equal(4, context.cb_count);

	/* Long retrieval: large -> 1700 bytes == 4 packets at 256 block size */
	context.expected_data = NULL;
	context.expected_offset = 0;
	context.cb_count = 0;
	rc = infuse_coap_download(sock, "large", 0, data_cb, &context, work_area, 400, 0, 1000);
	zassert_equal(1700, rc);
	zassert_equal(7, context.cb_count);

	/* Close socket */
	zassert_equal(0, zsock_close(sock));
}

static int download(int sock, const char *resource, size_t file_size, const char *expected,
		    size_t work_size, uint16_t block_size, int timeout_ms, struct cb_ctx *context)
{
	context->expected_data = expected;
	context->expected_offset = 0;
	context->cb_count = 0;
	return infuse_coap_download(sock, resource, file_size, data_cb, context, work_area,
				    work_size, block_size, timeout_ms);
}

/* Resources below are only provided by the local test server (pytest/conftest.py) */

ZTEST(infuse_coap, test_download_work_area)
{
	const char *large = (const char *)large_data;
	struct cb_ctx context;
	int sock;
	int rc;

	sock = socket_setup();

	/* Smallest work area, 64 byte blocks */
	rc = download(sock, "large", 0, large, 128, 0, 1000, &context);
	zassert_equal(sizeof(large_data), rc);
	zassert_equal(27, context.cb_count);

	/* Small work area with explicit block size, out of order blocks are buffered */
	rc = download(sock, "large", 0, large, 1000, 256, 1000, &context);
	zassert_equal(sizeof(large_data), rc);
	zassert_equal(7, context.cb_count);

	/* Explicit block sizes must fit in the work area */
	rc = download(sock, "large", 0, large, 700, 1024, 1000, &context);
	zassert_equal(-ENOMEM, rc);
	zassert_equal(0, context.cb_count);
	rc = download(sock, "large", 0, large, 64 + 64 - 1, 64, 1000, &context);
	zassert_equal(-ENOMEM, rc);

	zassert_equal(0, zsock_close(sock));
}

ZTEST(infuse_coap, test_download_sizes)
{
	const char *large = (const char *)large_data;
	struct cb_ctx context;
	int sock;
	int rc;

	sock = socket_setup();

	/* Server reduces the block size to 512 bytes */
	rc = download(sock, "large/reduced", 0, large, sizeof(work_area), 1024, 1000, &context);
	zassert_equal(sizeof(large_data), rc);
	zassert_equal(4, context.cb_count);

	zassert_equal(0, zsock_close(sock));
}

ZTEST(infuse_coap, test_download_bad_responses)
{
	struct cb_ctx context;
	int sock;
	int rc;

	sock = socket_setup();

	/* Server responds with a different block to the one requested */
	rc = download(sock, "large/wrong_block", 0, NULL, sizeof(work_area), 0, 1000, &context);
	zassert_equal(-EBADMSG, rc);
	zassert_equal(0, context.cb_count);

	/* Token that doesn't match any request is ignored */
	rc = download(sock, "hello/short_token", 0, NULL, sizeof(work_area), 0, 100, &context);
	zassert_equal(-ETIMEDOUT, rc);
	zassert_equal(0, context.cb_count);

	/* 8 byte token, longer than the parallel backend uses */
	rc = download(sock, "hello/long_token", 0, "world", sizeof(work_area), 0, 100, &context);
	if (IS_ENABLED(CONFIG_INFUSE_COAP_BACKEND_SERIAL)) {
		/* Serial backend uses 8 byte tokens */
		zassert_equal(5, rc);
	} else {
		zassert_equal(-ETIMEDOUT, rc);
		zassert_equal(0, context.cb_count);
	}

	zassert_equal(0, zsock_close(sock));
}

ZTEST(infuse_coap, test_separate_response)
{
	uint8_t work_area[256];
	struct cb_ctx context;
	int sock;
	int rc;

	/* Open socket */
	sock = socket_setup();

	/* Server responds with ACK immediately, then data after ~5 seconds */
	context.expected_data = "That took a long time";
	context.expected_offset = 0;
	rc = infuse_coap_download(sock, "separate", 0, data_cb, &context, work_area,
				  sizeof(work_area), 0, 7000);
	zassert_equal(strlen(context.expected_data), rc);

	/* Close socket */
	zassert_equal(0, zsock_close(sock));
}

void *test_init(void)
{
	for (int i = 0; i < sizeof(large_data); i++) {
		large_data[i] = (i * 31 + 7) & 0xFF;
	}

#ifdef CONFIG_WIFI
	KV_STRING_CONST(ssid, CONFIG_WIFI_SSID);
	KV_STRING_CONST(psk, CONFIG_WIFI_PSK);

	kv_store_write(KV_KEY_WIFI_SSID, &ssid, sizeof(ssid));
	kv_store_write(KV_KEY_WIFI_PSK, &psk, sizeof(psk));
#endif /* CONFIG_WIFI */

#ifdef CONFIG_NET_NATIVE_OFFLOADED_SOCKETS
	struct net_if *iface = net_if_get_default();
	struct in_addr addr;

	/* Add the IP address to trigger NET_EVENT_L4_CONNECTED */
	net_addr_pton(AF_INET, "192.0.2.1", &addr);
	net_if_ipv4_addr_add(iface, &addr, NET_ADDR_MANUAL, 0);
#else
	/* Turn on all interfaces */
	conn_mgr_all_if_up(true);
	conn_mgr_all_if_connect(true);
#endif /* CONFIG_NET_NATIVE_OFFLOADED_SOCKETS */

	/* Wait for the interface to come up before running any tests */
	zassert_equal(0, k_sem_take(&l4_up, IF_DELAY), "Timed out waiting for L4 connectivity");

	return NULL;
}

ZTEST_SUITE(infuse_coap, NULL, test_init, NULL, NULL, NULL);
```
