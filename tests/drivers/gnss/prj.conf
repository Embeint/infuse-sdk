## prj.conf
```kconfig
CONFIG_INFUSE_SDK=y
CONFIG_GNSS=y
```

## src/main.c
```c
/**
 * @file
 * @copyright 2024 Embeint Holdings Pty Ltd
 * @author Jordan Yates <jordan@embeint.com>
 *
 * SPDX-License-Identifier: FSL-1.1-ALv2
 */

int main(void)
{
	return 0;
}
```
