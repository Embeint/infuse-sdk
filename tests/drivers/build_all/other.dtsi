/*
 * Copyright (c) 2025, Embeint Pty Ltd.
 *
 * SPDX-License-Identifier: Apache-2.0
 *
 * Application overlay for other devices
 */

generic_sim_sensor: generic_sim_sensor {
	compatible = "zephyr,generic-sim-sensor";
	status = "okay";
};
