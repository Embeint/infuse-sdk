/*
 * Copyright (c) 2025, Embeint Pty Ltd.
 *
 * SPDX-License-Identifier: Apache-2.0
 */

/ {
	test_sensor: test_sensor {
		compatible = "zephyr,generic-sim-sensor";
		status = "okay";
	};

	fail_sensor: fail_sensor {
		compatible = "zephyr,generic-sim-sensor";
		status = "okay";
		negated-init-rc = <2>;
	};
};
