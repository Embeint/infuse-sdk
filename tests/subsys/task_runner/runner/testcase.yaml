## tests/subsys/task_runner/runner/testcase.yaml
```yaml
common:
  tags: task_runner
  min_flash: 64
  min_ram: 32
tests:
  task_runner.runner:
    integration_platforms:
      - native_sim
      - qemu_cortex_m3
```

## tests/subsys/task_runner/runner_kv/testcase.yaml
```yaml
common:
  tags: task_runner
  min_flash: 64
  min_ram: 32
tests:
  task_runner.runner_kv:
    required_snippets:
      - infuse
    integration_platforms:
      - mps2/an385
```

## tests/subsys/task_runner/tasks/alg_stationary_windowed/testcase.yaml
```yaml
common:
  tags: imu
  min_flash: 64
  min_ram: 32
tests:
  task_runner.tasks.alg_stationary.windowed:
    required_snippets:
      - infuse
    integration_platforms:
      - mps2/an385
```

## tests/subsys/task_runner/tasks/gnss_ubx_m8/testcase.yaml
```yaml
common:
  tags: gnss
  min_flash: 64
  min_ram: 32
tests:
  task_runner.tasks.gnss.ubx_m8:
    required_snippets:
      - infuse
    integration_platforms:
      - mps2/an385
```

## tests/subsys/task_runner/tasks/imu/testcase.yaml
```yaml
common:
  tags: imu
  min_flash: 64
  min_ram: 32
  required_snippets:
    - infuse
  integration_platforms:
    - mps2/an385
tests:
  task_runner.tasks.imu: {}
  task_runner.tasks.imu.idx_array:
    extra_configs:
      - CONFIG_TASK_RUNNER_TASK_IMU_LOG_IDX_ARRAY=y
```

## tests/subsys/task_runner/tasks/motion_id/testcase.yaml
```yaml
common:
  tags: data_logger tdf
  min_flash: 64
  min_ram: 32
tests:
  task_runner.tasks.task_motion_id:
    required_snippets:
      - infuse
    integration_platforms:
      - mps2/an385
```

## tests/subsys/tdf/testcase.yaml
```yaml
common:
  tags: tdf
  min_flash: 64
  min_ram: 32
tests:
  tdf.gen:
    integration_platforms:
      - native_sim
      - qemu_cortex_m3
  tdf.gen.diff:
    integration_platforms:
      - native_sim
      - qemu_cortex_m3
    extra_configs:
      - CONFIG_TDF_DIFF=y
```
