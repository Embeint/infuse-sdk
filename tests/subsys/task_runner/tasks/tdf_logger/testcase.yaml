## tests/subsys/task_runner/tasks/tdf_logger/testcase.yaml
```yaml
common:
  tags:
    - task_runner
    - data_logger
    - epacket
    - imu
    - kv_store
    - math
    - modem_monitor
    - rpc
    - states
    - tdf
    - time
    - version
    - watchdog
    - zbus
  min_flash: 64
  min_ram: 32
  required_snippets:
    - infuse
  integration_platforms:
    - mps2/an385
tests:
  task_runner.tasks.tdf_logger.complete: {}
  task_runner.tasks.tdf_logger.voltage:
    extra_configs:
      - CONFIG_TASK_TDF_LOGGER_BATTERY_TYPE_VOLTAGE=y
  task_runner.tasks.tdf_logger.soc:
    extra_configs:
      - CONFIG_TASK_TDF_LOGGER_BATTERY_TYPE_SOC=y
  task_runner.tasks.tdf_logger.battery_zero:
    extra_configs:
      - CONFIG_TASK_TDF_LOGGER_BATTERY_LOG_ZERO_ON_TIMEOUT=y
  task_runner.tasks.tdf_logger.storage:
    extra_dtc_overlay_files:
      - app.overlay
      - storage.overlay
```

## tests/subsys/task_runner/watchdog/testcase.yaml
```yaml
common:
  tags:
    - task_runner
    - kv_store
    - math
    - states
    - tdf
    - watchdog
  min_flash: 64
  min_ram: 32
tests:
  task_runner.watchdog:
    platform_allow:
      - mps2/an385
    integration_platforms:
      - mps2/an385
```

## west.yml
```yaml
# The west manifest file for the Infuse SDK.
#
# SPDX-License-Identifier: FSL-1.1-ALv2

manifest:
  defaults:
    remote: embeint

  remotes:
    - name: embeint
      url-base: https://github.com/embeint
    - name: memfault
      url-base: https://github.com/memfault
    - name: ncs
      url-base: https://github.com/nrfconnect

  projects:
    - name: zephyr
      revision: embeint-v4.5.0
      # Limit imported repositories to reduce clone time
      import:
        name-allowlist:
          - cmsis-dsp
          - cmsis_6
          - hal_nordic
          - hal_st
          - hal_stm32
          - hostap
          - libmetal
          - littlefs
          - lora-basics-modem
          - loramac-node
          - fatfs
          - mbedtls
          - open-amp
          - segger
          - nrf_wifi
          - tf-psa-crypto
          - tinycrypt
          - trusted-firmware-m
          - picolibc
          - zcbor
    - name: mcuboot
      revision: 846d77427aa373ed367d8e9785ef22f957edb399
      path: bootloader/mcuboot
    - name: sdk-nrf
      path: modules/nrfconnect/sdk-nrf
      revision: feature/preview_35
      import: true
    - name: memfault-firmware-sdk
      path: modules/lib/memfault
      revision: 1.44.0
      remote: memfault

  self:
    path: infuse-sdk
    west-commands: scripts/west-commands.yml
    import: submanifests
```
