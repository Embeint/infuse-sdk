## tests/subsys/mgmt/mcumgr/os_mgmt_mcumgr_params/testcase.yaml
```yaml
#
# Copyright (c) 2024 Embeint Holdings Pty Ltd
#
# SPDX-License-Identifier: FSL-1.1-ALv2
#
common:
  tags:
    - mcumgr
    - epacket
    - kv_store
    - reboot
    - rpc
    - security
    - states
    - tdf
    - time
tests:
  mgmt.mcumgr.infuse_os.mcumgr_params:
    required_snippets:
      - infuse
    integration_platforms:
      - mps2/an385
```

## tests/subsys/rpc/commands/annotate/testcase.yaml
```yaml
common:
  tags:
    - rpc
    - data_logger
    - epacket
    - kv_store
    - states
    - tdf
    - time
    - watchdog
  min_flash: 64
  min_ram: 32
tests:
  rpc.commands.annotate:
    required_snippets:
      - infuse
    platform_allow:
      - mps2/an385
    integration_platforms:
      - mps2/an385
```

## tests/subsys/rpc/commands/application_info/testcase.yaml
```yaml
common:
  tags:
    - rpc
    - data_logger
    - epacket
    - kv_store
    - security
    - states
    - tdf
    - watchdog
  min_flash: 64
  min_ram: 32
tests:
  rpc.commands.application_info:
    required_snippets:
      - infuse
    platform_allow:
      - mps2/an385
    integration_platforms:
      - mps2/an385
```

## tests/subsys/rpc/commands/audio_alert/testcase.yaml
```yaml
common:
  tags:
    - rpc
    - epacket
    - kv_store
    - security
    - states
    - tdf
    - watchdog
  platform_allow:
    - native_sim
  integration_platforms:
    - native_sim
  required_snippets:
    - infuse
tests:
  rpc.commands.audio_alert: {}
  rpc.commands.audio_alert.pm:
    extra_configs:
      - CONFIG_PM_DEVICE=y
      - CONFIG_PM_DEVICE_RUNTIME=y
```

## tests/subsys/rpc/commands/data_logger_shim/testcase.yaml
```yaml
common:
  tags:
    - rpc
    - data_logger
    - epacket
    - kv_store
    - states
    - tdf
    - watchdog
  min_flash: 64
  min_ram: 32
  required_snippets:
    - infuse
tests:
  rpc.commands.data_logger_shim:
    platform_allow:
      - native_sim
    integration_platforms:
      - native_sim
```

## tests/subsys/rpc/commands/fault/testcase.yaml
```yaml
common:
  tags:
    - rpc
    - common_boot
    - epacket
    - kv_store
    - reboot
    - states
    - tdf
    - watchdog
  arch_allow: arm
  min_flash: 64
  min_ram: 32
tests:
  rpc.commands.fault:
    ignore_faults: true
    expect_reboot: true
    platform_exclude:
      - native_sim
      - nrf52_bsim
    required_snippets:
      - infuse
    integration_platforms:
      - mps2/an385
```

## tests/subsys/rpc/commands/file_write/testcase.yaml
```yaml
common:
  tags:
    - rpc
    - bluetooth
    - cpatch
    - dfu
    - epacket
    - kv_store
    - littlefs
    - reboot
    - security
    - states
    - tdf
    - watchdog
  min_flash: 64
  min_ram: 32
tests:
  rpc.commands.file_write:
    platform_allow:
      - native_sim
    integration_platforms:
      - native_sim
```

## tests/subsys/rpc/commands/file_write_basic/testcase.yaml
```yaml
common:
  tags: infuse
  min_flash: 64
  min_ram: 32
tests:
  rpc.commands.file_write_basic:
    required_snippets:
      - infuse
    integration_platforms:
      - mps2/an385
  rpc.commands.file_write_basic.native:
    platform_allow:
      - native_sim
    integration_platforms:
      - native_sim
  rpc.commands.file_write_basic.native.littlefs:
    platform_allow:
      - native_sim
    integration_platforms:
      - native_sim
    extra_args:
      - DTC_OVERLAY_FILE="./littlefs.overlay;./app.overlay"
  rpc.commands.file_write_basic.native_large:
    platform_allow:
      - native_sim
    integration_platforms:
      - native_sim
    extra_args:
      - DTC_OVERLAY_FILE="./native_large_block.overlay;./app.overlay"
    extra_configs:
      - CONFIG_INFUSE_RPC_COMMON_FILE_ACTIONS_WRITE_BUFFER=1024
      - CONFIG_INFUSE_RPC_SERVER_WORKING_MEMORY=1024
  rpc.commands.file_write_basic.native.mcuboot_offset:
    platform_allow:
      - native_sim
    integration_platforms:
      - native_sim
    extra_args:
      - DTC_OVERLAY_FILE="./boards/native_sim.overlay;./mcuboot_offset.overlay"
    extra_configs:
      - CONFIG_BOOTLOADER_MCUBOOT=y
      - CONFIG_IMG_MANAGER=y
      - CONFIG_MCUBOOT_IMG_MANAGER=y
      - CONFIG_MCUBOOT_BOOTLOADER_MODE_SWAP_USING_OFFSET=y
  # FILE_WRITE should behave the same way as FILE_WRITE_BASIC
  # for the non-filesystem actions
  rpc.commands.file_write_basic.fw:
    required_snippets:
      - infuse
    integration_platforms:
      - mps2/an385
    extra_configs:
      - CONFIG_TEST_FILE_WRITE=y
  rpc.commands.file_write_basic.fw.native:
    platform_allow:
      - native_sim
    integration_platforms:
      - native_sim
    extra_configs:
      - CONFIG_TEST_FILE_WRITE=y
  rpc.commands.file_write_basic.fw.native.littlefs:
    platform_allow:
      - native_sim
    integration_platforms:
      - native_sim
    extra_args:
      - DTC_OVERLAY_FILE="./littlefs.overlay;./app.overlay"
    extra_configs:
      - CONFIG_TEST_FILE_WRITE=y
```

## tests/subsys/rpc/commands/filesystem/testcase.yaml
```yaml
common:
  tags:
    - rpc
    - epacket
    - kv_store
    - littlefs
    - states
    - tdf
    - watchdog
  min_flash: 64
  min_ram: 32
  required_snippets:
    - infuse
  platform_allow:
    - mps2/an385
  integration_platforms:
    - mps2/an385
tests:
  rpc.commands.filesystem: {}
```

## tests/subsys/rpc/commands/heap_stats/testcase.yaml
```yaml
common:
  tags:
    - rpc
    - epacket
    - kv_store
    - states
    - tdf
    - watchdog
  min_flash: 64
  min_ram: 32
tests:
  rpc.commands.heap_stats:
    required_snippets:
      - infuse
    platform_allow:
      - mps2/an385
    integration_platforms:
      - mps2/an385
```

## tests/subsys/rpc/commands/infuse_states_update/testcase.yaml
```yaml
common:
  tags:
    - rpc
    - epacket
    - kv_store
    - states
    - tdf
    - watchdog
  min_flash: 64
  min_ram: 32
tests:
  rpc.commands.infuse_states_update:
    required_snippets:
      - infuse
    integration_platforms:
      - mps2/an385
```

## tests/subsys/rpc/commands/kv_reflect_crcs/testcase.yaml
```yaml
common:
  tags:
    - rpc
    - common_boot
    - epacket
    - kv_store
    - states
    - tdf
    - watchdog
  min_flash: 64
  min_ram: 32
tests:
  rpc.commands.kv_reflect_crcs:
    required_snippets:
      - infuse
    integration_platforms:
      - mps2/an385
```

## tests/subsys/rpc/commands/kv_write/testcase.yaml
```yaml
common:
  tags:
    - rpc
    - common_boot
    - epacket
    - kv_store
    - security
    - states
    - tdf
    - watchdog
  min_flash: 64
  min_ram: 32
  required_snippets:
    - infuse
  integration_platforms:
    - mps2/an385
tests:
  rpc.commands.kv_write: {}
  rpc.commands.kv_write.user_validation:
    extra_configs:
      - CONFIG_INFUSE_RPC_OPTION_KV_WRITE_APP_VALIDATE=y
  rpc.commands.kv_write.reflect_limit:
    extra_configs:
      - CONFIG_KV_STORE_REFLECT_MAX_SIZE=48
```

## tests/subsys/rpc/commands/last_reboot/testcase.yaml
```yaml
common:
  tags:
    - rpc
    - common_boot
    - epacket
    - kv_store
    - reboot
    - security
    - states
    - tdf
    - time
    - watchdog
  min_flash: 64
  min_ram: 32
tests:
  rpc.commands.last_reboot:
    ignore_faults: true
    expect_reboot: true
    platform_exclude:
      - native_sim
      - nrf52_bsim
    required_snippets:
      - infuse
    integration_platforms:
      - mps2/an385
```

## tests/subsys/rpc/commands/mem_read/testcase.yaml
```yaml
common:
  tags:
    - rpc
    - epacket
    - kv_store
    - security
    - states
    - tdf
    - watchdog
  min_flash: 64
  min_ram: 32
tests:
  rpc.commands.mem_read:
    required_snippets:
      - infuse
    integration_platforms:
      - mps2/an385
```

## tests/subsys/rpc/commands/reboot/testcase.yaml
```yaml
common:
  tags:
    - rpc
    - common_boot
    - epacket
    - kv_store
    - reboot
    - security
    - states
    - tdf
    - watchdog
  min_flash: 64
  min_ram: 32
tests:
  rpc.commands.reboot:
    expect_reboot: true
    platform_exclude:
      - native_sim
      - nrf52_bsim
    required_snippets:
      - infuse
    integration_platforms:
      - mps2/an385
```

## tests/subsys/rpc/commands/security_public_keys/testcase.yaml
```yaml
common:
  tags:
    - rpc
    - common_boot
    - epacket
    - kv_store
    - security
    - states
    - tdf
    - watchdog
  min_flash: 64
  min_ram: 32
tests:
  rpc.commands.security_public_keys:
    required_snippets:
      - infuse
    integration_platforms:
      - mps2/an385
```

## tests/subsys/rpc/commands/time/testcase.yaml
```yaml
common:
  tags:
    - rpc
    - common_boot
    - epacket
    - kv_store
    - states
    - tdf
    - time
    - watchdog
  min_flash: 64
  min_ram: 32
tests:
  rpc.commands.time_get_set:
    required_snippets:
      - infuse
    integration_platforms:
      - mps2/an385
```

## tests/subsys/rpc/commands/zbus_channel_state/testcase.yaml
```yaml
common:
  tags:
    - rpc
    - epacket
    - kv_store
    - states
    - tdf
    - watchdog
    - zbus
  min_flash: 64
  min_ram: 32
tests:
  rpc.commands.zbus_channel_state:
    required_snippets:
      - infuse
    integration_platforms:
      - mps2/an385
```

## tests/subsys/rpc/watchdog/testcase.yaml
```yaml
common:
  tags:
    - rpc
    - epacket
    - task_runner
    - tdf
    - watchdog
  min_flash: 64
  min_ram: 32
tests:
  rpc.watchdog:
    platform_allow:
      - mps2/an385
    integration_platforms:
      - mps2/an385
```

## tests/subsys/task_runner/schedules/testcase.yaml
```yaml
common:
  tags:
    - task_runner
    - kv_store
    - math
    - states
    - tdf
    - watchdog
  min_flash: 64
  min_ram: 32
tests:
  task_runner.schedules:
    integration_platforms:
      - native_sim
      - qemu_cortex_m3
```

## tests/subsys/task_runner/schedules_kv/testcase.yaml
```yaml
common:
  tags:
    - task_runner
    - kv_store
    - math
    - states
    - tdf
    - watchdog
  min_flash: 64
  min_ram: 32
tests:
  task_runner.schedules.kv:
    platform_allow:
      - native_sim
      - mps2/an385
    integration_platforms:
      - native_sim
      - mps2/an385
```

## tests/subsys/task_runner/tasks/battery/testcase.yaml
```yaml
common:
  tags:
    - task_runner
    - data_logger
    - epacket
    - kv_store
    - math
    - rpc
    - states
    - tdf
    - time
    - watchdog
    - zbus
  min_flash: 64
  min_ram: 32
tests:
  task_runner.tasks.battery:
    required_snippets:
      - infuse
    platform_allow:
      - mps2/an385
    integration_platforms:
      - mps2/an385
```

## tests/subsys/task_runner/tasks/environmental/testcase.yaml
```yaml
common:
  tags:
    - task_runner
    - data_logger
    - epacket
    - kv_store
    - math
    - rpc
    - sensor
    - states
    - tdf
    - time
    - watchdog
    - zbus
  min_flash: 64
  min_ram: 32
  required_snippets:
    - infuse
  platform_allow:
    - mps2/an385
  integration_platforms:
    - mps2/an385

tests:
  task_runner.tasks.env: {}
  task_runner.tasks.env.pm:
    extra_configs:
      - CONFIG_PM_DEVICE=y
      - CONFIG_PM_DEVICE_RUNTIME=y
```

## tests/subsys/task_runner/tasks/soc_temperature/testcase.yaml
```yaml
common:
  tags:
    - task_runner
    - data_logger
    - epacket
    - kv_store
    - math
    - rpc
    - sensor
    - states
    - tdf
    - time
    - watchdog
    - zbus
  min_flash: 64
  min_ram: 32
  required_snippets:
    - infuse
  platform_allow:
    - mps2/an385
  integration_platforms:
    - mps2/an385

tests:
  task_runner.tasks.soc_temperature: {}
```
