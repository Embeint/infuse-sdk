## CMakeLists.txt
```
# SPDX-License-Identifier: Apache-2.0

cmake_minimum_required(VERSION 3.20.0)
find_package(Zephyr REQUIRED HINTS $ENV{ZEPHYR_BASE})
project(epacket_udp)

target_sources(app PRIVATE
  src/main.c
)
```

## Kconfig
```
config EPACKET_INTERFACE_UDP
	bool "Redefine for test"

source "Kconfig.zephyr"
```

## prj.conf
```kconfig
CONFIG_ZTEST=y
CONFIG_ENTROPY_GENERATOR=y
CONFIG_TEST_RANDOM_GENERATOR=y
CONFIG_NET_BUF=y
CONFIG_POLL=y
CONFIG_EPACKET=y
CONFIG_EPACKET_PAYLOAD_MAX=1200

CONFIG_INFUSE_CIVIL_TIME=y

CONFIG_MBEDTLS=y
CONFIG_MBEDTLS_ENABLE_HEAP=y
CONFIG_MBEDTLS_HEAP_SIZE=8192
CONFIG_MBEDTLS_ENTROPY_ENABLED=y
CONFIG_MBEDTLS_ZEPHYR_ENTROPY=y
CONFIG_MBEDTLS_PSA_CRYPTO_C=y
CONFIG_MBEDTLS_HKDF_C=y
CONFIG_MBEDTLS_CHACHAPOLY_AEAD_ENABLED=y
CONFIG_MBEDTLS_CIPHER_CHACHA20_ENABLED=y
CONFIG_MBEDTLS_MAC_POLY1305_ENABLED=y
```

## src/main.c
```c
/**
 * @file
 * @copyright 2024 Embeint Pty Ltd
 * @author Jordan Yates <jordan@embeint.com>
 *
 * SPDX-License-Identifier: LicenseRef-Embeint
 */

#include <string.h>

#include <zephyr/ztest.h>
#include <zephyr/kernel.h>
#include <zephyr/random/random.h>

#include <infuse/epacket/keys.h>
#include <infuse/epacket/packet.h>
#include <infuse/epacket/interface/epacket_udp.h>

#include "../subsys/epacket/interfaces/epacket_internal.h"

static K_FIFO_DEFINE(packet_queue);

uint64_t infuse_device_id(void)
{
	return 0x0123456789ABCDEF;
}

ZTEST(epacket_udp, test_sequence)
{
	struct net_buf *buf;
	uint16_t seqs[8];
	uint8_t *p;
	int rc;

	for (int i = 0; i < ARRAY_SIZE(seqs); i++) {
		/* Construct buffer */
		buf = epacket_alloc_tx(K_NO_WAIT);
		zassert_not_null(buf);
		net_buf_reserve(buf, EPACKET_UDP_FRAME_EXPECTED_SIZE);
		epacket_set_tx_metadata(buf, EPACKET_AUTH_DEVICE, 0, 0x10);
		p = net_buf_add(buf, 60);
		sys_rand_get(p, 60);

		/* Encrypt payload */
		rc = epacket_udp_encrypt(buf);
		zassert_equal(0, rc);

		/* Decrypt and free */
		rc = epacket_udp_decrypt(buf, &seqs[i]);
		zassert_equal(0, rc);
		net_buf_unref(buf);

		if (i > 0) {
			/* Sequence number should increase on each packet */
			zassert_equal(seqs[i - 1] + 1, seqs[i]);
		}
	}
}

ZTEST(epacket_udp, test_encrypt_decrypt)
{
	struct net_buf *orig_buf, *encr_buf, *copy_buf;
	uint16_t seq;
	uint8_t *p;
	int rc;

	/* Create original buffer */
	orig_buf = epacket_alloc_tx(K_NO_WAIT);
	zassert_not_null(orig_buf);
	net_buf_reserve(orig_buf, EPACKET_UDP_FRAME_EXPECTED_SIZE);
	epacket_set_tx_metadata(orig_buf, EPACKET_AUTH_DEVICE, 0, 0x10);
	p = net_buf_add(orig_buf, 60);
	sys_rand_get(p, 60);

	/* Encrypt original buffer */
	encr_buf = net_buf_clone(orig_buf, K_NO_WAIT);
	zassert_not_null(encr_buf);
	rc = epacket_udp_encrypt(encr_buf);
	zassert_equal(0, rc);
	zassert_equal(orig_buf->len + EPACKET_UDP_FRAME_EXPECTED_SIZE + 16, encr_buf->len);

	/* Decrypt unmodified packet */
	copy_buf = net_buf_clone(encr_buf, K_NO_WAIT);
	zassert_not_null(copy_buf);
	rc = epacket_udp_decrypt(copy_buf, &seq);
	zassert_equal(0, rc);
	zassert_equal(orig_buf->len, copy_buf->len);
	zassert_mem_equal(orig_buf->data, copy_buf->data, copy_buf->len);
	net_buf_unref(copy_buf);

	/* Test failure on modified encryption buffer */
	for (int i = 0; i < encr_buf->len; i++) {
		copy_buf = net_buf_clone(encr_buf, K_NO_WAIT);
		zassert_not_null(copy_buf);
		copy_buf->data[i]++;
		rc = epacket_udp_decrypt(copy_buf, &seq);
		zassert_equal(-1, rc);
		net_buf_unref(copy_buf);
	}
}

static bool psa_init(const void *global_state)
{
	zassert_equal(PSA_SUCCESS, psa_crypto_init());
	return true;
}

ZTEST_SUITE(epacket_udp, psa_init, NULL, NULL, NULL, NULL);
```
