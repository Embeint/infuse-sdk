## CMakeLists.txt
```
# SPDX-License-Identifier: Apache-2.0

cmake_minimum_required(VERSION 3.20.0)
find_package(Zephyr REQUIRED HINTS $ENV{ZEPHYR_BASE})
project(epacket_dummy)

target_sources(app PRIVATE
  src/main.c
)
```

## prj.conf
```kconfig
CONFIG_ZTEST=y
CONFIG_NET_BUF=y
CONFIG_NET_BUF_POOL_USAGE=y
CONFIG_POLL=y
CONFIG_EPACKET=y
CONFIG_EPACKET_INTERFACE_DUMMY=y
CONFIG_EPACKET_PACKET_SIZE_MAX=1200
```

## app.overlay
```dts
/ {
    epacket_dummy: epacket_dummy {
        compatible = "embeint,epacket-dummy";
    };
};
```

## src/main.c
```c
/**
 * @file
 * @copyright 2024 Embeint Holdings Pty Ltd
 * @author Jordan Yates <jordan@embeint.com>
 *
 * SPDX-License-Identifier: FSL-1.1-ALv2
 */

#include <string.h>

#include <zephyr/ztest.h>
#include <zephyr/kernel.h>
#include <zephyr/random/random.h>

#include <infuse/epacket/packet.h>
#include <infuse/epacket/interface/epacket_dummy.h>

#include "../subsys/epacket/interfaces/epacket_internal.h"

ZTEST(epacket_dummy, test_bad_payloads)
{
	const struct device *epacket_dummy = DEVICE_DT_GET(DT_NODELABEL(epacket_dummy));
	struct k_fifo *tx_fifo = epacket_dummmy_transmit_fifo_get();
	uint8_t bad_magic_byte = EPACKET_KEY_ID_REQ_MAGIC + 1;
	struct epacket_dummy_frame hdr = {0};

	zassert_not_null(tx_fifo);

	epacket_dummy_receive(epacket_dummy, &hdr, &bad_magic_byte, sizeof(bad_magic_byte));
	zassert_is_null(k_fifo_get(tx_fifo, K_MSEC(100)));
}

ZTEST(epacket_dummy, test_send_queue)
{
	const struct device *epacket_dummy = DEVICE_DT_GET(DT_NODELABEL(epacket_dummy));
	struct k_fifo *sent_queue = epacket_dummmy_transmit_fifo_get();
	struct epacket_rx_metadata *rx_meta;
	struct net_buf *tx, *sent, *rx;
	uint8_t payload[16];
	int rc;

	zassert_not_null(sent_queue);
	zassert_is_null(k_fifo_get(sent_queue, K_NO_WAIT));

	/* Allocate buffer */
	tx = epacket_alloc_tx_for_interface(epacket_dummy, K_NO_WAIT);
	zassert_not_null(tx);
	epacket_set_tx_metadata_core(tx, EPACKET_AUTH_DEVICE, 0x765431, 0x1234, 0x20,
				     EPACKET_ADDR_ALL);
	net_buf_add_mem(tx, payload, sizeof(payload));

	/* Send buffer on interface */
	epacket_queue(epacket_dummy, tx);

	/* Validate we can pick it up again */
	sent = k_fifo_get(sent_queue, K_MSEC(1));
	zassert_not_null(sent);
	zassert_equal(sent->len, sizeof(struct epacket_dummy_frame) + sizeof(payload));

	/* Copy message contents across to RX buffer */
	rx = epacket_alloc_rx(K_NO_WAIT);
	zassert_not_null(rx);
	net_buf_add_mem(rx, sent->data, sent->len);
	net_buf_unref(sent);

	/* Decrypt and validate against original packet */
	rc = epacket_dummy_decrypt(rx);
	zassert_equal(0, rc);
	rx_meta = net_buf_user_data(rx);
	zassert_equal(EPACKET_AUTH_DEVICE, rx_meta->auth);
	zassert_equal(0x20, rx_meta->type);
	zassert_equal(0x1234, rx_meta->flags);
	zassert_equal(0, rx_meta->sequence);
	zassert_equal(0x765431, rx_meta->key_identifier);
	net_buf_unref(rx);

	zassert_is_null(k_fifo_get(sent_queue, K_NO_WAIT));
}

ZTEST(epacket_dummy, test_rx_semaphore)
{
	const struct device *epacket_dummy = DEVICE_DT_GET(DT_NODELABEL(epacket_dummy));
	struct k_sem *epacket_rx_started = epacket_dummy_rx_started_sem_get();

	(void)k_sem_take(epacket_rx_started, K_NO_WAIT);

	epacket_receive(epacket_dummy, K_FOREVER);
	zassert_equal(0, k_sem_take(epacket_rx_started, K_NO_WAIT));
	zassert_equal(-EBUSY, k_sem_take(epacket_rx_started, K_NO_WAIT));
	epacket_receive(epacket_dummy, K_NO_WAIT);
	zassert_equal(-EBUSY, k_sem_take(epacket_rx_started, K_NO_WAIT));
	epacket_receive(epacket_dummy, K_SECONDS(1));
	zassert_equal(0, k_sem_take(epacket_rx_started, K_NO_WAIT));
	zassert_equal(-EAGAIN, k_sem_take(epacket_rx_started, K_SECONDS(2)));
}

static uint32_t expected_timestamp;
static K_SEM_DEFINE(packet_received, 0, 1);

static void rx_gps_test_handler(struct net_buf *rx)
{
	struct epacket_rx_metadata *meta = net_buf_user_data(rx);

	zassert_equal(expected_timestamp, meta->packet_gps_time);
	net_buf_unref(rx);
	k_sem_give(&packet_received);
}

ZTEST(epacket_dummy, test_rx)
{
	const struct device *epacket_dummy = DEVICE_DT_GET(DT_NODELABEL(epacket_dummy));
	struct epacket_dummy_frame frame = {
		.type = INFUSE_TDF,
		.auth = EPACKET_AUTH_NETWORK,
	};
	uint8_t tdf = 0;

	epacket_set_receive_handler(epacket_dummy, rx_gps_test_handler);
	expected_timestamp = 1234567;
	epacket_dummy_set_gps_timestamp(expected_timestamp);

	epacket_dummy_receive(epacket_dummy, &frame, &tdf, 1);
	zassert_equal(0, k_sem_take(&packet_received, K_SECONDS(1)));
}

ZTEST(epacket_dummy, test_packet_size)
{
	const struct device *epacket_dummy = DEVICE_DT_GET(DT_NODELABEL(epacket_dummy));
	struct net_buf *tx;

	/* Default sizes */
	tx = epacket_alloc_tx_for_interface(epacket_dummy, K_NO_WAIT);
	zassert_equal(tx->size, CONFIG_EPACKET_PACKET_SIZE_MAX);
	net_buf_unref(tx);

	/* Override sizes */
	epacket_dummy_set_max_packet(100);
	tx = epacket_alloc_tx_for_interface(epacket_dummy, K_NO_WAIT);
	zassert_equal(tx->size, 100);
	net_buf_unref(tx);

	/* Reset to default */
	epacket_dummy_set_max_packet(UINT16_MAX);
	tx = epacket_alloc_tx_for_interface(epacket_dummy, K_NO_WAIT);
	zassert_equal(tx->size, CONFIG_EPACKET_PACKET_SIZE_MAX);
	net_buf_unref(tx);
}

ZTEST_SUITE(epacket_dummy, NULL, NULL, NULL, NULL, NULL);
```
