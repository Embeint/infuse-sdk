## CMakeLists.txt
```
# SPDX-License-Identifier: Apache-2.0

cmake_minimum_required(VERSION 3.20.0)
find_package(Zephyr REQUIRED HINTS $ENV{ZEPHYR_BASE})
project(algorithms_runner_packaged)

set(INFUSE_SDK_BASE ${CMAKE_CURRENT_LIST_DIR}/../../../../..)
set(algorithm_base_dir "${PROJECT_BINARY_DIR}/llext")

include(${INFUSE_SDK_BASE}/subsys/algorithms/packager/algorithm_build.cmake)
foreach(algorithm_name test_algorithm test_algorithm_2 test_algorithm_invalid_version)
  algorithm_generate_targets(${algorithm_name}
    SOURCES ${CMAKE_CURRENT_LIST_DIR}/${algorithm_name}/main.c
    OUTPUT_BASE ${algorithm_base_dir}
  )

  # Only build and embed the algorithms here. Installing them in LittleFS is an
  # explicit runtime operation performed by the test helpers.
  algorithm_target_name(${algorithm_name} algorithm_target)
  algorithm_target_dir(${algorithm_base_dir} algorithm_dir)
  algorithm_target_inc(${algorithm_name} ${algorithm_base_dir} algorithm_inc_file)
  add_dependencies(app ${algorithm_target})
  set_property(SOURCE src/test_algorithm.c APPEND PROPERTY OBJECT_DEPENDS ${algorithm_inc_file})
endforeach()
zephyr_include_directories(${algorithm_dir})

target_sources(app PRIVATE
  src/main.c
  src/test_algorithm.c
)
```

## Kconfig
```
# Test Kconfig overrides

configdefault MAIN_STACK_SIZE
	default 8192 if COVERAGE
	default 4096

source "Kconfig.zephyr"
```

## prj.conf
```kconfig
CONFIG_ZTEST=y

CONFIG_FLASH=y
CONFIG_FLASH_SIMULATOR=y
CONFIG_FLASH_SIMULATOR_UNALIGNED_READ=y
CONFIG_FLASH_MAP=y
CONFIG_CRC=y

CONFIG_INFUSE_ALGORITHMS=y
CONFIG_ALGORITHM_RUNNER_MAX_ALGORITHMS=2
CONFIG_ALGORITHM_RUNNER_LOG_LEVEL_DBG=y

CONFIG_ALGORITHM_PACKAGER=y
CONFIG_LLEXT=y

CONFIG_ZBUS=y
CONFIG_ZBUS_CHANNEL_ID=y
```

## src/main.c
```c
/*
 * Copyright (c) 2026 Embeint Holdings Pty Ltd
 *
 * SPDX-License-Identifier: Apache-2.0
 */

#include <errno.h>

#include <zephyr/llext/llext.h>
#include <zephyr/sys/crc.h>
#include <zephyr/ztest.h>

#include <infuse/work_q.h>
#include <infuse/algorithms/runner/runner.h>
#include <infuse/fs/littlefs.h>
#include <infuse/zbus/channels.h>

#include "test_algorithm.h"

INFUSE_ZBUS_CHAN_DEFINE(INFUSE_ZBUS_CHAN_AMBIENT_ENV);

static bool builtin_algorithm_initialised;
static struct k_work work_queue_blocker;
static K_SEM_DEFINE(work_queue_blocker_started, 0, 1);
static K_SEM_DEFINE(work_queue_blocker_release, 0, 1);

static void work_queue_blocker_fn(struct k_work *work)
{
	ARG_UNUSED(work);

	k_sem_give(&work_queue_blocker_started);
	k_sem_take(&work_queue_blocker_release, K_FOREVER);
}

static void builtin_algorithm_fn(const struct zbus_channel *chan,
				 const struct infuse_algorithm *algorithm, const void *args)
{
	ARG_UNUSED(algorithm);
	ARG_UNUSED(args);

	if (chan == NULL) {
		builtin_algorithm_initialised = true;
		return;
	}

	struct tdf_ambient_temp_pres_hum *environment = (void *)zbus_chan_const_msg(chan);

	/* The host expects +4, proving initialisation ran before the channel publish. */
	environment->temperature += builtin_algorithm_initialised ? 4 : 400;
	zbus_chan_finish(chan);
}

static const struct infuse_algorithm builtin_algorithm = {
	.algorithm_id = 0xABCDEF01,
	.algorithm_version = 1,
	.zbus_channel = INFUSE_ZBUS_CHAN_AMBIENT_ENV,
	.fn = builtin_algorithm_fn,
};

static const struct infuse_algorithm older_builtin_algorithm = {
	.algorithm_id = TEST_ALGORITHM_FILE_ID,
	.algorithm_version = 1,
	.zbus_channel = INFUSE_ZBUS_CHAN_AMBIENT_ENV,
	.fn = builtin_algorithm_fn,
};

static void newer_builtin_algorithm_fn(const struct zbus_channel *chan,
				       const struct infuse_algorithm *algorithm, const void *args)
{
	ARG_UNUSED(algorithm);
	ARG_UNUSED(args);

	if (chan == NULL) {
		return;
	}

	struct tdf_ambient_temp_pres_hum *environment = (void *)zbus_chan_const_msg(chan);

	environment->temperature += 8;
	zbus_chan_finish(chan);
}

static const struct infuse_algorithm newer_builtin_algorithm = {
	.algorithm_id = TEST_ALGORITHM_FILE_ID,
	.algorithm_version = 3,
	.zbus_channel = INFUSE_ZBUS_CHAN_AMBIENT_ENV,
	.fn = newer_builtin_algorithm_fn,
};

static void expect_environment_temperature_change(int32_t change)
{
	struct tdf_ambient_temp_pres_hum environment = {
		.temperature = 1234,
	};
	struct tdf_ambient_temp_pres_hum result;

	zassert_ok(zbus_chan_pub(INFUSE_ZBUS_CHAN_GET(INFUSE_ZBUS_CHAN_AMBIENT_ENV), &environment,
				 K_FOREVER));
	k_sleep(K_MSEC(100));
	zassert_ok(zbus_chan_read(INFUSE_ZBUS_CHAN_GET(INFUSE_ZBUS_CHAN_AMBIENT_ENV), &result,
				  K_MSEC(100)));
	zassert_equal(environment.temperature + change, result.temperature);
}

ZTEST(algorithm_littlefs, test_algorithm_install)
{
	struct infuse_littlefs_metadata metadata;
	const uint8_t *expected = test_algorithm_data();
	uint8_t buffer[64];
	size_t offset = 0;
	int rc;

	rc = infuse_littlefs_init();
	zassert_ok(rc);

	algorithm_runner_init();

	/* Building the application must not automatically install the algorithm. */
	rc = infuse_littlefs_file_size(INFUSE_LFS_FOLDER_ALGORITHMS, TEST_ALGORITHM_FILE_ID);
	zassert_equal(-ENOENT, rc);

	zassert_ok(test_algorithm_install());
	zassert_equal(test_algorithm_size(), infuse_littlefs_file_size(INFUSE_LFS_FOLDER_ALGORITHMS,
								       TEST_ALGORITHM_FILE_ID));
	zassert_ok(infuse_littlefs_file_metadata(INFUSE_LFS_FOLDER_ALGORITHMS,
						 TEST_ALGORITHM_FILE_ID, &metadata));
	zassert_equal(TEST_ALGORITHM_FILE_ID, metadata.identifier);
	zassert_equal(crc32_ieee(expected, test_algorithm_size()), metadata.crc);

	zassert_ok(infuse_littlefs_file_open(INFUSE_LFS_FOLDER_ALGORITHMS, TEST_ALGORITHM_FILE_ID));
	while (offset < test_algorithm_size()) {
		size_t read_size = MIN(sizeof(buffer), test_algorithm_size() - offset);

		rc = infuse_littlefs_file_read(buffer, read_size);
		zassert_equal(read_size, rc);
		zassert_mem_equal(expected + offset, buffer, read_size);
		offset += read_size;
	}
	zassert_ok(infuse_littlefs_file_close());
}

ZTEST(algorithm_littlefs, test_runner_llext_single)
{
	/* Write algorithm */
	zassert_ok(infuse_littlefs_init());
	algorithm_runner_init();
	zassert_ok(test_algorithm_install());

	/* The runner work queue loads and registers the algorithm. */
	k_sleep(K_MSEC(100));

	/* Publishing environmental data triggers the initialised algorithm. The +1 result also
	 * verifies the runner previously called it with chan == NULL.
	 */
	expect_environment_temperature_change(1);

	/* Deleting the file unloads the extension. */
	zassert_ok(
		infuse_littlefs_file_delete(INFUSE_LFS_FOLDER_ALGORITHMS, TEST_ALGORITHM_FILE_ID));
	k_sleep(K_MSEC(100));

	/* Publishing to the environment channel doesn't trigger anything */
	expect_environment_temperature_change(0);
}

ZTEST(algorithm_littlefs, test_runner_loads_existing_llext)
{
	/* Install the algorithm before the runner starts, as occurs after a reboot. */
	zassert_ok(infuse_littlefs_init());
	zassert_ok(test_algorithm_install());

	algorithm_runner_init();

	/* The runner work queue loads and registers the existing algorithm. */
	k_sleep(K_MSEC(100));
	expect_environment_temperature_change(1);
}

ZTEST(algorithm_littlefs, test_runner_rejects_unknown_struct_version)
{
	zassert_ok(infuse_littlefs_init());
	algorithm_runner_init();
	zassert_ok(test_algorithm_invalid_version_install());

	/* The loader rejects and unloads algorithms using an unknown descriptor version. */
	k_sleep(K_MSEC(100));
	zassert_is_null(llext_by_name("12344321"));
	expect_environment_temperature_change(0);
}

ZTEST(algorithm_littlefs, test_runner_retries_multiple_llext_loads_while_filesystem_busy)
{
	zassert_ok(infuse_littlefs_init());
	algorithm_runner_init();

	/* Hold the runner work queue so the algorithm file can be opened before loading starts. */
	k_work_init(&work_queue_blocker, work_queue_blocker_fn);
	zassert_true(infuse_work_submit(&work_queue_blocker) >= 0);
	zassert_ok(k_sem_take(&work_queue_blocker_started, K_SECONDS(1)));

	zassert_ok(test_algorithm_install());
	zassert_ok(test_algorithm_2_install());
	zassert_ok(infuse_littlefs_file_open(INFUSE_LFS_FOLDER_ALGORITHMS, TEST_ALGORITHM_FILE_ID));
	k_sem_give(&work_queue_blocker_release);

	/* Keep the filesystem busy across multiple retry intervals. */
	k_sleep(K_MSEC(250));
	zassert_ok(infuse_littlefs_file_close());
	k_sleep(K_MSEC(150));

	/* Both queued algorithms load after the filesystem becomes available. */
	expect_environment_temperature_change(3);
}

ZTEST(algorithm_littlefs, test_runner_llext_multiple)
{
	zassert_ok(infuse_littlefs_init());
	algorithm_runner_init();

	/* Install and load two independent algorithms. */
	zassert_ok(test_algorithm_install());
	k_sleep(K_MSEC(100));
	zassert_ok(test_algorithm_2_install());
	k_sleep(K_MSEC(100));

	/* Both algorithms are initialised and run for the same channel publish. */
	expect_environment_temperature_change(3);

	/* Removing the first algorithm leaves the second algorithm active. */
	zassert_ok(
		infuse_littlefs_file_delete(INFUSE_LFS_FOLDER_ALGORITHMS, TEST_ALGORITHM_FILE_ID));
	k_sleep(K_MSEC(100));
	expect_environment_temperature_change(2);

	/* Removing the second algorithm leaves no subscriber active. */
	zassert_ok(infuse_littlefs_file_delete(INFUSE_LFS_FOLDER_ALGORITHMS,
					       TEST_ALGORITHM_2_FILE_ID));
	k_sleep(K_MSEC(100));
	expect_environment_temperature_change(0);
}

ZTEST(algorithm_littlefs, test_runner_builtin_and_llext)
{
	zassert_ok(infuse_littlefs_init());
	algorithm_runner_init();

	/* Register one built-in algorithm and load one filesystem algorithm. */
	builtin_algorithm_initialised = false;
	zassert_ok(algorithm_runner_register(&builtin_algorithm));
	zassert_true(builtin_algorithm_initialised);
	zassert_ok(test_algorithm_install());
	k_sleep(K_MSEC(100));

	/* Both algorithm types run for the same channel publish. */
	expect_environment_temperature_change(5);

	/* Removing the extension leaves the built-in algorithm active. */
	zassert_ok(
		infuse_littlefs_file_delete(INFUSE_LFS_FOLDER_ALGORITHMS, TEST_ALGORITHM_FILE_ID));
	k_sleep(K_MSEC(100));
	expect_environment_temperature_change(4);

	/* The built-in algorithm can still be explicitly unregistered. */
	zassert_ok(algorithm_runner_unregister(&builtin_algorithm));
	expect_environment_temperature_change(0);
}

ZTEST(algorithm_littlefs, test_runner_llext_supersedes_builtin)
{
	zassert_ok(infuse_littlefs_init());
	algorithm_runner_init();

	/* The version 2 extension supersedes the version 1 built-in with the same ID. */
	builtin_algorithm_initialised = false;
	zassert_ok(algorithm_runner_register(&older_builtin_algorithm));
	zassert_ok(test_algorithm_install());
	k_sleep(K_MSEC(100));
	expect_environment_temperature_change(1);

	/* Removing the extension restores the older built-in implementation. */
	zassert_ok(
		infuse_littlefs_file_delete(INFUSE_LFS_FOLDER_ALGORITHMS, TEST_ALGORITHM_FILE_ID));
	k_sleep(K_MSEC(100));
	expect_environment_temperature_change(4);
}

ZTEST(algorithm_littlefs, test_runner_builtin_supersedes_llext)
{
	zassert_ok(infuse_littlefs_init());
	algorithm_runner_init();

	/* The version 3 built-in supersedes the version 2 extension with the same ID. */
	zassert_ok(algorithm_runner_register(&newer_builtin_algorithm));
	zassert_ok(test_algorithm_install());
	k_sleep(K_MSEC(100));
	expect_environment_temperature_change(8);

	/* Removing the older extension does not affect the built-in implementation. */
	zassert_ok(
		infuse_littlefs_file_delete(INFUSE_LFS_FOLDER_ALGORITHMS, TEST_ALGORITHM_FILE_ID));
	k_sleep(K_MSEC(100));
	expect_environment_temperature_change(8);
}

static void test_after(void *fixture)
{
	ARG_UNUSED(fixture);
	algorithm_runner_reset();
	infuse_littfs_format();
	infuse_littlefs_reset();
}

ZTEST_SUITE(algorithm_littlefs, NULL, NULL, NULL, test_after, NULL);
```

## src/test_algorithm.c
```c
/*
 * Copyright (c) 2026 Embeint Holdings Pty Ltd
 *
 * SPDX-License-Identifier: Apache-2.0
 */

#include <errno.h>

#include <zephyr/sys/crc.h>

#include <infuse/fs/littlefs.h>

#include "test_algorithm.h"

static const uint8_t test_algorithm[] __aligned(sizeof(void *)) = {
#include "test_algorithm.inc"
};

static const uint8_t test_algorithm_2[] __aligned(sizeof(void *)) = {
#include "test_algorithm_2.inc"
};

static const uint8_t test_algorithm_invalid_version[] __aligned(sizeof(void *)) = {
#include "test_algorithm_invalid_version.inc"
};

static int algorithm_install(uint32_t file, const uint8_t *algorithm, size_t algorithm_size)
{
	struct infuse_littlefs_metadata metadata = {
		.identifier = file,
		.crc = crc32_ieee(algorithm, algorithm_size),
	};
	int rc;

	rc = infuse_littlefs_file_create(INFUSE_LFS_FOLDER_ALGORITHMS, file, &metadata);
	if (rc < 0) {
		return rc;
	}

	rc = infuse_littlefs_file_write(algorithm, algorithm_size);
	if (rc != algorithm_size) {
		(void)infuse_littlefs_file_close();
		(void)infuse_littlefs_file_delete(INFUSE_LFS_FOLDER_ALGORITHMS, file);
		return rc < 0 ? rc : -EIO;
	}

	return infuse_littlefs_file_close();
}

int test_algorithm_install(void)
{
	return algorithm_install(TEST_ALGORITHM_FILE_ID, test_algorithm, sizeof(test_algorithm));
}

int test_algorithm_2_install(void)
{
	return algorithm_install(TEST_ALGORITHM_2_FILE_ID, test_algorithm_2,
				 sizeof(test_algorithm_2));
}

int test_algorithm_invalid_version_install(void)
{
	return algorithm_install(TEST_ALGORITHM_INVALID_VERSION_FILE_ID,
				 test_algorithm_invalid_version,
				 sizeof(test_algorithm_invalid_version));
}

const uint8_t *test_algorithm_data(void)
{
	return test_algorithm;
}

size_t test_algorithm_size(void)
{
	return sizeof(test_algorithm);
}
```

## src/test_algorithm.h
```c
/*
 * Copyright (c) 2026 Embeint Holdings Pty Ltd
 *
 * SPDX-License-Identifier: Apache-2.0
 */

#ifndef INFUSE_SDK_TESTS_SUBSYS_ALGORITHMS_RUNNER_PACKAGED_SRC_TEST_ALGORITHM_H_
#define INFUSE_SDK_TESTS_SUBSYS_ALGORITHMS_RUNNER_PACKAGED_SRC_TEST_ALGORITHM_H_

#include <stddef.h>
#include <stdint.h>

#define TEST_ALGORITHM_FILE_ID                 0x12349876
#define TEST_ALGORITHM_2_FILE_ID               0x87654321
#define TEST_ALGORITHM_INVALID_VERSION_FILE_ID 0x12344321

int test_algorithm_install(void);
int test_algorithm_2_install(void);
int test_algorithm_invalid_version_install(void);
const uint8_t *test_algorithm_data(void);
size_t test_algorithm_size(void);

#endif /* INFUSE_SDK_TESTS_SUBSYS_ALGORITHMS_RUNNER_PACKAGED_SRC_TEST_ALGORITHM_H_ */
```
