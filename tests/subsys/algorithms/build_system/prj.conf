## CMakeLists.txt
```
# SPDX-License-Identifier: Apache-2.0

cmake_minimum_required(VERSION 3.20.0)
find_package(Zephyr REQUIRED HINTS $ENV{ZEPHYR_BASE})
project(algorithm_build_system)

set(algorithm_src
  ${CMAKE_CURRENT_LIST_DIR}/test_algorithm/main.c
  ${CMAKE_CURRENT_LIST_DIR}/test_algorithm/additional_sources/helper.c
)
set(algorithm_inc
  ${CMAKE_CURRENT_LIST_DIR}/include
  ${CMAKE_CURRENT_LIST_DIR}/test_algorithm/additional_include
)

if(CONFIG_TEST_ALGORITHM_BUILD_LLEXT)
  # Setup algorithm build
  set(INFUSE_SDK_BASE ${CMAKE_CURRENT_LIST_DIR}/../../../..)
  include(${INFUSE_SDK_BASE}/subsys/algorithms/algorithm_build.cmake)
  set(algorithm_name test_algorithm)
  set(algorithm_base_dir "${PROJECT_BINARY_DIR}/llext")
  algorithm_generate_targets(${algorithm_name}
    SOURCES ${algorithm_src}
    INCLUDES ${algorithm_inc}
    OUTPUT_BASE ${algorithm_base_dir}
  )
  # Add algorithm as application dependency
  algorithm_target_name(${algorithm_name} algorithm_target)
  add_dependencies(app ${algorithm_target})
  # Add directory containing the raw hex of the algorithm to the include path
  algorithm_target_dir(${algorithm_base_dir} algorithm_dir)
  algorithm_target_inc(${algorithm_name} ${algorithm_base_dir} algorithm_inc_file)
  set_property(SOURCE src/main.c APPEND PROPERTY OBJECT_DEPENDS ${algorithm_inc_file})
  zephyr_include_directories(
    ${algorithm_dir}
  )
else()
  # Add the algorithm implementation directly
  set(algorithm_output ${algorithm_src})
  zephyr_include_directories(${algorithm_inc})
endif()

zephyr_include_directories(include)
target_sources(app PRIVATE
  src/main.c
  ${algorithm_output}
)
```

## Kconfig
```
# SPDX-License-Identifier: Apache-2.0

choice TEST_ALGORITHM_BUILD_TYPE
	prompt "How to build the algorithm"

config TEST_ALGORITHM_BUILD_LLEXT
	bool "Compile to llext file to load as elf"
	select ALGORITHM_LLEXT_BUILTIN

config TEST_ALGORITHM_BUILD_NATIVE
	bool "Compile to run natively"
	select ALGORITHM_LLEXT_NATIVE

endchoice

source "Kconfig.zephyr"
```

## prj.conf
```kconfig
CONFIG_ZTEST=y
CONFIG_ZTEST_STACK_SIZE=2048
CONFIG_INFUSE_ALGORITHMS=y
CONFIG_ALGORITHM_RUNNER=y
CONFIG_CBPRINTF_FP_SUPPORT=y

CONFIG_NET_BUF=y
CONFIG_NET_BUF_POOL_USAGE=y
CONFIG_EPACKET=y
CONFIG_EPACKET_INTERFACE_DUMMY=y
CONFIG_DATA_LOGGER=y
CONFIG_DATA_LOGGER_EPACKET=y
CONFIG_TDF=y
CONFIG_TDF_DATA_LOGGER=y
CONFIG_TDF_DATA_LOGGER_SERIAL_DUMMY_BACKEND=y

CONFIG_ZBUS=y
CONFIG_ZBUS_CHANNEL_ID=y

CONFIG_LLEXT=y
CONFIG_TEST_ALGORITHM_BUILD_LLEXT=y
```

## src/main.c
```c
/**
 * @file
 * @copyright 2024 Embeint Holdings Pty Ltd
 * @author Jordan Yates <jordan@embeint.com>
 *
 * SPDX-License-Identifier: FSL-1.1-ALv2
 */

#include <string.h>

#include <zephyr/ztest.h>
#include <zephyr/kernel.h>
#include <zephyr/llext/llext.h>
#include <zephyr/llext/buf_loader.h>

#include <infuse/algorithms/implementation.h>
#include <infuse/tdf/definitions.h>
#include <infuse/zbus/channels.h>

#include "algorithm_info.h"

INFUSE_ZBUS_CHAN_DEFINE(INFUSE_ZBUS_CHAN_BATTERY);

#ifdef CONFIG_TEST_ALGORITHM_BUILD_LLEXT
static const uint8_t test_algorithm[] __aligned(sizeof(void *)) = {
#include "test_algorithm.inc"
};
#endif /* CONFIG_TEST_ALGORITHM_BUILD_LLEXT */

ZTEST(algorithm_runner_llext, test_loading)
{
	const struct zbus_channel *chan = INFUSE_ZBUS_CHAN_GET(INFUSE_ZBUS_CHAN_BATTERY);
	const struct infuse_algorithm *algorithm;
	__maybe_unused int rc;

#ifdef CONFIG_TEST_ALGORITHM_BUILD_LLEXT
	struct llext_buf_loader buf_loader =
		LLEXT_BUF_LOADER(test_algorithm, sizeof(test_algorithm));
	struct llext_loader *loader = &buf_loader.loader;
	struct llext_load_param ldr_parm = LLEXT_LOAD_PARAM_DEFAULT;
	struct llext *ext;

	/* Load the ELF file */
	rc = llext_load(loader, "test_alg", &ext, &ldr_parm);
	zassert_equal(0, rc);

	/* Find the algorithm struct that we expect to be exported */
	algorithm = llext_find_sym(&ext->exp_tab, "algorithm_config");
	zassert_not_null(algorithm);
#endif /* CONFIG_TEST_ALGORITHM_BUILD_LLEXT */

#ifdef CONFIG_TEST_ALGORITHM_BUILD_NATIVE
	extern const struct infuse_algorithm test_algorithm;

	algorithm = &test_algorithm;
#endif /* CONFIG_TEST_ALGORITHM_BUILD_NATIVE */

	struct tdf_battery_state battery = {.voltage_mv = 3700, .current_ua = -100, .soc = 70};

	zbus_chan_pub(chan, &battery, K_FOREVER);

	/* Validate exported algorithm */
	zassert_equal(ALGORITHM_ID_EXPECTED, algorithm->algorithm_id);
	zassert_equal(ALGORITHM_ZBUS_EXPECTED, algorithm->zbus_channel);
	zassert_not_null(algorithm->fn);

	/* Initialise state */
	algorithm->fn(NULL, algorithm, NULL);

	/* Run the function a few times */
	zassert_equal(0, zbus_chan_claim(chan, K_NO_WAIT));
	algorithm->fn(chan, algorithm, NULL);
	zassert_equal(0, zbus_chan_claim(chan, K_NO_WAIT));
	algorithm->fn(chan, algorithm, NULL);
	zassert_equal(0, zbus_chan_claim(chan, K_NO_WAIT));
	algorithm->fn(chan, algorithm, NULL);

#ifdef CONFIG_TEST_ALGORITHM_BUILD_LLEXT
	/* Unload the ELF */
	rc = llext_unload(&ext);
	zassert_equal(0, rc);
#endif /* CONFIG_TEST_ALGORITHM_BUILD_LLEXT */
}

ZTEST_SUITE(algorithm_runner_llext, NULL, NULL, NULL, NULL, NULL);
```

## include/algorithm_info.h
```c
/**
 * @file
 * @brief
 * @copyright 2025 Embeint Holdings Pty Ltd
 * @author Jordan Yates <jordan@embeint.com>
 *
 * SPDX-License-Identifier: FSL-1.1-ALv2
 */

#ifndef INFUSE_SDK_TESTS_SUBSYS_ALGORITHM_RUNNER_LLEXT_INCLUDE_ALGORITHM_INFO_H_
#define INFUSE_SDK_TESTS_SUBSYS_ALGORITHM_RUNNER_LLEXT_INCLUDE_ALGORITHM_INFO_H_

#include <stdint.h>

#ifdef __cplusplus
extern "C" {
#endif

#define ALGORITHM_ID_EXPECTED       0x12349876
#define ALGORITHM_ZBUS_EXPECTED     0x432100AA
#define ALGORITHM_LOGGER_EXPECTED   0x04
#define ALGORITHM_TDF_MASK_EXPECTED 0x01
#define ALGORITHM_TDF_ID_EXPECTED   2

#ifdef __cplusplus
}
#endif

#endif /* INFUSE_SDK_TESTS_SUBSYS_ALGORITHM_RUNNER_LLEXT_INCLUDE_ALGORITHM_INFO_H_ */
```
