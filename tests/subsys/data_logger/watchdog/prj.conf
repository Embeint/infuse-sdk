## CMakeLists.txt
```
# SPDX-License-Identifier: Apache-2.0

cmake_minimum_required(VERSION 3.20.0)
find_package(Zephyr REQUIRED HINTS $ENV{ZEPHYR_BASE})
project(data_logger_watchdog)

target_sources(app PRIVATE
  src/main.c
)
```

## prj.conf
```kconfig
CONFIG_ZTEST=y
CONFIG_POLL=y
CONFIG_LOG=y
CONFIG_EPACKET=y
CONFIG_EPACKET_INTERFACE_DUMMY=y
CONFIG_DATA_LOGGER=y
CONFIG_DATA_LOGGER_EPACKET=y
CONFIG_DATA_LOGGER_OFFLOAD_WRITES=y
CONFIG_DATA_LOGGER_OFFLOAD_WATCHDOG=y
CONFIG_WATCHDOG=y
CONFIG_INFUSE_WATCHDOG=y
CONFIG_INFUSE_WATCHDOG_PERIOD_MS=2000
CONFIG_INFUSE_WATCHDOG_FEED_EARLY_MS=100
# QEMU watchdog only supports one channel
CONFIG_EPACKET_INFUSE_WATCHDOG=n
```

## app.overlay
```dts
/ {
	data_logger_epacket: data_logger_epacket {
		compatible = "embeint,data-logger-epacket", "embeint,data-logger";
		epacket = <&epacket_dummy>;
	};

	epacket_dummy: epacket_dummy {
		compatible = "embeint,epacket-dummy";
	};
};
```

## src/main.c
```c
/**
 * @file
 * @copyright 2024 Embeint Holdings Pty Ltd
 * @author Jordan Yates <jordan@embeint.com>
 *
 * SPDX-License-Identifier: FSL-1.1-ALv2
 */

#include <string.h>

#include <zephyr/ztest.h>
#include <zephyr/kernel.h>
#include <zephyr/random/random.h>

#include <infuse/drivers/watchdog.h>
#include <infuse/task_runner/runner.h>

K_SEM_DEFINE(watchdog_expired, 0, 1);

void infuse_watchdog_expired(const struct device *dev, int channel_id)
{
	k_sem_give(&watchdog_expired);
}

ZTEST(data_logger_watchdog, test_watchdog)
{
	extern const k_tid_t logger_commit_thread;
	int rc;

	/* Start the watchdog */
	zassert_equal(0, infuse_watchdog_start());

	/* Watchdog shouldn't expire under normal operation */
	rc = k_sem_take(&watchdog_expired, K_SECONDS(5));
	zassert_equal(-EAGAIN, rc, "Watchdog expired prematurely");

	/* Block the RPC server thread */
	k_thread_suspend(logger_commit_thread);

	/* Failing to call task_runner_iterate should result in a watchdog interrupt */
	rc = k_sem_take(&watchdog_expired, K_MSEC(CONFIG_INFUSE_WATCHDOG_PERIOD_MS + 100));
	zassert_equal(0, rc, "Watchdog did not expire");
}

void watchdog_teardown(void *fixture)
{
	/* Disable the watchdog to ensure we aren't rebooted */
	wdt_disable(INFUSE_WATCHDOG_DEV);
}

ZTEST_SUITE(data_logger_watchdog, NULL, NULL, NULL, NULL, watchdog_teardown);
```
