## tests/subsys/data_logger/backends/exfat_multi_file/testcase.yaml
```yaml
common:
  tags: data_logger
  min_flash: 64
  min_ram: 32
tests:
  data_logger.exfat_multi:
    platform_allow:
      - native_sim
    integration_platforms:
      - native_sim
  data_logger.exfat_multi.sd:
    build_only: true
    depends_on: arduino_spi
    extra_args:
      - SHIELD=sparkfun_microsd
    # Shield will fail to compile on any board with an existing SPI device
    # on the Arduino SPI bus. Limit testing to a board we know without this
    # problem.
    platform_allow:
      - nrf52840dk/nrf52840
    integration_platforms:
      - nrf52840dk/nrf52840
```

## tests/subsys/data_logger/backends/exfat_single_file/testcase.yaml
```yaml
common:
  tags: data_logger
  min_flash: 64
  min_ram: 32
tests:
  data_logger.exfat_single:
    platform_allow:
      - native_sim
    integration_platforms:
      - native_sim
```

## tests/subsys/data_logger/backends/flash_map/testcase.yaml
```yaml
common:
  tags: data_logger
  min_flash: 64
  min_ram: 32
tests:
  data_logger.flash_map:
    platform_allow:
      - mps2/an385
      - qemu_cortex_m3
    integration_platforms:
      - qemu_cortex_m3
  data_logger.flash_map.large:
    platform_allow:
      - qemu_cortex_m3
    integration_platforms:
      - qemu_cortex_m3
    extra_args:
      - DTC_OVERLAY_FILE="large.overlay"
```

## tests/subsys/data_logger/epacket/testcase.yaml
```yaml
common:
  tags: data_logger
  min_flash: 64
  min_ram: 32
tests:
  data_logger.epacket:
    platform_allow:
      - qemu_cortex_m3
```

## tests/subsys/data_logger/high_level/tdf_binary_gen/testcase.yaml
```yaml
common:
  tags: data_logger tdf
  min_flash: 64
  min_ram: 32
tests:
  data_logger.tdf.binary_gen:
    platform_allow:
      - native_sim
    integration_platforms:
      - native_sim
```

## tests/subsys/data_logger/high_level/tdf_epacket/testcase.yaml
```yaml
common:
  tags: data_logger tdf
  min_flash: 64
  min_ram: 32
tests:
  data_logger.tdf.epacket:
    platform_allow:
      - mps2/an385
      - qemu_cortex_m3
    integration_platforms:
      - qemu_cortex_m3
  data_logger.tdf.epacket_footer:
    extra_args: DTC_OVERLAY_FILE="./app.overlay;./footer.overlay"
    extra_configs:
      - CONFIG_EPACKET_PACKET_SIZE_MAX=74
    platform_allow:
      - mps2/an385
      - qemu_cortex_m3
    integration_platforms:
      - qemu_cortex_m3
```

## tests/subsys/data_logger/high_level/tdf_flash_map/testcase.yaml
```yaml
common:
  tags: data_logger tdf
  min_flash: 64
  min_ram: 32
tests:
  data_logger.tdf.flash_map:
    platform_allow:
      - mps2/an385
    integration_platforms:
      - mps2/an385
  data_logger.tdf.flash_map.remote:
    extra_args: DTC_OVERLAY_FILE="./app.overlay;./tdf_remote.overlay"
    platform_allow:
      - mps2/an385
    integration_platforms:
      - mps2/an385
```

## tests/subsys/data_logger/high_level/tdf_persistent/testcase.yaml
```yaml
common:
  tags: data_logger tdf
  min_flash: 64
  min_ram: 32
tests:
  data_logger.tdf.persistent:
    platform_allow:
      - mps2/an385
      - qemu_cortex_m3
    integration_platforms:
      - qemu_cortex_m3
```

## tests/subsys/data_logger/high_level/tdf_reboot_recover/testcase.yaml
```yaml
common:
  tags: data_logger tdf
  expect_reboot: true
  platform_exclude:
    - native_sim
    - nrf52_bsim
    - nrf9161dk/nrf9161/ns
    - nrf9151dk/nrf9151/ns
  min_flash: 64
  min_ram: 32
  run_sequential: true
tests:
  data_logger.tdf.reboot_recover:
    required_snippets:
      - infuse
    integration_platforms:
      - mps2/an385
  data_logger.tdf.reboot_recover.remote:
    extra_args: DTC_OVERLAY_FILE="./app.overlay;./tdf_remote.overlay"
    required_snippets:
      - infuse
    integration_platforms:
      - mps2/an385
```

## tests/subsys/data_logger/persistent/testcase.yaml
```yaml
common:
  tags: data_logger
  min_flash: 64
  min_ram: 32
tests:
  data_logger.persistent:
    platform_allow:
      - qemu_cortex_m3
    integration_platforms:
      - qemu_cortex_m3
```

## tests/subsys/data_logger/tdf/testcase.yaml
```yaml
common:
  tags: data_logger
  min_flash: 64
  min_ram: 32
tests:
  data_logger.tdf:
    platform_allow:
      - mps2_an385
      - qemu_cortex_m3
    integration_platforms:
      - qemu_cortex_m3
```

## tests/subsys/epacket/handlers/testcase.yaml
```yaml
common:
  tags: crypto epacket
  min_flash: 64
  min_ram: 32
  platform_allow:
    - native_sim
    - mps2/an385
  integration_platforms:
    - native_sim
    - mps2/an385
tests:
  epacket.handlers: {}
  epacket.handlers.receive_group:
    extra_configs:
      - CONFIG_EPACKET_RECEIVE_GROUPING=y
```

## tests/subsys/epacket/interfaces/udp/testcase.yaml
```yaml
common:
  tags: net epacket
  min_flash: 64
  min_ram: 32
tests:
  epacket.interface.udp:
    platform_allow:
      - native_sim
    integration_platforms:
      - native_sim
    extra_args:
      - OVERLAY_CONFIG="overlay-nsos.conf"
```

## tests/subsys/epacket/keys/testcase.yaml
```yaml
common:
  tags: crypto epacket
  min_flash: 64
  min_ram: 32
tests:
  epacket.keys:
    platform_allow:
      - native_sim
      - mps2/an385
    integration_platforms:
      - native_sim
      - mps2/an385
  epacket.keys.secondary_remote:
    platform_allow:
      - mps2/an385
    integration_platforms:
      - mps2/an385
    extra_configs:
      - CONFIG_INFUSE_SECURITY_SECONDARY_REMOTE_ENABLE=y
```

## tests/subsys/epacket/watchdog/testcase.yaml
```yaml
common:
  tags: epacket
  min_flash: 64
  min_ram: 32
  platform_allow:
    - mps2/an385
  integration_platforms:
    - mps2/an385
tests:
  epacket.watchdog: {}
  epacket.watchdog.split:
    extra_configs:
      - CONFIG_EPACKET_PROCESS_THREAD_SPLIT=y
      - CONFIG_INFUSE_WATCHDOG_SW_MULTICHANNEL=y
      - CONFIG_INFUSE_WATCHDOG_SOFTWARE_WARNING=y
      - CONFIG_INFUSE_WATCHDOG_SOFTWARE_WARNING_MS=50
```

## tests/subsys/kv_store/core/testcase.yaml
```yaml
common:
  tags: nvs
tests:
  fs.kv_store.core:
    platform_allow:
      - native_sim
      - qemu_cortex_m0
      - mps2/an385
    integration_platforms:
      - native_sim
      - mps2/an385
```

## tests/subsys/kv_store/testcase.yaml
```yaml
common:
  tags: nvs
tests:
  fs.kv_store:
    platform_allow:
      - native_sim
      - qemu_cortex_m0
      - mps2_an385
    integration_platforms:
      - native_sim
      - mps2_an385
```

## tests/subsys/kv_store/user/testcase.yaml
```yaml
common:
  tags: nvs
tests:
  fs.kv_store.user_keys:
    platform_allow:
      - native_sim
    integration_platforms:
      - native_sim
```

## tests/subsys/mgmt/mcumgr/os_mgmt_bootloader_info/testcase.yaml
```yaml
#
# Copyright (c) 2024 Embeint Inc
#
# SPDX-License-Identifier: Apache-2.0
#
tests:
  mgmt.mcumgr.infuse_os.bootloader_info:
    required_snippets:
      - infuse
    integration_platforms:
      - mps2/an385
```

## tests/subsys/mgmt/mcumgr/os_mgmt_datetime/testcase.yaml
```yaml
#
# Copyright (c) 2024 Embeint Inc
#
# SPDX-License-Identifier: FSL-1.1-ALv2
#
tests:
  mgmt.mcumgr.infuse_os.datetime:
    required_snippets:
      - infuse
    integration_platforms:
      - mps2/an385
```

## tests/subsys/mgmt/mcumgr/os_mgmt_reset/testcase.yaml
```yaml
#
# Copyright (c) 2024 Embeint Holdings Pty Ltd
#
# SPDX-License-Identifier: FSL-1.1-ALv2
#
common:
  expect_reboot: true
  platform_exclude:
    - native_sim
    - nrf52_bsim
  required_snippets:
    - infuse
  integration_platforms:
    - mps2/an385
tests:
  mgmt.mcumgr.infuse_os.reboot: {}
  mgmt.mcumgr.infuse_os.reboot.min_uptime:
    extra_configs:
      - CONFIG_MCUMGR_GRP_OS_INFUSE_RESET_MIN_UPTIME=5
```

## tests/subsys/rpc/client/testcase.yaml
```yaml
common:
  tags: rpc
  min_flash: 64
  min_ram: 32
tests:
  rpc.client:
    integration_platforms:
      - native_sim
      - mps2/an385
```

## tests/subsys/rpc/commands/kv_read/testcase.yaml
```yaml
common:
  tags: infuse
  min_flash: 64
  min_ram: 32
  filter: dt_chosen_enabled("infuse,kv-partition")
tests:
  rpc.commands.kv_read:
    required_snippets:
      - infuse
    integration_platforms:
      - mps2/an385
```

## tests/subsys/rpc/commands/security_key_update/testcase.yaml
```yaml
common:
  tags: infuse
  min_flash: 64
  min_ram: 32
tests:
  rpc.commands.security_key_update:
    required_snippets:
      - infuse
    platform_allow:
      - mps2/an385
    integration_platforms:
      - mps2/an385
```

## tests/subsys/secure_storage/testcase.yaml
```yaml
common:
  tags: nvs psa
  platform_allow:
    - native_sim
    - mps2/an385
  integration_platforms:
    - native_sim
    - mps2/an385
tests:
  fs.secure_storage.nvs:
    extra_configs:
      - CONFIG_NVS=y
      - CONFIG_ZMS=n
  fs.secure_storage.zms:
    extra_configs:
      - CONFIG_NVS=n
      - CONFIG_ZMS=y
```
