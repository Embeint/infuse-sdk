## tests/bsim/bluetooth/task_runner/testcase.yaml
```yaml
common:
  build_only: true
  required_snippets:
    - infuse
  tags:
    - bluetooth
  platform_allow:
    - nrf52_bsim/native
    - nrf54l15bsim/nrf54l15/cpuapp
    - nrf5340bsim/nrf5340/cpunet
  harness: bsim
tests:
  bluetooth.task_runner:
    harness_config:
      bsim_exe_name: tests_bsim_bluetooth_task_runner_prj_conf
  bluetooth.task_runner.sdc:
    harness_config:
      bsim_exe_name: tests_bsim_bluetooth_task_runner_sdc_prj_conf
    extra_args:
      - DTC_OVERLAY_FILE="./app.overlay;./nrf_sdc.overlay"
```

## tests/bsim/serial/epacket/testcase.yaml
```yaml
common:
  build_only: true
  required_snippets:
    - infuse
  tags:
    - bluetooth
  platform_allow:
    - nrf52_bsim/native
  harness: bsim
tests:
  serial.epacket:
    harness_config:
      bsim_exe_name: tests_bsim_serial_epacket_prj_device_conf
  serial.epacket.pm:
    harness_config:
      bsim_exe_name: tests_bsim_serial_epacket_prj_device_pm_conf
    extra_args:
      - EXTRA_CONF_FILE=prj_pm.conf
  serial.epacket.async:
    harness_config:
      bsim_exe_name: tests_bsim_serial_epacket_prj_device_async_conf
    extra_args:
      - EXTRA_CONF_FILE=prj_async.conf
  serial.epacket.async_pm:
    harness_config:
      bsim_exe_name: tests_bsim_serial_epacket_prj_device_async_pm_conf
    extra_args:
      - EXTRA_CONF_FILE=prj_async_pm.conf
  serial.epacket.int_single:
    harness_config:
      bsim_exe_name: tests_bsim_serial_epacket_prj_device_int_single_conf
    extra_args:
      - EXTRA_CONF_FILE=prj_int_single.conf
  serial.epacket.int_single_pm:
    harness_config:
      bsim_exe_name: tests_bsim_serial_epacket_prj_device_int_single_pm_conf
    extra_args:
      - EXTRA_CONF_FILE=prj_int_single_pm.conf
```

## tests/ci_mock/Kconfig
```kconfig
# This file exists purely to define symbols that may come from other modules (NCS, etc)
# and would otherwise be caught by the `check_compliance.py` Kconfig linting.
#
# DO NOT include this file in the main Kconfig tree

# Symbols used by SDK-NRF libraries but not defined upstream
config ZEPHYR_NRF_MODULE
	bool
config SOC_SERIES_NRF71X
	bool
config NORDIC_SECURITY_BACKEND
	bool
config UNITY
	bool
config FOTA_DOWNLOAD
	bool
config DATE_TIME
	bool
```

## tests/drivers/build_all/Kconfig
```kconfig
# Some drivers depend on HAS_I2C_RTIO
config HAS_I2C_RTIO
	default y

source "Kconfig.zephyr"
```

## tests/drivers/sensor/generic_sim/testcase.yaml
```yaml
sample:
  description: Generic simulated sensor
  name: Generic simulated sensor

tests:
  sensor.generic_sim:
    sysbuild: true
    integration_platforms:
      - native_sim
```

## tests/drivers/shared_device/spdt_switch/testcase.yaml
```yaml
common:
  tags: drivers
  min_flash: 64
  min_ram: 32
tests:
  drivers.shared_device.spdt_switch:
    platform_allow:
      - native_sim
    integration_platforms:
      - native_sim
  drivers.shared_device.spdt_switch.pm:
    platform_allow:
      - native_sim
    integration_platforms:
      - native_sim
    extra_configs:
      - CONFIG_PM_DEVICE=y
      - CONFIG_PM_DEVICE_RUNTIME=y
```

## tests/drivers/watchdog/testcase.yaml
```yaml
common:
  tags: drivers
  min_flash: 64
  min_ram: 32
tests:
  drivers.watchdog:
    platform_allow:
      - mps2_an385
    integration_platforms:
      - mps2_an385
```

## tests/lib/auto/kv_state_observer/testcase.yaml
```yaml
common:
  platform_allow:
    - native_sim
  integration_platforms:
    - native_sim
  tags: infuse
  min_flash: 64
  min_ram: 32
tests:
  libraries.auto.kv_state_observer.none: {}
  libraries.auto.kv_state_observer.led_disable:
    extra_configs:
      - CONFIG_KV_STORE_KEY_LED_DISABLE_DAILY_TIME_RANGE=y
  libraries.auto.kv_state_observer.app_active:
    extra_configs:
      - CONFIG_KV_STORE_KEY_APPLICATION_ACTIVE=y
  libraries.auto.kv_state_observer.all:
    extra_configs:
      - CONFIG_KV_STORE_KEY_LED_DISABLE_DAILY_TIME_RANGE=y
      - CONFIG_KV_STORE_KEY_APPLICATION_ACTIVE=y
```

## tests/lib/civil_time/testcase.yaml
```yaml
tests:
  libraries.civil_time:
    integration_platforms:
      - native_sim
      - qemu_cortex_m3
    tags: infuse
    min_flash: 64
    min_ram: 32
```

## tests/lib/common_boot/testcase.yaml
```yaml
common:
  tags: infuse
  min_flash: 64
  min_ram: 32
  filter: dt_chosen_enabled("infuse,reboot-state")
tests:
  lib.common_boot:
    required_snippets:
      - infuse
    integration_platforms:
      - mps2/an385
```

## tests/lib/debug/workqueue_blocker/testcase.yaml
```yaml
common:
  tags: debug
  min_flash: 64
  min_ram: 32
tests:
  debug.workqueue_blocker:
    integration_platforms:
      - native_sim
      - qemu_cortex_m3
```

## tests/lib/reboot/reboot_a/testcase.yaml
```yaml
common:
  tags: infuse
  min_flash: 64
  min_ram: 32
tests:
  lib.reboot.a:
    expect_reboot: true
    platform_exclude:
      - native_sim
      - nrf52_bsim
    required_snippets:
      - infuse
    integration_platforms:
      - mps2/an385
```

## tests/lib/reboot/reboot_b/testcase.yaml
```yaml
common:
  tags: infuse
  min_flash: 64
  min_ram: 32
  platform_exclude:
    - tauro/nrf52840
tests:
  lib.reboot.b:
    required_snippets:
      - infuse
    integration_platforms:
      - mps2/an385
```

## tests/lib/reboot/testcase.yaml
```yaml
common:
  tags: infuse
  min_flash: 64
  min_ram: 32
tests:
  lib.reboot:
    platform_allow:
      - mps2_an385
    integration_platforms:
      - mps2_an385
```

## tests/net/auto_sntp/testcase.yaml
```yaml
common:
  tags: infuse net
  min_flash: 64
  min_ram: 32
tests:
  net.auto_sntp.wifi:
    build_only: true
    integration_platforms:
      - nrf7002dk/nrf5340/cpuapp
    required_snippets:
      - infuse
    depends_on:
      - netif
      - wifi
  net.auto_sntp.native.sync:
    platform_allow:
      - native_sim
    integration_platforms:
      - native_sim
    extra_configs:
      - CONFIG_NATIVE_SIM_SLOWDOWN_TO_REAL_TIME=y
      - CONFIG_INFUSE_DNS_ASYNC=n
    extra_args:
      - OVERLAY_CONFIG="overlay-nsos.conf"
    harness: console
    harness_config:
      type: multi_line
      ordered: true
      regex:
        - "pool.ntp.org -> (.*)"
        - "Sending request..."
        - "Unix time: (.*)"
        - "Now: (.*) UTC"
        - "www.google.com -> (.*)"
        - "Sending request..."
        - "SNTP query timeout"
        - "pool.ntp.org -> (.*)"
        - "Sending request..."
        - "Unix time: (.*)"
        - "Now: (.*) UTC"
        - "pool.ntp.org -> (.*)"
        - "Sending request..."
        - "Unix time: (.*)"
        - "Now: (.*) UTC"
        - "pool.ntp.org -> (.*)"
        - "Sending request..."
        - "Unix time: (.*)"
  net.auto_sntp.native.async:
    platform_allow:
      - native_sim
    integration_platforms:
      - native_sim
    extra_configs:
      - CONFIG_NATIVE_SIM_SLOWDOWN_TO_REAL_TIME=y
      - CONFIG_INFUSE_DNS_ASYNC=y
    extra_args:
      - OVERLAY_CONFIG="overlay-nsos.conf"
    harness: console
    harness_config:
      type: multi_line
      ordered: true
      regex:
        - "/?/?/? -> (.*)"
        - "Sending request..."
        - "Unix time: (.*)"
        - "Now: (.*) UTC"
        - "/?/?/? -> (.*)"
        - "Sending request..."
        - "SNTP query timeout"
        - "/?/?/? -> (.*)"
        - "Sending request..."
        - "Unix time: (.*)"
        - "Now: (.*) UTC"
        - "/?/?/? -> (.*)"
        - "Sending request..."
        - "Unix time: (.*)"
        - "Now: (.*) UTC"
        - "/?/?/? -> (.*)"
        - "Sending request..."
        - "Unix time: (.*)"
```

## tests/net/coap/infuse/testcase.yaml
```yaml
common:
  tags: infuse net
  min_flash: 64
  min_ram: 32
tests:
  net.coap.infuse.wifi:
    build_only: true
    integration_platforms:
      - nrf7002dk/nrf5340/cpuapp
    required_snippets:
      - infuse
    depends_on:
      - netif
      - wifi
  net.coap.infuse.native:
    platform_allow:
      - native_sim
    integration_platforms:
      - native_sim
    extra_args:
      - OVERLAY_CONFIG="overlay-nsos.conf"
  net.coap.infuse.native.serial:
    platform_allow:
      - native_sim
    integration_platforms:
      - native_sim
    extra_configs:
      - CONFIG_INFUSE_COAP_BACKEND_SERIAL=y
    extra_args:
      - OVERLAY_CONFIG="overlay-nsos.conf"
```

## tests/net/coap/testcase.yaml
```yaml
common:
  tags: infuse net
  min_flash: 64
  min_ram: 32
tests:
  net.coap:
    build_only: true
    platform_allow:
      - nrf7002dk_nrf5340_cpuapp
    depends_on:
      - net
  net.coap.native:
    platform_allow:
      - native_sim
    integration_platforms:
      - native_sim
    extra_args:
      - OVERLAY_CONFIG="overlay-nsos.conf"
```

## tests/net/nrf_modem_lib/testcase.yaml
```yaml
common:
  tags: infuse net
  min_flash: 64
  min_ram: 32
  platform_allow:
    - native_sim
  integration_platforms:
    - native_sim
tests:
  net.nrf_modem_lib:
    build_only: false
  net.nrf_modem_lib.conn_log:
    extra_configs:
      - CONFIG_INFUSE_MODEM_MONITOR_CONN_STATE_LOG=y
```

## tests/subsys/algorithm/runner/testcase.yaml
```yaml
common:
  tags: algorithm_runner
  min_flash: 64
  min_ram: 32
tests:
  algorithm.runner:
    platform_allow:
      - native_sim
      - mps2/an385
    integration_platforms:
      - native_sim
      - mps2/an385
```

## tests/subsys/algorithms/build_system/testcase.yaml
```yaml
common:
  tags: algorithms
  min_flash: 64
  min_ram: 32
  platform_allow:
    - mps2/an385      # Cortex-M3
    - mps2/an386      # Cortex-M4
    - mps2/an521/cpu0 # Cortex-M33
  integration_platforms:
    - mps2/an385      # Cortex-M3
    - mps2/an386      # Cortex-M4
    - mps2/an521/cpu0 # Cortex-M33
  harness: console
  harness_config:
    type: multi_line
    ordered: true
    regex:
      - "INIT"
      - "RUN: 0 0"
      - "RUN: 1 2"
      - "RUN: 2 5"
tests:
  algorithms.build_system.native:
    extra_configs:
      - CONFIG_TEST_ALGORITHM_BUILD_NATIVE=y
  algorithms.build_system.llext:
    extra_configs:
      - CONFIG_TEST_ALGORITHM_BUILD_LLEXT=y
      - CONFIG_FPU=n
  algorithms.build_system.llext.softabi:
    filter: CONFIG_CPU_HAS_FPU
    extra_configs:
      - CONFIG_TEST_ALGORITHM_BUILD_LLEXT=y
      - CONFIG_FP_SOFTABI=y
  algorithms.build_system.llext.hardabi:
    filter: CONFIG_CPU_HAS_FPU
    extra_configs:
      - CONFIG_TEST_ALGORITHM_BUILD_LLEXT=y
      - CONFIG_FP_HARDABI=y
```

## tests/subsys/algorithms/nrf_edge_ai/testcase.yaml
```yaml
common:
  tags: algorithms
  min_flash: 64
  min_ram: 32
  arch_allow: arm
  filter: CONFIG_CPU_HAS_FPU
  required_snippets:
    - infuse
  integration_platforms:
    - mps2/an386      # Cortex-M4
  harness: console
  harness_config:
    type: multi_line
    ordered: true
    regex:
      - "Initialized model"
      - "Inference anomaly score: [+-]?[0-9]+[.][0-9]{2}"
      - "Inference anomaly score: [+-]?[0-9]+[.][0-9]{2}"
      - "Inference anomaly score: [+-]?[0-9]+[.][0-9]{2}"
tests:
  algorithms.nrf_edge_ai: {}
```

## tests/subsys/algorithms/samples/movement_threshold/testcase.yaml
```yaml
common:
  tags: imu
  min_flash: 64
  min_ram: 32
tests:
  algorithm_runner.algorithms.movement_threshold:
    required_snippets:
      - infuse
    integration_platforms:
      - mps2/an385
```

## tests/subsys/algorithms/target_filtering/testcase.yaml
```yaml
common:
  tags: algorithms
  min_flash: 64
  min_ram: 32
  platform_allow:
    - mps2/an386      # Cortex-M4
  integration_platforms:
    - mps2/an386      # Cortex-M4
  harness: console
  harness_config:
    type: multi_line
    ordered: true
    regex:
      - "INIT"
      - "RUN: 0 RUN\\*2.75: 0"
      - "RUN: 1 RUN\\*2.75: 2"
      - "RUN: 2 RUN\\*2.75: 5"
tests:
  algorithms.target_filtering.native:
    extra_configs:
      - CONFIG_TEST_ALGORITHM_BUILD_NATIVE=y
  algorithms.target_filtering.llext:
    extra_configs:
      - CONFIG_TEST_ALGORITHM_BUILD_LLEXT=y
```

## tests/subsys/data_logger/api/testcase.yaml
```yaml
common:
  tags: data_logger
  min_flash: 64
  min_ram: 32
  integration_platforms:
    - native_sim
tests:
  data_logger.api: {}
  data_logger.api.offload:
    extra_configs:
      - CONFIG_DATA_LOGGER_OFFLOAD_WRITES=y
  data_logger.api.ram_buffer:
    extra_configs:
      - CONFIG_DATA_LOGGER_RAM_BUFFER=y
  data_logger.api.offload_ram_buffer_burst:
    extra_configs:
      - CONFIG_DATA_LOGGER_OFFLOAD_WRITES=y
      - CONFIG_DATA_LOGGER_RAM_BUFFER=y
      - CONFIG_TEST_FORCE_DATA_LOGGER_BURST_WRITES=y
```

## tests/subsys/data_logger/backends/exfat/testcase.yaml
```yaml
common:
  tags: data_logger
  min_flash: 64
  min_ram: 32
tests:
  data_logger.exfat:
    platform_allow:
      - native_sim
    integration_platforms:
      - native_sim
  data_logger.exfat.sd:
    build_only: true
    depends_on: arduino_spi
    extra_args:
      - SHIELD=sparkfun_microsd
    platform_exclude:
      - nrf9161dk_nrf9161
      - nrf9160dk_nrf9160
      - nrf9151dk_nrf9151
      - nrf9161dk/nrf9161/ns
      - nrf9160dk/nrf9160/ns
      - nrf9151dk/nrf9151/ns
    integration_platforms:
      - nrf52840dk/nrf52840
```
