## Kconfig
```
# Override REBOOT dependencies

config BSIM_REBOOT_SHIM
	bool "Compile in reboot shim"

if BSIM_REBOOT_SHIM

config INFUSE_REBOOT
	default y

config INFUSE_REBOOT_COMPILE
	default n

config INFUSE_REBOOT_RETURN
	default y

endif # BSIM_REBOOT_SHIM

source "Kconfig.zephyr"
```

## prj.conf
```kconfig
CONFIG_INFUSE_SDK=y
CONFIG_DATA_LOGGER_LOG_LEVEL_WRN=y
CONFIG_TASK_RUNNER=y
CONFIG_BT=y
# Allow DATA_SENDER and DATA_LOGGER_READ to run with network auth
CONFIG_INFUSE_RPC_COMMAND_DATA_SENDER=y
CONFIG_INFUSE_RPC_COMMAND_DATA_SENDER_REQUIRED_AUTH=1
CONFIG_INFUSE_RPC_COMMAND_DATA_LOGGER_READ_REQUIRED_AUTH=1
# Reduce maximum connections to make it easier to test saturation
CONFIG_BT_MAX_CONN=1
```

## prj_alt_network.conf
```kconfig
CONFIG_INFUSE_SECURITY_DEFAULT_NETWORK="../../tests/bsim/bluetooth/epacket/alternate_network.yaml"
```

## prj_cloud_uplink.conf
```kconfig
CONFIG_EPACKET_INTERFACE_BT_PERIPHERAL_CLOUD_UPLINK=y
```

## prj_cloud_uplink_memfault.conf
```kconfig
CONFIG_EPACKET_INTERFACE_BT_PERIPHERAL_CLOUD_UPLINK=y
CONFIG_MEMFAULT=y
CONFIG_MEMFAULT_INFUSE_CONFIG=y
```

## prj_public.conf
```kconfig
# Public Bluetooth address
CONFIG_INFUSE_BOARD_HAS_PUBLIC_BT_ADDRESS=y

# No logging support
CONFIG_LOG_BACKEND_EPACKET_BT=n
```

## prj_wdog.conf
```kconfig
# Watchdog reboot if no connectable packets sent for 2 seconds
CONFIG_EPACKET_INTERFACE_BT_ADV_CONNECTABLE_WATCHDOG_SEC=2

CONFIG_BSIM_REBOOT_SHIM=y
```

## src/main.c
```c
/**
 * Copyright (c) 2024 Embeint Holdings Pty Ltd
 *
 * SPDX-License-Identifier: Apache-2.0
 */

#include <zephyr/kernel.h>
#include <zephyr/logging/log.h>
#include <zephyr/sys/byteorder.h>
#include <zephyr/bluetooth/addr.h>
#include <zephyr/bluetooth/bluetooth.h>
#include <zephyr/bluetooth/conn.h>
#include <zephyr/random/random.h>

#include "bs_types.h"
#include "bs_tracing.h"
#include "time_machine.h"
#include "bstests.h"

#include <infuse/bluetooth/legacy_adv.h>
#include <infuse/epacket/interface.h>
#include <infuse/epacket/interface/epacket_bt_peripheral.h>
#include <infuse/epacket/packet.h>
#include <infuse/data_logger/logger.h>
#include <infuse/data_logger/high_level/tdf.h>
#include <infuse/tdf/definitions.h>
#include <infuse/work_q.h>
#include <infuse/reboot.h>

#define FAIL(...)                                                                                  \
	do {                                                                                       \
		bst_result = Failed;                                                               \
		bs_trace_error_time_line(__VA_ARGS__);                                             \
	} while (0)

#define PASS(...)                                                                                  \
	do {                                                                                       \
		bst_result = Passed;                                                               \
		bs_trace_info_time(1, "PASSED: " __VA_ARGS__);                                     \
	} while (0)

#define WAIT_SECONDS 30                            /* seconds */
#define WAIT_TIME    (WAIT_SECONDS * USEC_PER_SEC) /* microseconds*/

extern enum bst_result_t bst_result;
static int connection_notifications;
static int disconnection_notifications;

static K_SEM_DEFINE(load_complete, 0, 1);

LOG_MODULE_REGISTER(app, LOG_LEVEL_INF);

#ifdef CONFIG_INFUSE_BOARD_HAS_PUBLIC_BT_ADDRESS

int infuse_board_public_bt_addr(bt_addr_le_t *addr)
{
	uint32_t nordic_oui = 0xF4CE36;

	/* Generate a random Nordic MAC address for testing */
	addr->type = BT_ADDR_LE_PUBLIC;
	sys_put_le24(nordic_oui, addr->a.val + 3);
	sys_put_le24(sys_rand32_get(), addr->a.val + 0);
	return 0;
}

#endif /* CONFIG_INFUSE_BOARD_HAS_PUBLIC_BT_ADDRESS */

static void peripheral_interface_state(uint16_t current_max_payload, void *user_ctx)
{
	if (current_max_payload > 0) {
		connection_notifications += 1;
	} else {
		disconnection_notifications += 1;
	}
	LOG_INF("Peripheral: %s (Payload %d)",
		current_max_payload > 0 ? "Connected" : "Disconnected", current_max_payload);
}

static void main_epacket_bt_basic_broadcast(void)
{
	const struct device *epacket_bt_periph = DEVICE_DT_GET(DT_NODELABEL(epacket_bt_peripheral));
	struct tdf_announce_v2 announce = {0};
	struct epacket_interface_cb interface_cb = {
		.interface_state = peripheral_interface_state,
	};
	uint16_t packet_size;

#ifdef CONFIG_INFUSE_BOARD_HAS_PUBLIC_BT_ADDRESS
	bt_addr_le_t bt_addr[CONFIG_BT_ID_MAX];
	size_t bt_addr_cnt = ARRAY_SIZE(bt_addr);

	bt_id_get(bt_addr, &bt_addr_cnt);

	/* Ensure public address was set correctly */
	if (bt_addr->type != BT_ADDR_LE_PUBLIC) {
		FAIL("Public Bluetooth address not set\n");
		return;
	}
#endif /* CONFIG_INFUSE_BOARD_HAS_PUBLIC_BT_ADDRESS */

#ifdef CONFIG_DATA_LOGGER_SHIM
	const struct device *data_logger = DEVICE_DT_GET_ONE(embeint_data_logger_shim);
	const uint32_t num_blocks =
		DT_PROP(DT_COMPAT_GET_ANY_STATUS_OKAY(embeint_data_logger_shim), physical_blocks);
	uint8_t dummy_data[16] = {0};

	for (int i = 0; i < num_blocks; i++) {
		data_logger_block_write(data_logger, i, dummy_data, sizeof(dummy_data));
	}
#endif /* CONFIG_DATA_LOGGER_SHIM */

	epacket_register_callback(epacket_bt_periph, &interface_cb);

	packet_size = epacket_interface_max_packet_size(epacket_bt_periph);
	if (packet_size != 0) {
		FAIL("Unexpected packet size\n");
		return;
	}

	LOG_INF("Starting send");

	/* Burst send some packets */
	for (int i = 0; i < 10; i++) {
		k_sleep(K_USEC(sys_rand32_get() % 10000));
		TDF_DATA_LOGGER_LOG(TDF_DATA_LOGGER_BT_ADV | TDF_DATA_LOGGER_BT_PERIPHERAL,
				    TDF_ANNOUNCE_V2, 0, &announce);
		tdf_data_logger_flush(TDF_DATA_LOGGER_BT_ADV | TDF_DATA_LOGGER_BT_PERIPHERAL);
	}
	k_sleep(K_MSEC(500));

	/* Send 5 packets with spacing */
	for (int i = 0; i < 8; i++) {
		k_sleep(K_USEC(sys_rand32_get() % 10000));
		LOG_INF("TX %d", i);
		announce.uptime = k_uptime_seconds();
		TDF_DATA_LOGGER_LOG(TDF_DATA_LOGGER_BT_ADV | TDF_DATA_LOGGER_BT_PERIPHERAL,
				    TDF_ANNOUNCE_V2, 0, &announce);
		tdf_data_logger_flush(TDF_DATA_LOGGER_BT_ADV | TDF_DATA_LOGGER_BT_PERIPHERAL);
		k_sleep(K_MSEC(1000));
	}

	if (connection_notifications != disconnection_notifications) {
		FAIL("Unbalanced notifications\n");
		return;
	}

	PASS("Advertising device complete\n");
}

static void epacket_adv_load(struct k_work *work)
{
	const int iterations = 10 * CONFIG_EPACKET_BUFFERS_TX;
	struct tdf_announce_v2 announce = {0};

	LOG_INF("Loaded send from %p", work);

	for (int i = 0; i < iterations; i++) {
		LOG_INF("Loaded send %2d/%2d", i + 1, iterations);
		TDF_DATA_LOGGER_LOG(TDF_DATA_LOGGER_BT_ADV, TDF_ANNOUNCE_V2, 0, &announce);
		tdf_data_logger_flush(TDF_DATA_LOGGER_BT_ADV);
	}
	k_sem_give(&load_complete);
}

static void main_epacket_bt_adv_loaded(void)
{
	struct k_work from_infuse;

	/* Heavy load from main application thread */
	epacket_adv_load(NULL);
	k_sem_take(&load_complete, K_FOREVER);

	/* Heavy load from the Infuse-IoT workqueue */
	k_work_init(&from_infuse, epacket_adv_load);
	infuse_work_submit(&from_infuse);
	k_sem_take(&load_complete, K_FOREVER);

	PASS("Loaded send complete\n");
}

static K_SEM_DEFINE(tx_done, 0, 1);
static const struct device *tx_cb_dev;
static struct net_buf *tx_cb_pkt;
static int tx_cb_result;
static void tx_done_cb(const struct device *dev, struct net_buf *pkt, int result, void *user_data)
{
	tx_cb_dev = dev;
	tx_cb_pkt = pkt;
	tx_cb_result = result;
	k_sem_give(&tx_done);
}

static void main_epacket_bt_periph_send_unconnected(void)
{
	const struct device *epacket_bt_periph = DEVICE_DT_GET(DT_NODELABEL(epacket_bt_peripheral));
	union epacket_interface_address dest;
	struct net_buf *buf;

	dest.bluetooth.type = BT_ADDR_LE_PUBLIC;
	for (int i = 0; i < sizeof(dest.bluetooth.a.val); i++) {
		dest.bluetooth.a.val[i] = 0x10 + i;
	}

	/* To an explicit device should fail */
	for (int i = 0; i < 5 * CONFIG_EPACKET_BUFFERS_TX; i++) {
		/* Send a packet to a device we're not connected to */
		buf = epacket_alloc_tx_for_interface(epacket_bt_periph, K_FOREVER);
		if (buf == NULL) {
			FAIL("No buffer\n");
			return;
		}
		epacket_set_tx_metadata(buf, EPACKET_AUTH_DEVICE, 0, INFUSE_TDF, dest);
		epacket_set_tx_callback(buf, tx_done_cb, NULL);
		epacket_queue(epacket_bt_periph, buf);

		if (k_sem_take(&tx_done, K_MSEC(100)) != 0) {
			FAIL("No send callback\n");
			return;
		}
		if (tx_cb_dev != epacket_bt_periph) {
			FAIL("Bad device pointer\n");
			return;
		}
		if (tx_cb_pkt == NULL) {
			FAIL("Bad buffer pointer\n");
			return;
		}
		if (tx_cb_result != -ENOTCONN) {
			FAIL("Unexpected result\n");
			return;
		}
	}

	/* When no connected device exists */
	for (int i = 0; i < 5 * CONFIG_EPACKET_BUFFERS_TX; i++) {
		/* Send a packet to a device we're not connected to */
		buf = epacket_alloc_tx_for_interface(epacket_bt_periph, K_FOREVER);
		if (buf == NULL) {
			FAIL("No buffer\n");
			return;
		}
		epacket_set_tx_metadata(buf, EPACKET_AUTH_DEVICE, 0, INFUSE_TDF, EPACKET_ADDR_ALL);
		epacket_set_tx_callback(buf, tx_done_cb, NULL);
		epacket_queue(epacket_bt_periph, buf);

		if (k_sem_take(&tx_done, K_MSEC(100)) != 0) {
			FAIL("No send callback\n");
			return;
		}
		if (tx_cb_dev != epacket_bt_periph) {
			FAIL("Bad device pointer\n");
			return;
		}
		if (tx_cb_pkt == NULL) {
			FAIL("Bad buffer pointer\n");
			return;
		}
		/* Sending to everyone when no-one is connected is not an error */
		if (tx_cb_result != 0) {
			FAIL("Unexpected result\n");
			return;
		}
	}

	PASS("Send to unconnected passed\n");
}

#ifdef CONFIG_EPACKET_INTERFACE_BT_PERIPHERAL_CLOUD_UPLINK
static const uint8_t cloud_uplink_payload[] = {0x63, 0x6C, 0x6F, 0x75, 0x64};

static void conn_ref_connected(struct bt_conn *conn, void *user_data)
{
	struct bt_conn **conn_out = user_data;
	struct bt_conn_info info;

	if (*conn_out != NULL) {
		return;
	}
	if (bt_conn_get_info(conn, &info) != 0) {
		return;
	}
	if (info.state != BT_CONN_STATE_CONNECTED) {
		return;
	}

	*conn_out = bt_conn_ref(conn);
}

static void main_epacket_bt_cloud_uplink(void)
{
	const struct device *epacket_bt_periph = DEVICE_DT_GET(DT_NODELABEL(epacket_bt_peripheral));
	struct epacket_interface_cb interface_cb = {
		.interface_state = peripheral_interface_state,
	};
	struct tdf_announce_v2 announce = {0};
	struct net_buf *buf;
	int successful_sends = 0;
	int subscribed_checks = 0;
	int unsubscribed_checks = 0;
	int64_t deadline = k_uptime_get() + 12000;
	int sends = 0;
	int rc;
	bool subscribed;

	epacket_register_callback(epacket_bt_periph, &interface_cb);

	while (k_uptime_get() < deadline) {
		if (connection_notifications == disconnection_notifications) {
			TDF_DATA_LOGGER_LOG(TDF_DATA_LOGGER_BT_ADV, TDF_ANNOUNCE_V2, 0, &announce);
			tdf_data_logger_flush(TDF_DATA_LOGGER_BT_ADV);
			k_sleep(K_MSEC(500));
			continue;
		}

		struct bt_conn *cloud_conn = NULL;

		bt_conn_foreach(BT_CONN_TYPE_LE, conn_ref_connected, &cloud_conn);
		if (cloud_conn == NULL) {
			FAIL("No connected peer\n");
			return;
		}
		subscribed = epacket_bt_peripheral_cloud_uplink_subscribed(epacket_bt_periph,
									   cloud_conn);
		if (subscribed) {
			subscribed_checks += 1;
		} else {
			unsubscribed_checks += 1;
		}
		bt_conn_unref(cloud_conn);

		buf = epacket_alloc_tx_for_interface(epacket_bt_periph, K_FOREVER);
		if (buf != NULL) {
			epacket_set_tx_metadata(buf, EPACKET_AUTH_NETWORK, 0, INFUSE_TDF,
						EPACKET_ADDR_ALL);
			net_buf_add_mem(buf, cloud_uplink_payload, sizeof(cloud_uplink_payload));
			epacket_set_tx_callback(buf, tx_done_cb, NULL);

			rc = epacket_bt_peripheral_cloud_uplink_send(epacket_bt_periph, NULL, buf);
			if ((rc != 0) && (rc != -ENOTCONN)) {
				FAIL("Failed to send cloud uplink (%d)\n", rc);
				return;
			}
			if (k_sem_take(&tx_done, K_SECONDS(1)) != 0) {
				FAIL("No send callback\n");
				return;
			}
			if (tx_cb_dev != epacket_bt_periph) {
				FAIL("Bad device pointer\n");
				return;
			}
			if (tx_cb_pkt == NULL) {
				FAIL("Bad buffer pointer\n");
				return;
			}
			if ((tx_cb_result != 0) && (tx_cb_result != -ENOTCONN)) {
				FAIL("Unexpected result (%d)\n", tx_cb_result);
				return;
			}
			if (tx_cb_result == 0) {
				successful_sends += 1;
			}
			sends += 1;
		}
		k_sleep(K_MSEC(300));
	}

	if (sends == 0) {
		FAIL("No cloud uplink packets sent\n");
		return;
	}
	if (successful_sends == 0) {
		FAIL("No cloud uplink packets notified\n");
		return;
	}
	if (unsubscribed_checks == 0) {
		FAIL("Cloud uplink never observed unsubscribed\n");
		return;
	}
	if (subscribed_checks == 0) {
		FAIL("Cloud uplink never observed subscribed\n");
		return;
	}

	PASS("Cloud uplink complete\n");
}
#endif /* CONFIG_EPACKET_INTERFACE_BT_PERIPHERAL_CLOUD_UPLINK */

static void main_epacket_bt_name(void)
{
	/* Start the legacy name broadcaster */
	bluetooth_legacy_advertising_run();

	/* Wait for test to complete */
	k_sleep(K_SECONDS(9));

	PASS("Advertising device complete\n");
}

static K_SEM_DEFINE(reboot_request, 0, 1);

#ifdef CONFIG_BSIM_REBOOT_SHIM

int infuse_reboot_state_query(struct infuse_reboot_state *state)
{
	return -ENOENT;
}

void infuse_reboot_hard(enum infuse_reboot_reason reason, uint32_t info1, uint32_t info2)
{
	k_sem_give(&reboot_request);
}

void infuse_reboot_schedule(enum infuse_reboot_reason reason, uint32_t info1, uint32_t info2,
			    k_timeout_t delay)
{
	k_sem_give(&reboot_request);
}

#endif /* CONFIG_BSIM_REBOOT_SHIM */

static void main_epacket_bt_connectable_wdog(void)
{
	const uint32_t wdog_period = CONFIG_EPACKET_INTERFACE_BT_ADV_CONNECTABLE_WATCHDOG_SEC;
	struct tdf_announce_v2 announce = {0};

	/* Send packets for a while */
	while (k_uptime_seconds() < (wdog_period + 2)) {
		k_sleep(K_MSEC(500));
		TDF_DATA_LOGGER_LOG(TDF_DATA_LOGGER_BT_ADV | TDF_DATA_LOGGER_BT_PERIPHERAL,
				    TDF_ANNOUNCE_V2, 0, &announce);
		tdf_data_logger_flush(TDF_DATA_LOGGER_BT_ADV | TDF_DATA_LOGGER_BT_PERIPHERAL);
	}

	if (k_sem_take(&reboot_request, K_SECONDS(wdog_period - 1)) != -EAGAIN) {
		FAIL("Connectable watchdog expired too early\n");
		return;
	}

	if (k_sem_take(&reboot_request, K_SECONDS(2)) != -0) {
		FAIL("Connectable watchdog did not expire\n");
		return;
	}

	PASS("Connectable watchdog expired successfully\n");
}

void test_tick(bs_time_t HW_device_time)
{
	if (bst_result != Passed) {
		FAIL("test failed (not passed after %i seconds)\n", WAIT_SECONDS);
	}
}

void test_init(void)
{
	bst_ticker_set_next_tick_absolute(WAIT_TIME);
	bst_result = In_progress;
}

static const struct bst_test_instance ext_adv_advertiser[] = {
	{
		.test_id = "epacket_bt_device",
		.test_descr = "Basic Infuse-IoT Bluetooth device",
		.test_pre_init_f = test_init,
		.test_tick_f = test_tick,
		.test_main_f = main_epacket_bt_basic_broadcast,
	},
	{
		.test_id = "epacket_bt_adv_load",
		.test_descr = "Load the Bluetooth stack with large amounts of traffic",
		.test_pre_init_f = test_init,
		.test_tick_f = test_tick,
		.test_main_f = main_epacket_bt_adv_loaded,
	},
	{
		.test_id = "epacket_bt_periph_send_unconnected",
		.test_descr = "Queue packets to an unconnected device",
		.test_pre_init_f = test_init,
		.test_tick_f = test_tick,
		.test_main_f = main_epacket_bt_periph_send_unconnected,
	},
	{
		.test_id = "epacket_bt_name",
		.test_descr = "Advertising Bluetooth name",
		.test_pre_init_f = test_init,
		.test_tick_f = test_tick,
		.test_main_f = main_epacket_bt_name,
	},
#ifdef CONFIG_EPACKET_INTERFACE_BT_PERIPHERAL_CLOUD_UPLINK
	{
		.test_id = "epacket_bt_cloud_uplink",
		.test_descr = "Send data on the cloud uplink characteristic",
		.test_pre_init_f = test_init,
		.test_tick_f = test_tick,
		.test_main_f = main_epacket_bt_cloud_uplink,
	},
#endif /* CONFIG_EPACKET_INTERFACE_BT_PERIPHERAL_CLOUD_UPLINK */
	{
		.test_id = "epacket_bt_connectable_wdog",
		.test_descr = "Connectable Bluetooth advertising watchdog",
		.test_pre_init_f = test_init,
		.test_tick_f = test_tick,
		.test_main_f = main_epacket_bt_connectable_wdog,
	},
	BSTEST_END_MARKER,
};

struct bst_test_list *test_ext_adv_advertiser(struct bst_test_list *tests)
{
	return bst_add_tests(tests, ext_adv_advertiser);
}

bst_test_install_t test_installers[] = {test_ext_adv_advertiser, NULL};

int main(void)
{
	bst_main();
	return 0;
}
```
