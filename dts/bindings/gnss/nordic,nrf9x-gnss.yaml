## dts/bindings/gnss/nordic,nrf9x-gnss.yaml
```yaml
# Copyright (c) 2025 Embeint Inc
# SPDX-License-Identifier: Apache-2.0

description: nRF9x GNSS interface

compatible: "nordic,nrf9x-gnss"
```

## dts/bindings/gnss/u-blox,m10-i2c.yaml
```yaml
# Copyright (c) 2024 Embeint Holdings Pty Ltd
# SPDX-License-Identifier: FSL-1.1-ALv2

description: U-BLOX M10 GNSS Module

compatible: "u-blox,m10-i2c"

include: [i2c-device.yaml, "u-blox-common.yaml"]

properties:
  rf-lna-mode:
    type: string
    enum:
      - "NORMAL"
      - "LOWGAIN"
      - "BYPASS"
    default: "NORMAL"
    description: |
      Operating mode for the RF LNA.
      Normal: internal LNA enabled at full gain
      Low Gain: LNA enabled in low gain mode
      Bypass: Bypass LNA
```

## dts/bindings/gnss/u-blox,m8-emul.yaml
```yaml
# Copyright (c) 2024 Embeint Holdings Pty Ltd
# SPDX-License-Identifier: FSL-1.1-ALv2

description: Emulated U-BLOX M8 GNSS Module

compatible: "u-blox,m8-emul"

include: [base.yaml, power.yaml]
```

## dts/bindings/gnss/u-blox,m8-spi.yaml
```yaml
# Copyright (c) 2024 Embeint Holdings Pty Ltd
# SPDX-License-Identifier: FSL-1.1-ALv2

description: U-BLOX M8 GNSS Module

compatible: "u-blox,m8-spi"

include: [spi-device.yaml, "u-blox-common.yaml"]
```

## dts/bindings/gnss/u-blox-common.yaml
```yaml
# Copyright (c) 2024 Embeint Inc
# SPDX-License-Identifier: Apache-2.0

properties:
  reset-gpios:
    type: phandle-array
    required: true
    description: |
      Reset GPIO.

  data-ready-gpios:
    type: phandle-array
    required: true
    description: |
      Data Ready GPIO.

  data-ready-pio:
    type: int
    required: true
    description: |
      PIO number of data-ready output.

  extint-gpios:
    type: phandle-array
    description: |
      EXTINT GPIO.

  timepulse-gpios:
    type: phandle-array
    description: |
      Data Ready GPIO.

  antenna-switch:
    type: phandle-array
    specifier-space: shared-dev
    description: |
      Optional switch that must be requested to connect the antenna
```

## dts/bindings/imu/embeint,imu-emul.yaml
```yaml
# Copyright (c) 2024 Embeint Holdings Pty Ltd
# SPDX-License-Identifier: FSL-1.1-ALv2

description: |
  Emulated IMU driver

compatible: "embeint,imu-emul"

include: sensor-device.yaml
```

## dts/bindings/led/ti,lp5815.yaml
```yaml
description: TI LP5815 LED Driver

compatible: "ti,lp5815"

include: ["ti,lp581x.yaml"]
```

## dts/bindings/led/ti,lp5816.yaml
```yaml
description: TI LP5816 LED Driver

compatible: "ti,lp5816"

include: ["ti,lp581x.yaml"]

properties:
  out3-current-max:
    type: int
    default: 0
    description: Maximum output current of channel 0 in 0.1 mA (0-25.5 mA).
                 Default value is the power-on default. Valid range = 0 - 255.
                 A value of 0 disables the channel.
```

## dts/bindings/led/ti,lp5817.yaml
```yaml
description: TI LP5817 LED Driver

compatible: "ti,lp5817"

include: ["ti,lp581x.yaml"]
```

## dts/bindings/led/ti,lp581x.yaml
```yaml
description: TI LP581X LED Driver

compatible: "ti,lp581x"

include: ["i2c-device.yaml", "led-controller.yaml"]

properties:
  out0-current-max:
    type: int
    default: 0
    description: |
      Maximum output current of channel 0 in 0.1 mA (0-25.5 mA).
      Default value is the power-on default. Valid range = 0 - 255.
      A value of 0 disables the channel.
  out1-current-max:
    type: int
    default: 0
    description: |
      Maximum output current of channel 1 in 0.1 mA (0-25.5 mA)
      Default value is the power-on default. Valid range = 0 - 255.
      A value of 0 disables the channel.
  out2-current-max:
    type: int
    default: 0
    description: |
      Maximum output current of channel 2 in 0.1 mA (0-25.5 mA)
      Default value is the power-on default. Valid range = 0 - 255.
      A value of 0 disables the channel.

  fade-duration-ms:
    type: int
    enum:
      - 0
      - 50
      - 100
      - 150
      - 200
      - 250
      - 300
      - 350
      - 400
      - 450
      - 500
      - 1000
      - 2000
      - 4000
      - 6000
      - 8000
    default: 0
    description: |
      Duration of the fade effect from the previous PWM value to the updated
      value. The 0 value disables this effect. Does not apply to the animation
      mode. Applies to all LED channels.

  exponential-fading:
    type: boolean
    description: |
      Fade according to an exponential curve, instead of a linear one. This
      results in a more natural fading effect to the human eye. Applies to all
      LED channels.

child-binding:
  properties:
    index:
      required: true
    color-mapping:
      required: true
```

## dts/bindings/misc/embeint,gpio-charger-control.yaml
```yaml
# Copyright (c) 2024 Embeint Inc
# SPDX-License-Identifier: FSL-1.1-ALv2

description: |
  Battery charger control based on temperature

compatible: "embeint,gpio-charger-control"

properties:
  control-gpios:
    type: phandle-array
    required: true
    description: |
      Control line to enable/disable the battery charger

  temperature-min:
    type: int
    required: true
    description: |
      Minimum temperature to allow charging at, in degrees kelvin

  temperature-max:
    type: int
    required: true
    description: |
      Maximum temperature to allow charging at, in degrees kelvin

  control-hysteresis:
    type: int
    required: true
    description: |
      Temperature must fall this far within the allowed temperature range
      after being disabled before being re-enabled.
```

## dts/bindings/sensor/microchip,pac1941-1.yaml
```yaml
# Copyright (c) 2025 Embeint Holdings Pty Ltd
# SPDX-License-Identifier: FSL-1.1-ALv2

description: |
  Single Channel High-Side Power Monitor with Accumulator, 9V Full-Scale Range

compatible: "microchip,pac1941-1"

include: [i2c-device.yaml]

properties:
  power-down-gpios:
    type: phandle-array
    description: GPIO used to put the device in a power down state

  sense-resistor-milli-ohms:
    type: int
    required: true
    description: Value of the sense resistor in milli-ohms

  fsr-vbus-channel-1:
    type: string
    enum:
      - "0V to 9V"
      - "-9V to 9V"
      - "-4.5V to 4.5V"
    default: "0V to 9V"
    description:
      Full scale range of the VBUS measurements on channel 1. Default
      is the same as the hardware reset value.

  fsr-vsense-channel-1:
    type: string
    enum:
      - "0mV to 100mV"
      - "-100mV to 100mV"
      - "-50mV to 50mV"
    default: "0mV to 100mV"
    description:
      Full scale range of the VBUS measurements on channel 1. Default
      is the same as the hardware reset value.
```

## dts/bindings/sensor/nordic,nrf9x-batt.yaml
```yaml
# Copyright (c) 2025 Embeint Inc
# SPDX-License-Identifier: FSL-1.1-ALv2

description: |
  Internal SoC battery voltage measurement via nRF modem library

compatible: "nordic,nrf9x-batt"
```

## dts/bindings/sensor/nordic,nrf9x-temp.yaml
```yaml
# Copyright (c) 2025 Embeint Holdings Pty Ltd
# SPDX-License-Identifier: FSL-1.1-ALv2

description: |
  Internal SoC temperature sensor via nRF modem library

compatible: "nordic,nrf9x-temp"
```

## dts/bindings/sensor/ti,bq25798.yaml
```yaml
# Copyright (c) 2025 Embeint Holdings Pty Ltd
# SPDX-License-Identifier: FSL-1.1-ALv2

description: TI BQ25798 Buck-Boost Battery Charger

compatible: "ti,bq25798"

include: [i2c-device.yaml]

properties:
  en-gpios:
    type: phandle-array
    required: true
    description: |
      Charger enable GPIO.

  int-gpios:
    type: phandle-array
    required: true
    description: |
      Charger interrupt GPIO.

  v-sys-min:
    type: int
    default: 3500
    description:
      Minimum system voltage in milliVolts. Supports 250mV steps
      from 2500 mV.
      Default is the POR value for a 1S battery.

  v-in-dpm:
    type: int
    default: 3600
    description:
      Minimum voltage target for the PMID supply in milliVolts.
      Default is the POR value.

  input-current-limit:
    type: int
    default: 3000
    description:
      Input current limit in milliAmps.
      Reducing this to 1A or less will give greater current resolution.
      Default is the POR value.

  vac-ovp:
    type: int
    enum:
      - 26
      - 18
      - 12
      - 7
    default: 7
    description:
      Input voltage over-voltage protection limit. Default of 7V is the
      chip default.

  mppt-ratio:
    type: int
    enum:
      - 56
      - 62
      - 68
      - 75
      - 81
      - 87
      - 93
      - 100
    description:
      Percentage of the open circuit voltage for the MPPT charger
      to aim for. Don't configure this property to disable MPPT.

  acdrv1-en:
    type: boolean
    description:
      Enable ACFET1-RBFET1 gate driver control

  acdrv2-en:
    type: boolean
    description:
      Enable ACFET2-RBFET2 gate driver control

  ts-rt1:
    type: int
    required: true
    description: |
      RT1 resistance in ohms.

  ts-rt2:
    type: int
    required: true
    description: |
      RT2 resistance in ohms.

  ntc-beta:
    type: int
    default: 3435
    description: |
      NTC Beta value. Default is for a 103AT-2 thermistor

  ntc-r0:
    type: int
    default: 10000
    description: |
      NTC R0 resistance in Ohms. Default is for a 103AT-2 thermistor

  ntc-t0:
    type: int
    default: 299
    description: |
      NTC T0 temperature in Kelvin. Default is for a 103AT-2 thermistor
```

## dts/bindings/sensor/zephyr,generic-sim-sensor.yaml
```yaml
# Copyright (c) 2025 Embeint Holdings Pty Ltd
# SPDX-License-Identifier: FSL-1.1-ALv2

description: |
  Generic simulated sensor

compatible: "zephyr,generic-sim-sensor"

properties:
  negated-init-rc:
    type: int
    default: 0
    description:
      Value to return in init function (negated due to devicetree limitation
      to unsigned integers).
```

## dts/bindings/shared-device/shared-device.yaml
```yaml
# Copyright (c) 2024 Embeint Holdings Pty Ltd
# SPDX-License-Identifier: FSL-1.1-ALv2

# Common fields for shared devices

properties:
  "#shared-dev-cells":
    type: int
    description: Number of items to expect in a shared device specifier

shared-dev-cells:
  - state
  - priority
```

## dts/bindings/shared-device/zephyr,spdt-switch.yaml
```yaml
# Copyright (c) 2024 Embeint Inc
# SPDX-License-Identifier: FSL-1.1-ALv2

description: |
  Generic single-pole double-throw GPIO controlled switch

compatible: "zephyr,spdt-switch"

include: [base.yaml, shared-device.yaml]

properties:
  ctrl-gpios:
    required: true
    type: phandle-array
    description: |
      Control GPIO line.
```

## kconfig/Kconfig.defaults.802154
```kconfig
# Infuse-IoT SDK 802.15.4 defaults
#
# Copyright (c) 2025 Embeint Holdings Pty Ltd
# SPDX-License-Identifier: FSL-1.1-ALv2

# nrfxlib defaults the choice to the proprietary library,
# which doesn't support the babblesim boards.
choice NRF_802154_SOURCE
	default NRF_802154_SOURCE_HAL_NORDIC if SOC_SERIES_BSIM_NRFXX
endchoice
```

## kconfig/Kconfig.defaults.bluetooth
```kconfig
# Infuse-IoT SDK Bluetooth defaults

DT_CHOSEN_Z_BT_HCI := zephyr,bt-hci

# Enable Bluetooth by default if supported by hardware
configdefault BT
	default y if INFUSE_SDK && !ZTEST && !QEMU_TARGET && !NATIVE_BUILD && $(dt_chosen_enabled,$(DT_CHOSEN_Z_BT_HCI))

config INFUSE_SDK_BLUETOOTH
	bool "Infuse-IoT SDK Bluetooth defaults"
	depends on BT
	default y if INFUSE_SDK

if INFUSE_SDK_BLUETOOTH

configdefault BT_DEVICE_NAME
	default "Infuse-IoT"

# A dedicated workqueue for ECC crypto (that Infuse-IoT does not use by default)
# and GATT database hash (that only runs once on boot) is overkill. Disabling this
# workqueue saves >1kB of RAM.
configdefault BT_LONG_WQ
	default n

# Uncoded LE Data Packet Format:
#
# | Preamble | Access  |                           PDU (2 to 257 bytes)                         |   CRC   |
# |          | Address | LL Header |       Link Layer PDU (0 to 251 bytes)           |    MIC   |         |
# |          |         |           | L2CAP Header |      L2CAP PDU (0-247 bytes)     | Optional |         |
# |          |         |           |              |    ATT Header    |  ATT Payload  |          |         |
# |          |         |           |              | OpCode | Handle  |               |          |         |
# |  1 byte  | 4 bytes |  2 bytes  |   4 bytes    | 1 byte | 2 bytes | 0 - 244 bytes | 4 bytes  | 3 bytes |
#
# L2CAP can be larger than 247 bytes, but will be split across multiple LL packets as a result.
# ATT payloads can be larger than 244 bytes, but will be split across multiple LL packets as a result.
#
# Kconfig Symbols:
#     CONFIG_BT_CTLR_DATA_LENGTH_MAX : Maximum payload size of the Link Layer PDU
#     CONFIG_BT_BUF_ACL_TX_SIZE      : Maximum L2CAP PDU is limited to this value - 4
#     CONFIG_BT_BUF_ACL_RX_SIZE      : Maximum L2CAP PDU is limited to this value - 4
#     CONFIG_BT_L2CAP_TX_MTU         : Maximum L2CAP PDU size for transmission

configdefault BT_CTLR_DATA_LENGTH_MAX
	default 251
configdefault BT_BUF_ACL_TX_SIZE
	default 251
configdefault BT_BUF_ACL_RX_SIZE
	default 251
configdefault BT_L2CAP_TX_MTU
	default 246 if BT_SPI # SPI HCI can only handle 254 byte payloads (PDU - LL Header)
	default 247

# We expect our controllers to support the Zephyr vendor specific commands (read static address, etc)
configdefault BT_HCI_VS
	default y
# We want to support our own extended VS commands
configdefault BT_HCI_VS_EVT_USER
	default y

# Extended advertising is a requirement
configdefault BT_EXT_ADV
	default y
configdefault BT_EXT_ADV_MAX_ADV_SET
	default 2
configdefault BT_MAX_CONN
	default 2

# Maximum possible output power
configdefault BT_CTLR_TX_PWR_ANTENNA
	default 20

# TX Bluetooth advertising packets
configdefault BT_BROADCASTER
	default y
# RX Bluetooth Advertising packets
configdefault BT_OBSERVER
	default y
# Support being the target of a connection
configdefault BT_PERIPHERAL
	default y

# While extended advertising can support 255 bytes, iOS only supports 124 bytes
configdefault BT_CTLR_ADV_DATA_LEN_MAX
	default 124
configdefault BT_CTLR_SCAN_DATA_LEN_MAX
	default 124

# Increase the radio utilisation for continuous scanninging on the Zephyr controller
configdefault BT_CTLR_SCAN_UNRESERVED
	default y

# GATT central options
configdefault BT_GATT_CLIENT
	default y if BT_CENTRAL
configdefault BT_SCAN_AND_INITIATE_IN_PARALLEL
	default y
configdefault BT_CTLR_SDC_ALLOW_PARALLEL_SCANNING_AND_INITIATING
	default y

# Advertising happens on 2Mbit PHY, which is the desired PHY for connections
# due to the increased data throughput. However disabling the option to
# switch PHY's results in iPhones having problems connecting to devices.
configdefault BT_PHY_UPDATE
	default y
# But we don't want the PHY update to be triggered automatically by the stack
configdefault BT_AUTO_PHY_UPDATE
	default n
choice BT_AUTO_PHY_CENTRAL
	default BT_AUTO_PHY_CENTRAL_NONE
endchoice
choice BT_AUTO_PHY_PERIPHERAL
	default BT_AUTO_PHY_PERIPHERAL_NONE
endchoice
# GATT clients should be able to request PHY's
configdefault BT_USER_PHY_UPDATE
	default y if BT_GATT_CLIENT

# Connection parameters should be pro-actively negotiated, not delayed by 5
# seconds as many connections are complete by then.
configdefault BT_GAP_AUTO_UPDATE_CONN_PARAMS
	default n

# Generic Sensor (0x015 << 6)
configdefault BT_DEVICE_APPEARANCE
	default 1344

# Querying the RSSI of connections can be useful
configdefault BT_CTLR_CONN_RSSI
	default y

# Infuse-IoT SPI controller builds support more buffers by default.
# Mismatches between the controller and host trigger a startup warning.
configdefault BT_BUF_ACL_TX_COUNT
	default 5 if DT_HAS_ZEPHYR_BT_HCI_SPI_ENABLED

endif # INFUSE_SDK_BLUETOOTH
```
