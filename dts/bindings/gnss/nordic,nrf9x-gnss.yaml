## kconfig/Kconfig.defaults.core
```kconfig
# Infuse-IoT SDK core defaults
#
# Copyright (c) 2025 Embeint Holdings Pty Ltd
# SPDX-License-Identifier: FSL-1.1-ALv2

# Picolibc is smaller and more performant
choice LIBC_IMPLEMENTATION
	default PICOLIBC if !NATIVE_BUILD
endchoice

configdefault MAIN_STACK_SIZE
	default 2048

# Reboot state storage
configdefault REBOOT
	default y
configdefault HWINFO
	default y
configdefault INFUSE_REBOOT
	default y if !ZTEST
configdefault RETENTION
	default y
configdefault RETENTION_MUTEX_FORCE_DISABLE
	default y
configdefault RETAINED_MEM
	default y
configdefault RETAINED_MEM_MUTEX_FORCE_DISABLE
	default y

# Power management
configdefault PM
	default y
configdefault PM_DEVICE
	default y
configdefault PM_DEVICE_RUNTIME
	default y

# Watchdog
configdefault WATCHDOG
	default y if !ZTEST

# Zephyr bus
configdefault ZBUS
	default y
configdefault ZBUS_CHANNEL_ID
	default y
configdefault ZBUS_CHANNEL_PUBLISH_STATS
	default y

# ePacket API
configdefault EPACKET
	default y
configdefault NET_BUF
	default y
configdefault EVENTS
	default y
configdefault UART_INTERRUPT_DRIVEN
	default y if USB_CDC_ACM
	default y if UART_NRFX
configdefault UART_ASYNC_API
	default y if UART_STM32

# Remote Procedure Calls
configdefault INFUSE_RPC
	default y

configdefault TDF
	default y

configdefault DATA_LOGGER
	default y

configdefault INFUSE_EPOCH_TIME
	default y

configdefault INFUSE_APPLICATION_STATES
	default y

# Application management
if BOOTLOADER_MCUBOOT || BUILD_WITH_TFM
configdefault STREAM_FLASH
	default y
configdefault IMG_MANAGER
	default y
configdefault INFUSE_CPATCH
	default y

if BT_CONN
configdefault ZCBOR
	default y
configdefault MCUMGR
	default y
configdefault MCUMGR_SMP_SUPPORT_ORIGINAL_PROTOCOL
	default n
configdefault MCUMGR_TRANSPORT_BT
	default y
configdefault MCUMGR_TRANSPORT_BT_REASSEMBLY
	default y
# nRF Connect for Mobile assumes at least 512 bytes payload available
configdefault MCUMGR_TRANSPORT_NETBUF_SIZE
	default 520
# TF-M uses `OVERWRITE-ONLY`, which requires confirming non-active images
configdefault MCUMGR_GRP_IMG_ALLOW_CONFIRM_NON_ACTIVE_IMAGE_ANY
	default y if BUILD_WITH_TFM
configdefault MCUMGR_GRP_IMG_ALLOW_ERASE_PENDING
	default y if BUILD_WITH_TFM
configdefault MCUMGR_GRP_OS_INFUSE
	default y
configdefault MCUMGR_GRP_IMG
	default y
configdefault  ZCBOR
	default y
endif # BT_CONN
endif # BOOTLOADER_MCUBOOT || BUILD_WITH_TFM


# KV store
configdefault FLASH
	default y
configdefault FLASH_MAP
	default y
configdefault NVS
	default y if !(SOC_FLASH_NRF_RRAM || SOC_FLASH_NRF_MRAM)
configdefault ZMS
	default y if (SOC_FLASH_NRF_RRAM || SOC_FLASH_NRF_MRAM)
configdefault KV_STORE
	default y
configdefault KV_STORE_KEY_REBOOTS
	default y
configdefault KV_STORE_KEY_INFUSE_APPLICATION_ID
	default y

# Watchdog
configdefault WDT_DISABLE_AT_BOOT
	default y

# Power Management
configdefault POWER_DOMAIN
	default y if "$(dt_has_compat,power-domain-gpio)"

# Random numbers
configdefault ENTROPY_GENERATOR
	default y
choice RNG_GENERATOR_CHOICE
	# The following entropy drivers have a significant processing overhead.
	# Use the XOSHIRO pseudo-random-generator for non cryptographically secure
	# number generation.
	# Cryptographically secure random numbers directly from the entropy device
	# can still be obtained with sys_csrand_get.
	default XOSHIRO_RANDOM_GENERATOR if ENTROPY_PSA_CRYPTO_RNG
	default XOSHIRO_RANDOM_GENERATOR if ENTROPY_CC3XX
endchoice

# Trusted-Firmware M
configdefault TFM_MCUBOOT_IMAGE_NUMBER
	# A single image reduces upgrade complexity
	default 1
configdefault TFM_BL2_SPI_NOR_FLASH
	default y if $(dt_has_compat,$(DT_COMPAT_JEDEC_SPI_NOR)) && TFM_DEVICETREE_LAYOUT
configdefault TFM_BL2_QSPI_FLASH
	default y if $(dt_has_compat,$(DT_COMPAT_NORDIC_QSPI_NOR)) && TFM_DEVICETREE_LAYOUT

# MbedTLS through the PSA API
configdefault MBEDTLS
	default y
configdefault MBEDTLS_ENABLE_HEAP
	default y
configdefault MBEDTLS_HEAP_SIZE
	default 16384 if NET_SOCKETS_ENABLE_DTLS
	default 8192
configdefault MBEDTLS_USER_CONFIG_ENABLE
	default y
configdefault MBEDTLS_USER_CONFIG_FILE
	default "infuse/crypto/mbedtls/infuse_user_config.h"
configdefault MBEDTLS_PSA_CRYPTO_C
	default y

choice MBEDTLS_PSA_CRYPTO_RNG_SOURCE
	default MBEDTLS_PSA_CRYPTO_EXTERNAL_RNG if NRF_CC3XX_PLATFORM
endchoice
configdefault MBEDTLS_ENTROPY_C
	default y
configdefault MBEDTLS_ENTROPY_POLL_ZEPHYR
	default n if NRF_CC3XX_PLATFORM
# Key derivation
configdefault PSA_WANT_ALG_HKDF
	default y
configdefault PSA_WANT_ALG_ECDH
	default y
configdefault PSA_WANT_ECC_MONTGOMERY_255
	default y
configdefault PSA_WANT_KEY_TYPE_ECC_PUBLIC_KEY
	default y
configdefault PSA_WANT_KEY_TYPE_ECC_KEY_PAIR_GENERATE
	default y
# chacha20-poly1305 AEAD
configdefault PSA_WANT_KEY_TYPE_CHACHA20
	default y
configdefault PSA_WANT_ALG_CHACHA20_POLY1305
	default y

# Logging
configdefault PRINTK
	default y
configdefault LOG
	default y
configdefault LOG_PRINTK
	default y

# Use new LoRa backend by default
choice LORA_MODULE_BACKEND
	default LORA_MODULE_BACKEND_LORA_BASICS_MODEM
endchoice

# RTT communications
configdefault SEGGER_RTT_BUFFER_SIZE_UP
	default 1024
configdefault SEGGER_RTT_BUFFER_SIZE_DOWN
	default 256
choice SEGGER_RTT_SECTION
	# Custom section causes obtuse linker errors on nRF91
	default SEGGER_RTT_SECTION_NONE
endchoice

# LLEXT Options
configdefault LLEXT_EXPORT_DEFAULT_GROUPS
	default n

# Size optimisations
configdefault UART_USE_RUNTIME_CONFIGURE
	default n
configdefault TIMEUTIL_APPLY_SKEW
	default n

# Debug options
configdefault DEBUG_THREAD_INFO
	default y
configdefault OUTPUT_DISASSEMBLY
	default y if !ZTEST && !SOC_SERIES_BSIM_NRFXX

# Memfault options
configdefault MEMFAULT_NRF_CONNECT_SDK
	default n
configdefault MEMFAULT_HTTP_ENABLE
	default n
configdefault MEMFAULT_FS_BYTES_FREE_METRIC
	default n
configdefault MEMFAULT_METRICS
	default n
configdefault MEMFAULT_HEAP_STATS
	default n
configdefault MEMFAULT_FAULT_HANDLER_RETURN
	default y
configdefault MEMFAULT_CRC16_BUILTIN
	default n
configdefault MEMFAULT_METRICS_WIFI
	# Disable by default, since this would otherwise end up enabled
	# for scanning only applications.
	default n
configdefault MEMFAULT_METRICS_BLUETOOTH
	# Disable by default, provided metrics don't map well to Infuse-IoT
	# which tends not to be consistently paired to a single peer.
	default n
choice MEMFAULT_REBOOT_REASON_GET
	default MEMFAULT_REBOOT_REASON_GET_CUSTOM
endchoice
# Temporary option until Memfault updated
# https://github.com/memfault/memfault-firmware-sdk/issues/96
config PARTITION_MANAGER_ENABLED
	bool
```

## kconfig/Kconfig.defaults.log
```kconfig
# Infuse-IoT SDK log defaults
#
# Copyright (c) 2025 Embeint Holdings Pty Ltd
# SPDX-License-Identifier: FSL-1.1-ALv2

configdefault USBD_LOG_LEVEL
	default 0
configdefault USBD_CDC_ACM_LOG_LEVEL
	default 0

configdefault NVS_LOG_LEVEL
	default 2

configdefault ZMS_LOG_LEVEL
	default 2

configdefault BT_LOG_LEVEL
	default 2
```

## kconfig/Kconfig.defaults.modules
```kconfig
# Infuse-IoT SDK module Kconfig fixups

# Upstream symbols depends on NEWLIB_LIBC
# Duplicate here to also accept PICOLIBC until upstream does
menuconfig NRF_EDGEAI
	bool "nRF Edge AI Library"
	depends on FPU
	depends on PICOLIBC

if NRF_EDGEAI

config NRF_EDGEAI_COMPLIANCE_SUPPRESS
	bool
	help
	  Symbol exists only to suppress compliance warnings about
	  pointless `menuconfig` above. Remove when upstream supports
	  PICOLIBC.

endif
```
