## lib/nrf_modem_lib/Kconfig
```kconfig
# Modem monitor configuration

config INFUSE_NRF_MODEM_MONITOR
	bool "Infuse-IoT integration with Nordic LTE modem"
	depends on NRF_MODEM_LIB
	depends on LTE_LINK_CONTROL
	depends on KV_STORE
	select LTE_LC_EDRX_MODULE
	select LTE_LC_PSM_MODULE
	select LTE_LC_MODEM_SLEEP_MODULE
	select INFUSE_WORKQ
	default y

if INFUSE_NRF_MODEM_MONITOR

module = INFUSE_NRF_MODEM_MONITOR
module-str = modem_mon
source "subsys/logging/Kconfig.template.log_config"

config INFUSE_NRF_MODEM_MONITOR_CONN_STATE_LOG
	bool "Automatic logging of LTE connection state"
	depends on INFUSE_EPOCH_TIME
	depends on TDF_DATA_LOGGER
	help
	  Automatically log TDF_LTE_CONN_STATUS TDFs in response to registration
	  state and cell tower changes. Output loggers must be configured with
	  `nrf_modem_monitor_network_state_log`.

config INFUSE_NRF_MODEM_MONITOR_CONNECTIVITY_TIMEOUT_SEC
	int "Timeout for receiving L4 connectivity after registering on the network"
	default 120
	help
	  Once registered to a LTE network (home or roaming), the Zephyr networking
	  stack still needs to receive an IP address before considering the interface
	  active. If the interface is not considered active within this time period,
	  the assumption is that something has gone wrong with the interface bring-up
	  and the application is rebooted. Typically the interface goes active within
	  a few seconds of registering to the network.

	  The current situation that has been observed to cause this is the IP address
	  being assigned to a PDP context other than 0, which the network stack
	  integration fails to handle.

config INFUSE_NRF_MODEM_MONITOR_DEFAULT_PDP_APN
	string "Default APN to use for PDP context 0"
	depends on KV_STORE_KEY_LTE_PDP_CONFIG
	default ""
	help
	  The default APN to use for PDP context 0, if it has not been set to
	  some other value in the KV store key. If set to the empty string,
	  the APN is only set if the KV slot has been explicitly written to.

config INFUSE_NRF_MODEM_MONITOR_DEFAULT_PDP_APN_SET
	bool
	default y if INFUSE_NRF_MODEM_MONITOR_DEFAULT_PDP_APN != ""

choice INFUSE_NRF_MODEM_MONITOR_DEFAULT_PDP_FAMILY
	prompt "Default protocol family to use for PDP context 0"
	depends on INFUSE_NRF_MODEM_MONITOR_DEFAULT_PDP_APN_SET
	default INFUSE_NRF_MODEM_MONITOR_DEFAULT_PDP_FAMILY_IPV4V6

config INFUSE_NRF_MODEM_MONITOR_DEFAULT_PDP_FAMILY_IPV4
	bool "Internet Protocol"

config INFUSE_NRF_MODEM_MONITOR_DEFAULT_PDP_FAMILY_IPV6
	bool "Internet Protocol version 6"

config INFUSE_NRF_MODEM_MONITOR_DEFAULT_PDP_FAMILY_IPV4V6
	bool "Virtual type of dual IP stack"

config INFUSE_NRF_MODEM_MONITOR_DEFAULT_PDP_FAMILY_NON_IP
	bool "Transfer of non-IP data to external packet data network"

endchoice

choice INFUSE_NRF_MODEM_MONITOR_MOBILITY
	prompt "Mobility mode for nRF modem"
	default INFUSE_NRF_MODEM_MONITOR_MOBILITY_DEFAULT
	help
	  The proprietary %REDMOB command is used to reduce LTE idle mode mobility,
	  such as swapping between cells in stationary use cases. The modem defaults
	  to the 3GPP relaxed monitoring feature if not configured.

config INFUSE_NRF_MODEM_MONITOR_MOBILITY_DEFAULT
	bool "Functionality according to the 3GPP relaxed monitoring feature"
	help
	  Defined in 3GPP TS 36.304 Ch. 5.2.4.12.

config INFUSE_NRF_MODEM_MONITOR_MOBILITY_NORDIC_PROPRIETARY
	bool "Nordic proprietary reduced mobility feature"
	help
	  The main difference between the 3GPP relaxed monitoring feature and the
	  Nordic-proprietary reduced mobility feature is that the 3GPP feature
	  requires support from the network and the Nordic-proprietary feature does
	  not.

config INFUSE_NRF_MODEM_MONITOR_MOBILITY_FULL
	bool "Full measurements for best possible mobility"
	help
	  Disable the 3GPP relaxed monitoring and Nordic-proprietary reduced mobility
	  features.

endchoice

config INFUSE_NRF_MODEM_MONITOR_MOBILITY_VALUE
	int
	default 0 if INFUSE_NRF_MODEM_MONITOR_MOBILITY_DEFAULT
	default 1 if INFUSE_NRF_MODEM_MONITOR_MOBILITY_NORDIC_PROPRIETARY
	default 2 if INFUSE_NRF_MODEM_MONITOR_MOBILITY_FULL

config INFUSE_NRF_MODEM_MONITOR_AT_TIMEOUT_MS
	int "Timeout period for nRF modem AT commands"
	default 100
	help
	  Value used for `nrf_modem_at_sem_timeout_set`.

config INFUSE_NRF_MODEM_DATA_PROFILE_DEFAULT
	int "Default AT%XDATAPRFL value"
	range 0 4
	default 2
	help
	  Explicitly set AT%XDATAPRFL to a value

	  Levels 4 and 3 are meant for devices that can prioritize the time
	  spent on finding service over power consumption. Battery-operated
	  devices should use levels 2, 1, or 0. 2 is the default value used
	  by the modem.

endif

config INFUSE_NRF_MODEM_LIB_SIM
	bool "Basic implementation of nRF modem API for testing"
	depends on NATIVE_BUILD

if INFUSE_NRF_MODEM_LIB_SIM

config LTE_LINK_CONTROL
	default y

config LTE_LC_EDRX_MODULE
	default y
config LTE_LC_PSM_MODULE
	default y
config LTE_LC_MODEM_SLEEP_MODULE
	default y

config INFUSE_NRF_MODEM_MONITOR
	default y

config INFUSE_NRF_MODEM_LIB_SIM_MODEL
	string "Simulated model number"
	default "nRF9151-LACA"

config INFUSE_NRF_MODEM_LIB_SIM_FIRMWARE
	string "Simulated firmware string"
	default "mfw_nrf91x1_2.0.2"

config INFUSE_NRF_MODEM_LIB_SIM_ESN
	string "Simulated electronic serial number"
	default "359404230119999"

config INFUSE_NRF_MODEM_LIB_SIM_IMEI
	string "Simulated IMEI"
	default "359404230110000"

config INFUSE_NRF_MODEM_LIB_SIM_IMSI
	string "Simulated IMSI"
	default "525053090792900"

config INFUSE_NRF_MODEM_LIB_SIM_UICC
	string "Simulated UICC"
	default "8901990000000000000"

endif # INFUSE_NRF_MODEM_LIB_SIM
```

## lib/security/Kconfig
```kconfig
# Infuse-IoT Security

config INFUSE_SECURITY
	bool "Infuse-IoT security"
	depends on MBEDTLS
	depends on PSA_WANT_ALG_HKDF
	depends on PSA_WANT_ALG_CHACHA20_POLY1305
	select CRC
	default y if INFUSE_SDK

if INFUSE_SECURITY

config INFUSE_SECURITY_DEFAULT_NETWORK
	string "Path to yaml file containing default network parameters"
	default "default_network.yaml"

config INFUSE_SECURITY_SECONDARY_REMOTE_ENABLE
	bool "Support a secondary remote in parallel with cloud device key"
	depends on KV_STORE
	help
	  Enable generation of a secondary shared device key. The remote public key
	  used for the secondary device key is stored in KV_KEY_SECONDARY_REMOTE_PUBLIC_KEY.

config INFUSE_SECURITY_SECONDARY_NETWORK_ENABLE
	bool "Generate parameters for a secondary network"

config INFUSE_SECURITY_SECONDARY_NETWORK
	string "Path to yaml file containing secondary network parameters"
	depends on INFUSE_SECURITY_SECONDARY_NETWORK_ENABLE

config INFUSE_SECURITY_CHACHA_KEY_EXPORT
	bool "Enable exporting ChaCha20-Poly1305 symmetric keys"
	depends on ZTEST
	default y if ZTEST
	help
	  DO NOT enable this in production

config INFUSE_SECURITY_TEST_CREDENTIALS
	bool "Use hardcoded test credentials for testing"
	depends on ZTEST
	default y if ZTEST
	help
	  Use hardcoded device ID's and credentials for testing purposes. These
	  credentials have limited access to backend services.

config INFUSE_SECURITY_SKIP_INIT
	bool "Don't initialise the module"
	depends on ZTEST
	help
	  Only use this when tests both don't require any crypto support AND the
	  extra boot time from initialising the keys is problematic for repeatability.

module = INFUSE_SECURITY
module-str = Infuse-IoT security
source "subsys/logging/Kconfig.template.log_config"

endif # INFUSE_SECURITY

rsource "hardware_unique_key/Kconfig"
```

## lib/security/hardware_unique_key/Kconfig
```kconfig
# Infuse IoT Hardware Unique Key configuration

choice INFUSE_HUK_PROVIDER
	prompt "Storage backend for Hardware Unique Key"
	default INFUSE_HUK_TFM
	default INFUSE_HUK_NORDIC_KMU_CC3XX
	default INFUSE_HUK_HWID_HASH

config INFUSE_HUK_TFM
	bool "Hardware Unique Key provisioned by TF-M"
	depends on BUILD_WITH_TFM

config INFUSE_HUK_NORDIC_KMU_CC3XX
	bool "Nordic Key-Management-Unit (KMU) w/ CC3XX"
	depends on DT_HAS_NORDIC_NRF_KMU_ENABLED
	depends on NRF_CC3XX_PLATFORM
	depends on !BUILD_WITH_TFM

config INFUSE_HUK_HWID_HASH
	bool "SHA-256 hash of unique hardware identifier (Least secure)"
	depends on HWINFO

endchoice
```

## lib/states/Kconfig
```kconfig
# Infuse-IoT application states

config INFUSE_APPLICATION_STATES
	bool "Application states"

if INFUSE_APPLICATION_STATES

module = INFUSE_APPLICATION_STATES
module-str = states
source "subsys/logging/Kconfig.template.log_config"

config INFUSE_APPLICATION_STATES_MAX_TIMEOUTS
	int "Maximum number of timeouts that can be pending at a time"
	default 8

endif
```

## samples/crypto/ecdh/testcase.yaml
```yaml
common:
  tags: crypto ecdh
  min_flash: 64
  min_ram: 32
tests:
  crypto.ecdh:
    platform_allow:
      - native_sim
      - mps2/an385
      - nrf52840dk/nrf52840
      - nrf5340dk/nrf5340/cpuapp
    integration_platforms:
      - native_sim
      - mps2/an385
      - nrf52840dk/nrf52840
      - nrf5340dk/nrf5340/cpuapp
    harness: console
    harness_config:
      type: one_line
      regex:
        - "Shared secret:"
```

## samples/epacket/bluetooth_adv/sample.yaml
```yaml
sample:
  description: ePacket Bluetooth advertising sample
  name: Bluetooth advertising
common:
  build_only: true
  required_snippets:
    - infuse
tests:
  sample.epacket.bluetooth_adv:
    tags: bluetooth epacket
    platform_allow:
      - nrf52840dk_nrf52840
    integration_platforms:
      - nrf52840dk_nrf52840
  sample.epacket.bluetooth_adv.sysbuild:
    tags: bluetooth epacket
    sysbuild: true
    platform_allow:
      - nrf5340dk_nrf5340_cpuapp
      - nrf7002dk_nrf5340_cpuapp
      - thingy53_nrf5340_cpuapp
    integration_platforms:
      - nrf5340dk_nrf5340_cpuapp
```

## samples/epacket/udp_bulk_upload/Kconfig
```kconfig
# Increased defaults for bulk uploads

config BULK_UPLOAD_BYTES
	int "Number of payload bytes to uplink (default 1MB)"
	default 1048576

config BULK_UPLOAD_PERIOD
	int "Time between bulk uploads"
	default 60

configdefault HEAP_MEM_POOL_SIZE
	default 200000 if WIFI_NRF700X

source "Kconfig.zephyr"
```

## samples/flash_erase/sample.yaml
```yaml
sample:
  description: Erase onboard flash
  name: Flash Erase

tests:
  sample.flash_erase:
    build_only: true
    required_snippets:
      - infuse
    integration_platforms:
      - nrf52840dk/nrf52840
```
