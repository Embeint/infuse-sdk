## lib/auto/Kconfig
```kconfig
# Infuse-IoT automatic behaviours

config INFUSE_AUTO_BLUETOOTH_CONN_LOG
	bool "Automatically log Bluetooth connection events"
	depends on BT_PERIPHERAL || BT_CENTRAL
	depends on TDF_DATA_LOGGER
	default y

config INFUSE_AUTO_TIME_SYNC_LOG
	bool "Automatically log time sync events"
	depends on INFUSE_EPOCH_TIME
	depends on TDF_DATA_LOGGER
	default y

config INFUSE_AUTO_KV_STATE_OBSERVER
	bool "Automatically set application states based on KV"
	depends on INFUSE_APPLICATION_STATES
	default y

config INFUSE_AUTO_WIFI_CONN_LOG
	bool "Automatically log WiFi connection events"
	depends on WIFI
	depends on TDF_DATA_LOGGER
	default y

config INFUSE_AUTO_CHARGER_TEMPERATURE_CONTROL
	bool "Automatically control charging state based on temperature"
	depends on DT_HAS_EMBEINT_GPIO_CHARGER_CONTROL_ENABLED
	depends on INFUSE_ZBUS_CHAN_AMBIENT_ENV
	depends on TDF_DATA_LOGGER
	default y

if INFUSE_AUTO_CHARGER_TEMPERATURE_CONTROL

module = CHARGER_CONTROL
module-str = charger control
source "subsys/logging/Kconfig.template.log_config"

endif # INFUSE_AUTO_CHARGER_TEMPERATURE_CONTROL

config INFUSE_AUTO_BATTERY_CHARGE_ACCUMULATOR
	bool "Automatically accumulate battery charge over time"
	depends on ZBUS_CHANNEL_PUBLISH_STATS
	depends on INFUSE_ZBUS_CHAN_BATTERY
```

## lib/crypto/Kconfig
```kconfig
# Crypto library configuration

config PSA_CRYPTO_DRIVER_OBERON
	# The Oberon driver is required to provide HKDF needed for protected storage and builtin keys
	prompt "Oberon PSA driver" if !TFM_PARTITION_PROTECTED_STORAGE
	bool
	depends on SOC_FAMILY_NORDIC_NRF
	default y
	help
	  This configuration enables the usage of the Oberon PSA driver.

config CRYPTO_ASCON
	bool "ASCON lightweight cryptographic algorithms"
	help
	  Ascon is a family of lightweight cryptographic algorithms and consists of:
	  - Authenticated encryption schemes with associated data (AEAD)
	  - Hash functions (HASH) and extendible output functions (XOF)
	  - Pseudo-random functions (PRF) and message authentication codes (MAC)
	  More information can be found here: https://ascon.iaik.tugraz.at/

if CRYPTO_ASCON

config CRYPTO_ASCON_INLINE_MODE
	bool
	default y if (CRYPTO_ASCON_128 && CRYPTO_ASCON_128A) || \
		(CRYPTO_ASCON_128 && CRYPTO_ASCON_80PQ) || \
		(CRYPTO_ASCON_80PQ && CRYPTO_ASCON_128A)
	help
	  Due to naming conflicts inline mode is required when multiple algorithms
	  are selected. This results in significantly larger binaries and slightly
	  slower implementations

config CRYPTO_ASCON_IMPL
	string "ASCON implementation"
	default "armv7m_small" if ARMV7_M_ARMV8_M_MAINLINE
	default "ref"
	help
	  Valid options are "ref", "armv7m", "armv7m_lowsize", "armv7m_small".
	  Additional implementations require updates to ascon library.
	  See samples/crypto/profiling for size and performance comparisons.

config CRYPTO_ASCON_128
	bool "ascon-128"
	help
	  6 rounds, 64bit data rate.
	  Higher robustness in case of state recovery.

config CRYPTO_ASCON_128A
	bool "ascon-128a"
	help
	  8 rounds, 128bit data rate.
	  33% more performance due to larger data rate.

config CRYPTO_ASCON_80PQ
	bool "ascon-80pq"
	help
	  Post-Quantum variant, increased key size of 160 bits.

endif # CRYPTO_ASCON

config CRYPTO_XOODYAK
	bool "Xoodyak lightweight cryptographic algorithms"
	help
	  Xoodyak is a family of lightweight cryptographic algorithms.
	  More information can be found here: https://keccak.team/keccak.html

if CRYPTO_XOODYAK

config CRYPTO_XOODYAK_OPTIMIZED_ARM
	bool
	depends on ARMV7_M_ARMV8_M_MAINLINE || ARMV6_M_ARMV8_M_BASELINE
	default y

endif
```

## lib/crypto/hardware_unique_key/Kconfig
```kconfig
# Infuse IoT Hardware Unique Key configuration

choice INFUSE_HUK_PROVIDER
	prompt "Storage backend for Hardware Unique Key"
	default INFUSE_HUK_HWID_HASH

config INFUSE_HUK_HWID_HASH
	bool "SHA-256 hash of unique hardware identifier (Least secure)"
	depends on HWINFO

endchoice
```

## lib/debug/Kconfig
```kconfig
# Infuse-IoT debugging options

config INFUSE_WORKQUEUE_BLOCK_TEST
	bool "Randomly block the system and Infuse-IoT workqueue"
	select INFUSE_WORKQ
	help
	  Randomly block the system and Infuse-IoT workqueue for non-trivial
	  durations to see whether the application recovers or whether it
	  deadlocks.

if INFUSE_WORKQUEUE_BLOCK_TEST

config WORKQUEUE_BLOCK_PERIODICITY_MIN_MS
	int "Minimium milliseconds between workqueue blocks"
	default 2000

config WORKQUEUE_BLOCK_PERIODICITY_MAX_MS
	int "Maximum milliseconds between workqueue blocks"
	default 3000

config WORKQUEUE_BLOCK_DURATION_MIN_MS
	int "Minimium milliseconds of workqueue blocks"
	default 500

config WORKQUEUE_BLOCK_DURATION_MAX_MS
	int "Maximum milliseconds of workqueue blocks"
	default 1000

endif # INFUSE_WORKQUEUE_BLOCK_TEST
```

## lib/math/Kconfig
```kconfig
# Infuse-IoT math libraries

config INFUSE_MATH
	bool "Infuse-IoT math libraries"
	default y if INFUSE_SDK

if INFUSE_MATH

config INFUSE_MATH_GEODESY
	bool "Geodesic functions"
	select CMSIS_DSP
	select CMSIS_DSP_FASTMATH

config INFUSE_MATH_HAMMING
	bool "Hamming 8-4 error correcting codes"

endif # INFUSE_MATH
```

## lib/memfault/Kconfig
```kconfig
# Infuse-IoT Memfault configuration

config INFUSE_MEMFAULT
	bool "Infuse-IoT integration with Memfault"
	depends on MEMFAULT
	depends on INFUSE_COMMON_BOOT
	default y

if INFUSE_MEMFAULT

config MEMFAULT_INFUSE_SOFTWARE_TYPE
	string "Software type to report to Memfault"
	default INFUSE_APPLICATION_NAME

config MEMFAULT_INFUSE_HARDWARE_VERSION
	string "Hardware version to report to Memfault"
	default "$(BOARD)_$(BOARD_REVISION)$(BOARD_QUALIFIERS)" if "$(BOARD_REVISION)" != ""
	default BOARD_TARGET
	help
	  The Memfault Cloud does not accept '@' characters in the hardware version,
	  so replace with an '_'.

config MEMFAULT_INFUSE_CONFIG
	bool "Use Infuse-IoT configuration files"
	depends on MEMFAULT_METRICS || MEMFAULT_INFUSE_SECURE_FAULT_KNOWLEDGE
	default y

config MEMFAULT_INFUSE_SECURE_FAULT_KNOWLEDGE
	bool "Inject knowledge about secure faults to Memfault on boot"
	depends on ARM
	depends on !SIMPLIFIED_EXCEPTION_CODES
	default y if TFM_PLATFORM_FAULT_INFO_QUERY
	help
	  Memfault has no way of detecting secure faults by itself.
	  When enabled, use Infuse-IoT's fault handling knowledge to
	  provide the fault information to Memfault if the reboot was
	  caused by a secure fault.

if MEMFAULT_INFUSE_CONFIG && MEMFAULT_METRICS

config MEMFAULT_INFUSE_METRICS_BATTERY
	bool "Battery metrics from Infuse-IoT zbus channel"
	depends on INFUSE_ZBUS_CHAN_BATTERY
	default y

config MEMFAULT_INFUSE_METRICS_CONNECTIVITY_L4
	bool "Track the L4 network connected time"
	depends on NET_MGMT_EVENT
	default y

config MEMFAULT_INFUSE_METRICS_EPACKET_UDP
	bool "Networking metrics from the ePacket UDP interface"
	depends on EPACKET_INTERFACE_UDP
	default y

config MEMFAULT_INFUSE_NRF_MODEM
	bool
	help
	  nRF91x modem related metrics collection

config MEMFAULT_INFUSE_METRICS_NRF_MODEM
	bool "nRF91x modem metrics"
	depends on LTE_LINK_CONTROL
	depends on INFUSE_NRF_MODEM_MONITOR
	select MEMFAULT_INFUSE_NRF_MODEM
	default y

choice MEMFAULT_INFUSE_METRICS_CONNECTIVITY
	prompt "Select the platform implementation for capturing connected time metric"
	default MEMFAULT_INFUSE_METRICS_CONNECTIVITY_NRF_MODEM if LTE_LINK_CONTROL

config MEMFAULT_INFUSE_METRICS_CONNECTIVITY_NRF_MODEM
	bool "Capture connected time metric on nRF91x platforms"
	depends on LTE_LINK_CONTROL
	select MEMFAULT_INFUSE_NRF_MODEM
	select MEMFAULT_PLATFORM_METRICS_CONNECTIVITY_BOOT

endchoice # MEMFAULT_INFUSE_METRICS_CONNECTIVITY

choice MEMFAULT_INFUSE_METRICS_SYNC_SUCCESS
	prompt "Select the platform implementation for capturing sync success metric"
	depends on MEMFAULT_METRICS_SYNC_SUCCESS
	default MEMFAULT_INFUSE_METRICS_SYNC_SUCCESS_EPACKET_UDP if EPACKET_INTERFACE_UDP

config MEMFAULT_INFUSE_METRICS_SYNC_SUCCESS_EPACKET_UDP
	bool "ePacket UDP sync success metric"
	depends on EPACKET_INTERFACE_UDP
	help
	  Sync success is defined as receiving a packet from the cloud services.
	  Sync failure is defined as dropping the connection due to no packets.

endchoice # MEMFAULT_INFUSE_METRICS_SYNC_SUCCESS

endif # MEMFAULT_INFUSE_CONFIG && MEMFAULT_METRICS

endif # INFUSE_MEMFAULT
```

## lib/modem_monitor/Kconfig
```kconfig
# Modem monitor configuration

config INFUSE_MODEM_MONITOR
	bool

if INFUSE_MODEM_MONITOR

module = INFUSE_MODEM_MONITOR
module-str = modem_mon
source "subsys/logging/Kconfig.template.log_config"

config INFUSE_MODEM_MONITOR_CONN_STATE_LOG
	bool "Automatic logging of LTE connection state"
	depends on INFUSE_EPOCH_TIME
	depends on TDF_DATA_LOGGER
	help
	  Automatically log TDF_LTE_CONN_STATUS TDFs in response to registration
	  state and cell tower changes. Output loggers must be configured with
	  `lte_modem_monitor_network_state_log`.

config INFUSE_MODEM_MONITOR_CONNECTIVITY_TIMEOUT_SEC
	int "Timeout for receiving L4 connectivity after registering on the network"
	default 120
	help
	  Once registered to a LTE network (home or roaming), the Zephyr networking
	  stack still needs to receive an IP address before considering the interface
	  active. If the interface is not considered active within this time period,
	  the assumption is that something has gone wrong with the interface bring-up
	  and the application is rebooted. Typically the interface goes active within
	  a few seconds of registering to the network.

	  The current situation that has been observed to cause this is the IP address
	  being assigned to a PDP context other than 0, which the network stack
	  integration fails to handle.

config INFUSE_MODEM_MONITOR_DEFAULT_PDP_APN
	string "Default APN to use for PDP context 0"
	depends on KV_STORE_KEY_LTE_PDP_CONFIG
	default ""
	help
	  The default APN to use for PDP context 0, if it has not been set to
	  some other value in the KV store key. If set to the empty string,
	  the APN is only set if the KV slot has been explicitly written to.

config INFUSE_MODEM_MONITOR_DEFAULT_PDP_APN_SET
	bool
	default y if INFUSE_MODEM_MONITOR_DEFAULT_PDP_APN != ""

choice INFUSE_MODEM_MONITOR_DEFAULT_PDP_FAMILY
	prompt "Default protocol family to use for PDP context 0"
	depends on INFUSE_MODEM_MONITOR_DEFAULT_PDP_APN_SET
	default INFUSE_MODEM_MONITOR_DEFAULT_PDP_FAMILY_IPV4 if MODEM_CELLULAR
	default INFUSE_MODEM_MONITOR_DEFAULT_PDP_FAMILY_IPV4V6

config INFUSE_MODEM_MONITOR_DEFAULT_PDP_FAMILY_IPV4
	bool "Internet Protocol"

config INFUSE_MODEM_MONITOR_DEFAULT_PDP_FAMILY_IPV6
	bool "Internet Protocol version 6"

config INFUSE_MODEM_MONITOR_DEFAULT_PDP_FAMILY_IPV4V6
	bool "Virtual type of dual IP stack"

config INFUSE_MODEM_MONITOR_DEFAULT_PDP_FAMILY_NON_IP
	bool "Transfer of non-IP data to external packet data network"

endchoice

endif # INFUSE_MODEM_MONITOR

rsource "modem_cellular/Kconfig"
rsource "modem_nrf9x/Kconfig"
```

## lib/modem_monitor/modem_cellular/Kconfig
```kconfig
# Cellular Modem monitor configuration

config INFUSE_CELLULAR_MODEM_MONITOR
	bool "Infuse-IoT integration with Cellular Modems"
	depends on KV_STORE
	depends on MODEM_CELLULAR
	depends on INFUSE_REBOOT
	# select MODEM_CELLULAR_SUSPEND_ASYNC
	select INFUSE_MODEM_MONITOR
	select INFUSE_WORKQ
	imply MODEM_CELLULAR_CUSTOM_FAILURE_HANDLING
	default y

config INFUSE_CELLULAR_MODEM_MONITOR_INIT_PRIORITY
	int "Cellular modem integration initialisation priority"
	depends on INFUSE_CELLULAR_MODEM_MONITOR
	default 11
	help
	  Must be later than INFUSE_COMMON_BOOT_INIT_PRIORITY to ensure
	  default PDP configuration applies to KV store if the common init
	  resets the KV store.
```

## lib/modem_monitor/modem_nrf9x/Kconfig
```kconfig
# nRF9x Modem monitor configuration

config INFUSE_NRF_MODEM_MONITOR
	bool "Infuse-IoT integration with Nordic LTE modem"
	depends on NRF_MODEM_LIB
	depends on LTE_LINK_CONTROL
	depends on KV_STORE
	select LTE_LC_EDRX_MODULE
	select LTE_LC_PSM_MODULE
	select LTE_LC_MODEM_SLEEP_MODULE
	select INFUSE_MODEM_MONITOR
	select INFUSE_WORKQ
	default y

if INFUSE_NRF_MODEM_MONITOR

choice INFUSE_NRF_MODEM_MONITOR_MOBILITY
	prompt "Mobility mode for nRF modem"
	default INFUSE_NRF_MODEM_MONITOR_MOBILITY_DEFAULT
	help
	  The proprietary %REDMOB command is used to reduce LTE idle mode mobility,
	  such as swapping between cells in stationary use cases. The modem defaults
	  to the 3GPP relaxed monitoring feature if not configured.

config INFUSE_NRF_MODEM_MONITOR_MOBILITY_DEFAULT
	bool "Functionality according to the 3GPP relaxed monitoring feature"
	help
	  Defined in 3GPP TS 36.304 Ch. 5.2.4.12.

config INFUSE_NRF_MODEM_MONITOR_MOBILITY_NORDIC_PROPRIETARY
	bool "Nordic proprietary reduced mobility feature"
	help
	  The main difference between the 3GPP relaxed monitoring feature and the
	  Nordic-proprietary reduced mobility feature is that the 3GPP feature
	  requires support from the network and the Nordic-proprietary feature does
	  not.

config INFUSE_NRF_MODEM_MONITOR_MOBILITY_FULL
	bool "Full measurements for best possible mobility"
	help
	  Disable the 3GPP relaxed monitoring and Nordic-proprietary reduced mobility
	  features.

endchoice

config INFUSE_NRF_MODEM_MONITOR_MOBILITY_VALUE
	int
	default 0 if INFUSE_NRF_MODEM_MONITOR_MOBILITY_DEFAULT
	default 1 if INFUSE_NRF_MODEM_MONITOR_MOBILITY_NORDIC_PROPRIETARY
	default 2 if INFUSE_NRF_MODEM_MONITOR_MOBILITY_FULL

config INFUSE_NRF_MODEM_MONITOR_AT_TIMEOUT_MS
	int "Timeout period for nRF modem AT commands"
	default 100
	help
	  Value used for `nrf_modem_at_sem_timeout_set`.

config INFUSE_NRF_MODEM_DATA_PROFILE_DEFAULT
	int "Default AT%XDATAPRFL value"
	range 0 4
	default 2
	help
	  Explicitly set AT%XDATAPRFL to a value

	  Levels 4 and 3 are meant for devices that can prioritize the time
	  spent on finding service over power consumption. Battery-operated
	  devices should use levels 2, 1, or 0. 2 is the default value used
	  by the modem.

endif

config INFUSE_NRF_MODEM_LIB_SIM
	bool "Basic implementation of nRF modem API for testing"
	depends on NATIVE_BUILD || QEMU_TARGET

if INFUSE_NRF_MODEM_LIB_SIM

config LTE_LINK_CONTROL
	default y

config LTE_LC_EDRX_MODULE
	default y
config LTE_LC_PSM_MODULE
	default y
config LTE_LC_MODEM_SLEEP_MODULE
	default y

config INFUSE_NRF_MODEM_MONITOR
	select INFUSE_MODEM_MONITOR
	default y

config INFUSE_NRF_MODEM_LIB_SIM_MODEL
	string "Simulated model number"
	default "nRF9151-LACA"

config INFUSE_NRF_MODEM_LIB_SIM_FIRMWARE
	string "Simulated firmware string"
	default "mfw_nrf91x1_2.0.2"

config INFUSE_NRF_MODEM_LIB_SIM_ESN
	string "Simulated electronic serial number"
	default "359404230119999"

config INFUSE_NRF_MODEM_LIB_SIM_IMEI
	string "Simulated IMEI"
	default "359404230110000"

config INFUSE_NRF_MODEM_LIB_SIM_IMSI
	string "Simulated IMSI"
	default "525053090792900"

config INFUSE_NRF_MODEM_LIB_SIM_UICC
	string "Simulated UICC"
	default "8901990000000000000"

endif # INFUSE_NRF_MODEM_LIB_SIM
```
