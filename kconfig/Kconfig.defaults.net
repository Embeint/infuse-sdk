## kconfig/Kconfig.defaults.net
```kconfig
# Infuse-IoT SDK networking defaults
#
# Copyright (c) 2025 Embeint Holdings Pty Ltd
# SPDX-License-Identifier: FSL-1.1-ALv2

DT_CHOSEN_Z_WIFI := zephyr,wifi

config INFUSE_SDK_NETWORKING
	bool "Infuse-IoT SDK Networking defaults"
	depends on NETWORKING
	default y if INFUSE_SDK

if INFUSE_SDK_NETWORKING

configdefault WIFI
	default y if $(dt_chosen_enabled,$(DT_CHOSEN_Z_WIFI))

# LTE Modem
if $(dt_alias_enabled,modem)
configdefault MODEM
	default y
configdefault MODEM_CELLULAR
	default y
configdefault MODEM_MODULES
	default y
configdefault MODEM_DEDICATED_WORKQUEUE
	default y
configdefault MODEM_AT_USER_PIPE
	default y
configdefault NET_DRIVERS
	default y
configdefault NET_L2_PPP
	default y
configdefault NET_L2_PPP_OPTION_DNS_USE
	default y
endif # $(dt_alias_enabled,modem)

if WIFI

# Reduce the default priority to prevent blocking other threads
# during crypto operations
configdefault WIFI_NM_WPA_SUPPLICANT_PRIO
	default 6

endif # WIFI

# Core Protocols
configdefault NET_UDP
	default y
configdefault NET_IPV4
	default y
configdefault NET_IPV6
	# Disabled due to IPV6 addresses not being removed on network down
	default n if !NRF_MODEM_LIB

configdefault NET_MAX_CONN
	# DNS + SNTP + UDP + WPA_SUPP consume the default 4
	default 6

# Native DNS support (not needed for offloaded `getaddrinfo`)
if !NRF_MODEM_LIB
configdefault DNS_RESOLVER
	default y
configdefault DNS_SERVER_IP_ADDRESSES
	default y
configdefault DNS_SERVER1
	default "1.1.1.1"
configdefault DNS_SERVER2
	default "1.0.0.1"
configdefault DNS_NUM_CONCUR_QUERIES
	# Both libraries do DNS queries immediately upon connection
	default 2 if SNTP_AUTO && EPACKET_INTERFACE_UDP
endif

# SNTP time sync
configdefault SNTP
	default y
configdefault SNTP_AUTO
	default y

# IP assignment
configdefault NET_DHCPV4
	default y

# Sockets
configdefault NET_SOCKETS
	default y

# Infuse-IoT COAP
configdefault COAP
	default y
configdefault INFUSE_COAP
	default y
if INFUSE_COAP && !NRF_MODEM_LIB
configdefault TLS_CREDENTIALS
	default y
configdefault NET_SOCKETS_SOCKOPT_TLS
	default y
configdefault NET_SOCKETS_ENABLE_DTLS
	default y
configdefault MBEDTLS_KEY_EXCHANGE_PSK_ENABLED
	default y
configdefault PSA_WANT_KEY_TYPE_ECC_PUBLIC_KEY
	default y if !BUILD_WITH_TFM
configdefault PSA_WANT_ALG_TLS12_PSK_TO_MS
	default y
configdefault PSA_WANT_ALG_TLS12_PRF
	default y
configdefault PSA_WANT_ALG_ECDSA
	default y if !BUILD_WITH_TFM
configdefault PSA_WANT_ALG_JPAKE
	default y if !BUILD_WITH_TFM
endif # INFUSE_COAP && !NRF_MODEM_LIB

# Zephyr networking
configdefault NET_CONNECTION_MANAGER
	default y
configdefault NET_CONNECTION_MANAGER_CONNECTIVITY_WIFI_MGMT
	default y if (WIFI_USAGE_MODE_STA || WIFI_USAGE_MODE_STA_AP)
configdefault CONN_MGR_WIFI_KV_STORE
	default y if (WIFI_USAGE_MODE_STA || WIFI_USAGE_MODE_STA_AP)
# Connection manager requires an IP address slot per interface it is trying to track
configdefault NET_IF_MAX_IPV4_COUNT
	default 2 if NRF_MODEM_LIB_NET_IF && WIFI

endif # INFUSE_SDK_NETWORKING

if SHIELD_NRF7002EB || SHIELD_NRF7002EK

configdefault NETWORKING
	default y if !MCUBOOT

endif # SHIELD_NRF7002EB || SHIELD_NRF7002EK
```

## kconfig/Kconfig.defaults.nrf
```kconfig
# Infuse-IoT SDK Nordic defaults
#
# Copyright (c) 2025 Embeint Holdings Pty Ltd
# SPDX-License-Identifier: FSL-1.1-ALv2

if SOC_FAMILY_NORDIC_NRF

configdefault LOG_TIMESTAMP_64BIT
	# GRTC runs at 1Mhz, timestamps rollover after 71 minutes in 32bits
	default y if NRF_GRTC_TIMER

configdefault NRF_CC3XX_PLATFORM
	default y

# Use CC3XX platform
choice MBEDTLS_PSA_CRYPTO_RNG_SOURCE
	default MBEDTLS_PSA_CRYPTO_EXTERNAL_RNG if NRF_CC3XX_PLATFORM
endchoice

# Oberon backend
configdefault NRF_OBERON
	default y if !BUILD_WITH_TFM

# LTE defaults
configdefault AT_MONITOR_HEAP_SIZE
	default 1024 if TASK_RUNNER_TASK_NETWORK_SCAN
	default 512
configdefault NET_IPV6_MLD
	default n if NRF_MODEM_LIB
configdefault NET_IPV6_NBR_CACHE
	default n if NRF_MODEM_LIB
configdefault NRF_MODEM_LIB_NET_IF
	default y
configdefault MODEM_KEY_MGMT
	default y if INFUSE_SECURITY
configdefault NRF_MODEM_LIB_NET_IF_APPLICATION_ERROR_HANDLER
	default y if INFUSE_NRF_MODEM_MONITOR
configdefault NRF_MODEM_LIB_SHMEM_RX_SIZE
	default 12288
configdefault NRF_MODEM_LIB_SHMEM_TX_SIZE
	default 10240
choice NRF_MODEM_LIB_ON_FAULT
	default NRF_MODEM_LIB_ON_FAULT_APPLICATION_SPECIFIC
endchoice
# Sleep mode notifications
configdefault LTE_LC_MODEM_SLEEP_NOTIFICATIONS
	default y
configdefault LTE_LC_MODEM_SLEEP_PRE_WARNING_TIME_MS
	default 500
configdefault LTE_LC_MODEM_SLEEP_NOTIFICATIONS_THRESHOLD_MS
	default 10240

# Default PSM mode
configdefault LTE_PSM_REQ
	default y
# Bits 5 to 1 represent the binary coded timer value.
# Bits 6 to 8 defines the timer value unit for the GPRS timer as follows:
# Bits
# 8 7 6
# 0 0 0  value is incremented in multiples of 2 seconds
# 0 0 1  value is incremented in multiples of 1 minute
# 0 1 0  value is incremented in multiples of decihours
# 1 1 1  value indicates that the timer is deactivated.
configdefault LTE_PSM_REQ_RAT
	default "00000001"
# Bits 5 to 1 represent the binary coded timer value.
# Bits 6 to 8 defines the timer value unit for the GPRS timer as follows:
# Bits
# 8 7 6
# 0 0 0 value is incremented in multiples of 10 minutes
# 0 0 1 value is incremented in multiples of 1 hour
# 0 1 0 value is incremented in multiples of 10 hours
# 0 1 1 value is incremented in multiples of 2 seconds
# 1 0 0 value is incremented in multiples of 30 seconds
# 1 0 1 value is incremented in multiples of 1 minute
# 1 1 0 value is incremented in multiples of 320 hours (NOTE 1)
# 1 1 1 value indicates that the timer is deactivated (NOTE 2).
configdefault LTE_PSM_REQ_RPTAU
	default "00101100"
# When networks don't support PSM natively, use the Nordic proprietary PSM
# feature. Proprietary PSM can be used only in application use cases where
# the device always initiates the data connection. Infuse-IoT satisfies this
# requirement. Currently only supported on the nRF9120 based chips.
configdefault LTE_PROPRIETARY_PSM_REQ
	default y if SOC_NRF9120
# Enable Release Assistance Indication (RAI) support.
# Only supported on the nRF9120 based chips (Modem firmware v2.0.x>=2).
configdefault LTE_LC_RAI_MODULE
	default y if SOC_NRF9120
configdefault LTE_RAI_REQ
	default y if SOC_NRF9120

config NRF_WIFI_LOW_RAM
	bool "nRF Wi-Fi low RAM defaults"
	default y if SRAM_SIZE <= 256

configdefault NRF70_RX_MAX_DATA_SIZE
	# Value is hardcoded in fmac_main when TX is disabled
	default 1004 if !NRF70_DATA_TX

# Lower resource requirements in scan only mode
if NRF70_SCAN_ONLY
configdefault NRF_WIFI_DATA_HEAP_SIZE
	default 8000
configdefault NET_BUF_RX_COUNT
	default 1
configdefault NET_BUF_TX_COUNT
	default 1
configdefault NET_PKT_RX_COUNT
	default 1
configdefault NET_PKT_TX_COUNT
	default 1
configdefault NET_TC_TX_COUNT
	default 1
configdefault NET_MAX_CONTEXTS
	default 1
configdefault NET_TX_STACK_SIZE
	default 1024
configdefault NET_RX_STACK_SIZE
	default 1024
endif # NRF70_SCAN_ONLY

# Limit nRF memory usage to the bare minimum
if NRF_WIFI_LOW_RAM
configdefault NRF_WIFI_IFACE_MTU
	default 576 if !NET_IPV6 # Minimum IPv4 compatible MTU
	default 1280             # Minimum IPv6 compatible MTU
configdefault NRF70_TX_MAX_DATA_SIZE
	# Interface MTU + nRF header sizes
	default 644 if !NET_IPV6
	default 1348
configdefault NRF70_RX_MAX_DATA_SIZE
	# Interface MTU + nRF header sizes
	default 644 if !NET_IPV6
	default 1348
configdefault NRF70_MAX_TX_PENDING_QLEN
	# Disable the limit so packets aren't dropped
	default 32768
configdefault NRF70_RX_NUM_BUFS
	default 6
configdefault NRF70_MAX_TX_TOKENS
	default 6
configdefault NRF70_MAX_TX_AGGREGATION
	default 3
configdefault NRF_WIFI_DATA_HEAP_SIZE
	def_int 8240 if !NET_IPV6
	def_int 16688
	# IPV4 Data plane is (6 + 6) * 644 ~= 8kB
	# IPV6 Data plane is (6 + 6) * 1348 ~= 16kB
endif # NRF_WIFI_LOW_RAM

# WiFi defaults
configdefault NET_L2_ETHERNET
	default y if WIFI_NRF70
configdefault SYSTEM_WORKQUEUE_STACK_SIZE
	default 6144 if WIFI_NRF70 && !NRF70_SCAN_ONLY
configdefault NRF70_RX_NUM_BUFS
	default 32
configdefault NRF_WIFI_DATA_HEAP_SIZE
	# NRF70_RX_MAX_DATA_SIZE * NRF70_RX_NUM_BUFS +
	# NRF70_TX_MAX_DATA_SIZE * NRF70_MAX_TX_TOKENS
	def_int 80000 if !NRF70_SCAN_ONLY
configdefault NET_CONNECTION_MANAGER_MONITOR_STACK_SIZE
	default 4096 if NRF70_STA_MODE
	default 1024 if NRF_MODEM_LIB_NET_IF
configdefault NRF_WIFI_IF_AUTO_START
	default n
configdefault ZVFS_OPEN_MAX
	default 20 if WIFI_NRF70
choice NET_SOCKETPAIR_ALLOCATION_STRATEGY
	default NET_SOCKETPAIR_STATIC
endchoice
choice NRF70_OPER_MODES
	default NRF70_SCAN_ONLY if WIFI_USAGE_MODE_SCAN_ONLY
endchoice

# MbedTLS requirements for WiFi connectivity
configdefault PSA_WANT_KEY_TYPE_AES
	default y if NRF70_STA_MODE
configdefault PSA_WANT_ALG_CMAC
	default y if NRF70_STA_MODE
configdefault PSA_WANT_ALG_ECDH
	default y if NRF70_STA_MODE
configdefault PSA_WANT_ALG_ECDSA
	default y if NRF70_STA_MODE
configdefault MBEDTLS_HASH_ALL_ENABLED
	default y if NRF70_STA_MODE
configdefault MBEDTLS_ECP_C
	default y if NRF70_STA_MODE
configdefault MBEDTLS_ECP_DP_SECP256R1_ENABLED
	default y if NRF70_STA_MODE
configdefault MBEDTLS_ECDH_C
	default y if NRF70_STA_MODE
configdefault MBEDTLS_ECDSA_C
	default y if NRF70_STA_MODE
configdefault MBEDTLS_ECJPAKE_C
	default y if NRF70_STA_MODE && !BUILD_WITH_TFM
configdefault MBEDTLS_CIPHER_AES_ENABLED
	default y if NRF70_STA_MODE
configdefault MBEDTLS_CIPHER_MODE_CTR_ENABLED
	default y if NRF70_STA_MODE

# UART0 is the standard serial port on Nordic boards
configdefault UART_0_NRF_TX_BUFFER_SIZE
	default 1024 if EPACKET_INTERFACE_SERIAL
# UART20 is the standard serial port on Nordic nRF54L boards
configdefault UART_20_NRF_TX_BUFFER_SIZE
	default 1024 if EPACKET_INTERFACE_SERIAL

# If running HCI link over SPI and the Wake line is used, we need
# to account for larger than usual delays while the Bluetooth controller
# is writing to onboard flash while performing a DFU.
configdefault SPI_NRFX_WAKE_TIMEOUT_US
	default 2000 if BT_SPI

# Symbols used by SDK-NRF libraries but not defined upstream
config ZEPHYR_NRF_MODULE
	bool
config SOC_SERIES_NRF71X
	bool
config NORDIC_SECURITY_BACKEND
	bool
config UNITY
	bool
config FOTA_DOWNLOAD
	bool
config DATE_TIME
	bool

endif # SOC_FAMILY_NORDIC_NRF
```

## kconfig/Kconfig.defaults.sensor
```kconfig
# Infuse-IoT SDK sensor defaults
#
# Copyright (c) 2025 Embeint Holdings Pty Ltd
# SPDX-License-Identifier: FSL-1.1-ALv2

configdefault SENSOR
	default y
configdefault INFUSE_IMU
	default y if "$(dt_alias_enabled,imu0)"
configdefault GNSS
	default y if "$(dt_alias_enabled,gnss)"
configdefault FUEL_GAUGE
	default y if "$(dt_alias_enabled,fuel-gauge0)"
configdefault LORA
	default y if "$(dt_alias_enabled,lora0)"

# We want to use UBX messages directly
configdefault GNSS_U_BLOX_NO_API_COMPAT
	default y
configdefault GNSS_U_BLOX_CONSTELLATION_API_COMPAT
	default y

# We want to trigger samples, not run sampling permanently
choice BME280_MODE
	default BME280_MODE_FORCED
endchoice

# Bring SD card init forward so it occurs before data loggers
configdefault SDHC_INIT_PRIORITY
	default 75
configdefault SD_INIT_PRIORITY
	default 76
```

## kconfig/Kconfig.defaults.stm32
```kconfig
# Infuse-IoT SDK STM32 defaults
#
# Copyright (c) 2025 Embeint Holdings Pty Ltd
# SPDX-License-Identifier: FSL-1.1-ALv2

if SOC_FAMILY_STM32

configdefault FLASH_EX_OP_ENABLED
	default y if INFUSE_COMMON_BOOT_DEBUG_PORT_DISABLE
configdefault FLASH_STM32_READOUT_PROTECTION
	default y if INFUSE_COMMON_BOOT_DEBUG_PORT_DISABLE

endif # SOC_FAMILY_STM32
```

## kconfig/Kconfig.defaults.ztest
```kconfig
# Test defaults for Infuse-IoT libraries
#
# Copyright (c) 2025 Embeint Holdings Pty Ltd
# SPDX-License-Identifier: FSL-1.1-ALv2

config INFUSE_TEST_ID
	bool "Use hardcode test ID (0xFFFFFFFFFFFFFFFD)"
	default y if INFUSE_SECURITY_TEST_CREDENTIALS || !INFUSE_SDK
	depends on ZTEST

config INFUSE_REBOOT_RETURN
	bool "Disable FUNC_NOTRETURN on `infuse_reboot`"
	depends on ZTEST || SOC_SERIES_BSIM_NRFXX

if INFUSE_SECURITY || MBEDTLS

configdefault MAIN_STACK_SIZE
	default 2048
configdefault ZTEST_STACK_SIZE
	default 2048
configdefault MBEDTLS_ENTROPY_POLL_ZEPHYR
	default n if NRF_CC3XX_PLATFORM

endif # INFUSE_SECURITY || MBEDTLS

choice MBEDTLS_PSA_ITS_BACKEND
	default MBEDTLS_PSA_ITS_BACKEND_MBEDTLS_FILE if ZTEST
endchoice

configdefault MCUMGR_TRANSPORT_WORKQUEUE_STACK_SIZE
	default 8192 if COVERAGE_GCOV
```

## lib/Kconfig
```kconfig
# Infuse-IoT libraries

config INFUSE_WORKQ
	bool "Enable Infuse-IoT workqueue"
	default y if INFUSE_SDK

config INFUSE_WORKQ_STACK_SIZE
	int "Stack size of the Infuse-IoT workqueue"
	depends on INFUSE_WORKQ
	default 8192 if COVERAGE
	default 2048

config INFUSE_COMMON_BOOT
	bool "Infuse-IoT common boot logic"
	default y if INFUSE_SDK

config INFUSE_REBOOT
	bool "Infuse-IoT reboot logic"
	depends on REBOOT
	depends on HWINFO
	depends on INFUSE_EPOCH_TIME
	depends on RETENTION
	# Cannot use mutexes inside ISRs
	depends on RETENTION_MUTEX_FORCE_DISABLE
	depends on RETAINED_MEM_MUTEX_FORCE_DISABLE

config INFUSE_REBOOT_COMPILE
	bool "Control standard reboot compilation" if ZTEST
	default y if INFUSE_REBOOT
	help
	  Compilation control symbol. Allows enabling INFUSE_REBOOT
	  in tests while stubbing out the implementation.

config INFUSE_EPOCH_TIME
	bool "Infuse-IoT epoch time library"

config INFUSE_EPOCH_TIME_PRINT_ON_SYNC
	bool "Print current time on time sync"
	depends on INFUSE_EPOCH_TIME
	default y

config INFUSE_EPOCH_TIME_PRINT_REF_ON_SYNC
	bool "Print the current reference local time on sync"
	depends on ARCH_POSIX
	default y

config INFUSE_CUSTOM_IDENTIFIERS
	bool "Rely on some other source to supply an implementation of infuse_device_id"
	help
	  Allowing other sources to supply an implementation of infuse_device_id allows for
	  custom storage locations and layouts.

if INFUSE_COMMON_BOOT

config INFUSE_COMMON_BOOT_INIT_PRIORITY
	int "Initialisation priority of the common boot handling"
	default 10

config INFUSE_COMMON_BOOT_AUTO_IMG_CONFIRM
	bool "Automatically confirm a MCUboot image if common boot passes"
	depends on MCUBOOT_IMG_MANAGER
	depends on !BUILD_WITH_TFM
	default y
	help
	  Automatically confirm a MCUboot image if the `infuse_common_boot` function passes
	  without any critical subsystems failing to initialise.

config INFUSE_COMMON_BOOT_DEBUG_PORT_DISABLE
	bool "Automatically disable the debug port"
	depends on SOC_SERIES_NRF52X || SOC_SERIES_NRF54LX || SOC_SERIES_STM32F4X || SOC_SERIES_STM32L4X || SOC_SERIES_STM32G4X
	help
	  Disable the debug access port to the device. Failing to disable the DAP on deployed
	  devices is a critical security risk as it allows adversaries to read arbitrary memory
	  at runtime with simple tooling.

config INFUSE_BOARD_HAS_PUBLIC_BT_ADDRESS
	bool "Board has a public Bluetooth MAC address that should be used"
	depends on HAS_BT_CTLR
	help
	  Use a board provided public Bluetooth MAC address instead of the random static
	  address. The board must implement `infuse_board_public_bt_addr`.

module = INFUSE_COMMON
module-str = infuse
source "subsys/logging/Kconfig.template.log_config"

endif # INFUSE_COMMON_BOOT

rsource "auto/Kconfig"
rsource "crypto/Kconfig"
rsource "debug/Kconfig"
rsource "math/Kconfig"
rsource "memfault/Kconfig"
rsource "modem_monitor/Kconfig"
rsource "security/Kconfig"
rsource "states/Kconfig"
```
