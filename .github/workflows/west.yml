## boards/embeint/bonasus/Kconfig.defconfig
```kconfig
# Copyright (c) 2026 Embeint Inc
# SPDX-License-Identifier: Apache-2.0

if BOARD_BONASUS_NRF54L15_CPUAPP

# Symbols set by the build system, declared for `check_compliance.py`
config BOARD_REVISION_0
	bool
config BOARD_REVISION_1
	bool

configdefault ROM_START_OFFSET
	default 0x800 if BOOTLOADER_MCUBOOT

configdefault LED
	default y

if NETWORKING

# We want to use the UART ASYNC API
configdefault UART_ASYNC_API
	default y
configdefault UART_ASYNC_TX_CACHE_SIZE
	default 64
choice MODEM_BACKEND_UART_IMPL
	default MODEM_BACKEND_UART_ASYNC if BOARD_REVISION_0
	default MODEM_BACKEND_UART_ASYNC_HWFC
endchoice
configdefault UART_00_NRF_TX_BUFFER_SIZE
	default 1536
configdefault UART_00_INTERRUPT_DRIVEN
	default n
endif # NETWORKING

endif # BOARD_BONASUS_NRF54L15_CPUAPP
```

## boards/embeint/bonasus/board.yml
```yaml
board:
  name: bonasus
  full_name: Bonasus CAT1bis LTE Gateway
  vendor: embeint
  socs:
  - name: nrf54l15
  revision:
    format: number
    default: "1"
    revisions:
    - name: "0"
    - name: "1"
```

## boards/embeint/bosanus/Kconfig.bosanus
```kconfig
# Copyright (c) 2026 Embeint Inc
# SPDX-License-Identifier: Apache-2.0

config BOARD_BOSANUS_NRF54L15_CPUAPP
	select SOC_NRF54L15_CPUAPP if BOARD_BOSANUS_NRF54L15_CPUAPP
```

## boards/embeint/bosanus/board.yml
```yaml
board:
  name: bosanus
  full_name: Bosanus CAT1bis LTE Gateway
  vendor: embeint
  socs:
  - name: nrf54l15
  revision:
    format: number
    default: "1"
    revisions:
    - name: "0"
    - name: "1"
```

## boards/embeint/kudu/Kconfig.defconfig
```kconfig
# Copyright (c) 2025 Embeint Inc
# SPDX-License-Identifier: Apache-2.0

if BOARD_KUDU_NRF54L15_CPUAPP

configdefault ROM_START_OFFSET
	default 0x800 if BOOTLOADER_MCUBOOT

if NETWORKING

# Pull-up resistor is missing for SIMDET to work
choice MODEM_CELLULAR_SIM_DETECTION
	default MODEM_CELLULAR_SIM_DETECTION_FORCE_PRESENT
endchoice

# We want to use the UART ASYNC API
configdefault UART_ASYNC_API
	default y
configdefault UART_ASYNC_TX_CACHE_SIZE
	default 64
choice MODEM_BACKEND_UART_IMPL
	default MODEM_BACKEND_UART_ASYNC_HWFC
endchoice
configdefault UART_00_NRF_TX_BUFFER_SIZE
	default 1536
configdefault UART_00_INTERRUPT_DRIVEN
	default n
endif # NETWORKING

endif # BOARD_KUDU_NRF54L15_CPUAPP
```

## boards/waveshare/esp32c6_lcd_1_47/Kconfig
```kconfig
# Copyright (c) 2026 Embeint Holdings Pty Ltd
# SPDX-License-Identifier: FSL-1.1-ALv2

config HEAP_MEM_POOL_ADD_SIZE_BOARD
	default 4096 if BOARD_ESP32C6_LCD_1_47_ESP32C6_HPCORE_FLASH8M
	default 256 if BOARD_ESP32C6_LCD_1_47_ESP32C6_LPCORE_FLASH8M

config DMA
	default y if WS2812_STRIP_UART

config COUNTER
	default y if PM
```

## boards/waveshare/esp32c6_lcd_1_47/Kconfig.esp32c6_lcd_1_47
```kconfig
# Copyright (c) 2026 Embeint Holdings Pty Ltd
# SPDX-License-Identifier: FSL-1.1-ALv2

config BOARD_ESP32C6_LCD_1_47
	select SOC_ESP32C6_HPCORE if BOARD_ESP32C6_LCD_1_47_ESP32C6_HPCORE_FLASH8M
	select SOC_ESP32C6_LPCORE if BOARD_ESP32C6_LCD_1_47_ESP32C6_LPCORE_FLASH8M
```

## boards/waveshare/esp32c6_lcd_1_47/Kconfig.sysbuild
```kconfig
# Copyright (c) 2026 Embeint Holdings Pty Ltd
# SPDX-License-Identifier: FSL-1.1-ALv2

choice BOOT_SIGNATURE_TYPE
	default BOOT_SIGNATURE_TYPE_ECDSA_P256
endchoice
```

## boards/waveshare/esp32c6_lcd_1_47/board.yml
```yaml
# Copyright (c) 2026 Embeint Holdings Pty Ltd
# SPDX-License-Identifier: FSL-1.1-ALv2

board:
  extend: esp32c6_lcd_1_47
  variants:
    - name: flash8m
      qualifier: esp32c6/hpcore
    - name: flash8m
      qualifier: esp32c6/lpcore
```

## boards/waveshare/esp32c6_lcd_1_47/esp32c6_lcd_1_47_hpcore_flash8m_defconfig
```kconfig
# Copyright (c) 2026 Embeint Holdings Pty Ltd
# SPDX-License-Identifier: FSL-1.1-ALv2

CONFIG_CONSOLE=y
CONFIG_SERIAL=y
CONFIG_UART_CONSOLE=y
CONFIG_GPIO=y
```

## drivers/bluetooth/Kconfig
```kconfig
# Copyright (c) 2026 Embeint Holdings Pty Ltd
# SPDX-License-Identifier: FSL-1.1-ALv2

config BT_HCI_CYW43_INFUSE
	bool "CYW43439 Bluetooth HCI over the AIROC shared SPI bus"
	default y
	depends on SOC_FAMILY_RPI_PICO
	depends on BT && WIFI_AIROC && AIROC_WIFI_BUS_SPI && CYW43439
	depends on DT_HAS_EMBEINT_CYW43_BT_HCI_ENABLED
	help
	  Share the initialized AIROC/WHD driver with the onboard Bluetooth
	  controller. Requires the infuse-sdk Wi-Fi/shared-bus and Bluetooth firmware blobs.

if BT_HCI_CYW43_INFUSE

config BT_HCI_CYW43_INIT_PRIORITY
	int "CYW43 HCI device initialization priority"
	range 0 99
	default 81
	help
	  Must be later than WIFI_INIT_PRIORITY. Firmware is loaded at bt_enable.

config BT_HCI_CYW43_RX_STACK_SIZE
	int "Bluetooth receive thread stack size"
	default 2048

config BT_HCI_CYW43_POLL_INTERVAL_MS
	int "Bluetooth receive poll interval in milliseconds"
	range 1 20
	default 4
	help
	  Polling keeps the shared bus awake and wakes the MCU at this interval.
	  Host-wake interrupt-driven reception is not implemented yet.

config BT_HCI_CYW43_RX_PRIORITY
	int "Bluetooth receive thread preemptive priority"
	range 0 NUM_PREEMPT_PRIORITIES
	default 2
	help
	  Prioritize HCI events over application work while allowing higher
	  priority system threads to preempt reception.

config BT_HCI_CYW43_SEND_TIMEOUT_MS
	int "Bluetooth transmit ring wait timeout in milliseconds"
	range 1 10000
	default 1000
	help
	  Bound the time a caller waits for room in the controller transmit ring.

endif
```

## drivers/charger/Kconfig
```kconfig
# Battery charger drivers

# Copyright (c) 2026 Embeint Holdings Pty Ltd
# SPDX-License-Identifier: Apache-2.0

config CHARGER_BQ25798
	bool "TI BQ25798 charger status"
	default y
	depends on DT_HAS_TI_BQ25798_CHARGER_ENABLED
	depends on BQ25798
	depends on CHARGER
	help
	  Enable the charger child device for the TI BQ25798. This device
	  exposes the charge status and charge type reported by the BQ25798.
```

## dts/bindings/bluetooth/embeint,cyw43-bt-hci.yaml
```yaml
# Copyright (c) 2026 Embeint Holdings Pty Ltd
# SPDX-License-Identifier: FSL-1.1-ALv2

description: CYW43439 Bluetooth HCI sharing an initialized AIROC Wi-Fi SPI bus
compatible: "embeint,cyw43-bt-hci"
include: bt-hci.yaml
properties:
  wifi:
    type: phandle
    required: true
    description: The infineon,airoc-wifi device owning the shared SPI bus
  bt-hci-name:
    default: "CYW43439"
  bt-hci-bus:
    default: "spi"
```

## dts/bindings/charger/ti,bq25798-charger.yaml
```yaml
# Copyright (c) 2026 Embeint Holdings Pty Ltd
# SPDX-License-Identifier: Apache-2.0

description: Charger child device for the TI BQ25798

compatible: "ti,bq25798-charger"

on-bus: bq25798

include: base.yaml
```

## lib/crypto/tf-psa-crypto/Kconfig
```kconfig
# Crypto library configuration

config PSA_CRYPTO_DRIVER_OBERON
	# The Oberon driver is required to provide HKDF needed for protected storage and builtin keys
	prompt "Oberon PSA driver" if !TFM_PARTITION_PROTECTED_STORAGE
	bool
	depends on SOC_FAMILY_NORDIC_NRF
	default y
	help
	  This configuration enables the usage of the Oberon PSA driver.

config TF_PSA_CRYPTO_OBERON_ACCELERATOR
	bool "PSA crypto acceleration through the Oberon library"
	depends on NRF_OBERON
	default y
	help
	  The integration does not attempt to accelerate every algorithm supported
	  by Oberon, only those commonly used by Infuse-IoT.

configdefault TF_PSA_CRYPTO_DISPATCH_DIR
	default "$(ZEPHYR_INFUSE_SDK_MODULE_DIR)/lib/crypto/tf-psa-crypto/dispatch" if TF_PSA_CRYPTO_OBERON_ACCELERATOR

configdefault TF_PSA_CRYPTO_DRIVER_CONFIG_FILE
	default "infuse/crypto/tf-psa-crypto/oberon_driver_config.h" if TF_PSA_CRYPTO_OBERON_ACCELERATOR

config TF_PSA_CRYPTO_OBERON_ACCELERATOR_SHA
	bool "Accelerate SHA algorithms"
	depends on TF_PSA_CRYPTO_OBERON_ACCELERATOR
	help
	  Accelerating SHA costs ~2.7kB of ROM if only SHA256 is enabled,
	  or ~10kB if SHA1, SHA224, SHA256, SHA384 and SHA512 are enabled.
	  Accelerated functions also require additional stack.

config TF_PSA_CRYPTO_OBERON_ACCELERATOR_KEY_AGREEMENT
	bool "Accelerate 'key_agreement' for ECDH Curve25519"
	depends on TF_PSA_CRYPTO_OBERON_ACCELERATOR
	help
	  Accelerating this function costs ~2.7kB of ROM as the builtin
	  implementation cannot be removed without significant other
	  functionality extensions.
```

## samples/epacket/udp_bulk_upload/sample.yaml
```yaml
sample:
  description: Bulk data upload test
  name: Bulk data upload
common:
  tags:
    - epacket
    - data_logger
    - imu
    - kv_store
    - logging
    - modem_monitor
    - net
    - reboot
    - rpc
    - security
    - states
    - tdf
    - time
    - watchdog
  build_only: true
  required_snippets:
    - infuse
tests:
  sample.epacket.udp_bulk_upload:
    platform_allow:
      - nrf7002dk/nrf5340/cpuapp
    integration_platforms:
      - nrf7002dk/nrf5340/cpuapp
  sample.epacket.udp_bulk_upload.nrf7002eb:
    sysbuild: true
    platform_allow:
      - thingy53/nrf5340/cpuapp
    extra_args:
      - udp_bulk_upload_SHIELD=nrf7002eb
      - udp_bulk_upload_EXTRA_DTC_OVERLAY_FILE=epacket_udp.overlay
```

## samples/low_power/sample.yaml
```yaml
sample:
  description: Low power application
  name: Low power
common:
  tags:
    - sample
    - epacket
    - kv_store
    - logging
    - mcumgr
    - rpc
    - states
    - tdf
  build_only: true
  required_snippets:
    - infuse
  integration_platforms:
    - nrf52840dk/nrf52840
    - nrf5340dk/nrf5340/cpuapp
    - nrf5340dk/nrf5340/cpuapp/ns
    - nrf54l15dk/nrf54l15/cpuapp
tests:
  sample.low_power: {}
  sample.low_power.rtt:
    filter: CONFIG_HAS_SEGGER_RTT
    required_snippets:
      - rtt
```

## subsys/algorithm_runner/Kconfig
```kconfig
# Infuse-IoT algorithm abstraction

config ALGORITHM_RUNNER
	bool "Infuse-IoT algorithm runner"
	depends on ZBUS_CHANNEL_ID
	select INFUSE_WORKQ

if ALGORITHM_RUNNER

config ALGORITHM_RUNNER_LLEXT_LITTLEFS_LOADER
	bool
	depends on INFUSE_LITTLEFS
	depends on LLEXT
	default y
	help
	  Load LLEXT algorithms dynamically from the Infuse LittleFS
	  filesystem.

config ALGORITHM_RUNNER_MAX_ALGORITHMS
	int "Maximum number of registered algorithms"
	default 8
	range 1 32
	help
	  Maximum number of algorithms that can be registered concurrently.

module = ALGORITHM_RUNNER
module-str = Algorithm Runner
source "subsys/logging/Kconfig.template.log_config"

endif # ALGORITHM_RUNNER

rsource "algorithms/Kconfig"
```
