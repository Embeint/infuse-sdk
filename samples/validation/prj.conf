## CMakeLists.txt
```
# SPDX-License-Identifier: Apache-2.0

cmake_minimum_required(VERSION 3.20.0)

# Infuse-IoT application
if(NOT infuse IN_LIST SNIPPET)
  set(SNIPPET infuse ${SNIPPET} CACHE STRING "" FORCE)
endif()

find_package(Zephyr REQUIRED HINTS $ENV{ZEPHYR_BASE})
project(validation)

target_sources(app PRIVATE
  src/main.c
)
```

## Kconfig
```
# Subsystem enabling

DT_CHOSEN_Z_BT_HCI := zephyr,bt-hci
DT_CHOSEN_Z_WIFI := zephyr,wifi
DT_COMPAT_Z_SDMMC := zephyr,sdmmc-disk
DT_COMPAT_ST_SDMMC := st,stm32-sdmmc

config VALIDATION_DRIVER_TESTS
	bool "Run the longer tests which validate driver behaviour"
	default y
	help
	  Some tests are intended for validating driver implementations as opposed
	  to testing board assembly.

config VALIDATION_NRF70_XO_TUNE
	bool "Run external oscillator calibration"
	depends on $(dt_chosen_enabled,$(DT_CHOSEN_Z_WIFI))
	depends on !NETWORKING

configdefault BT
	default y if $(dt_chosen_enabled,$(DT_CHOSEN_Z_BT_HCI))
configdefault NETWORKING
	default y if $(dt_chosen_enabled,$(DT_CHOSEN_Z_WIFI))
configdefault WIFI
	default y if $(dt_chosen_enabled,$(DT_CHOSEN_Z_WIFI))
configdefault DISK_ACCESS
	default y if $(dt_compat_enabled,$(DT_COMPAT_Z_SDMMC))
	default y if $(dt_compat_enabled,$(DT_COMPAT_ST_SDMMC))
configdefault GNSS
	default y if $(dt_alias_enabled,gnss)
configdefault LORA
	default y if $(dt_alias_enabled,lora0)
configdefault FUEL_GAUGE
	default y if $(dt_alias_enabled,fuel-gauge0)
configdefault INFUSE_VALIDATION_LEDS_GPIO
	default y if $(dt_alias_enabled,led0)
configdefault INFUSE_VALIDATION_LEDS_CONTROLLER
	default y if $(dt_alias_enabled,led-controller0)
configdefault AUDIO
	default y if $(dt_alias_enabled,dmic-dev)
configdefault AUDIO_DMIC
	default y if $(dt_alias_enabled,dmic-dev)
choice NRF70_OPER_MODES
	default NRF70_RADIO_TEST if VALIDATION_NRF70_XO_TUNE
endchoice


# Floating point

configdefault FPU
	# nRF70 Wi-Fi libraries are currently hardcoded to software FP
	default n if WIFI_NRF70
	default y if CPU_HAS_FPU
configdefault CBPRINTF_FP_SUPPORT
	default y

# System heap usage

configdefault SYS_HEAP_RUNTIME_STATS
	default y
configdefault SYS_HEAP_ARRAY_SIZE
	default 4

# Larger logging buffer sizes

configdefault LOG_BUFFER_SIZE
	default 4096 if SRAM_SIZE < 256
	default 4096 if NRF_WIFI_LOW_RAM
	default 16384

configdefault SEGGER_RTT_BUFFER_SIZE_UP
	default 4096 if SRAM_SIZE < 256
	default 4096 if NRF_WIFI_LOW_RAM
	default 16384

# Networking options

configdefault NET_CONNECTION_MANAGER_CONNECTIVITY_WIFI_MGMT
	default n
configdefault CONN_MGR_WIFI_KV_STORE
	default n
configdefault SNTP_AUTO
	default n

# GNSS options

config GNSS_VALIDATION_SUPPORTED
	bool
	depends on GNSS_UBX_MODEM || GNSS_NRF9X
	default y

# nRF9x options

configdefault LTE_LC_NEIGHBOR_CELL_MEAS_MODULE
	default y
configdefault NRF_SYS_EVENT
	default y if SOC_NRF9120
configdefault SOC_NRF_FORCE_CONSTLAT
	default y if SOC_NRF9120 && USE_SEGGER_RTT

# Driver configuration

configdefault INFUSE_IMU_SELF_TEST
	default y

choice LORA_MODULE_BACKEND
	default LORA_MODULE_BACKEND_LORA_BASICS_MODEM
endchoice

# Log suppression

configdefault INFUSE_MODEM_MONITOR_LOG_LEVEL
	default 2
configdefault EPACKET_LOG_LEVEL
	default 2
configdefault EPACKET_UDP_LOG_LEVEL
	default 2
configdefault WIFI_NRF70_BUSLIB_LOG_LEVEL
	default 2
configdefault SD_LOG_LEVEL
	default 2
configdefault MODEM_LOG_LEVEL
	default 2
configdefault WIFI_NM_WPA_SUPPLICANT_LOG_LEVEL
	default 2
configdefault AUDIO_DMIC_LOG_LEVEL
	default 2

source "Kconfig.zephyr"
```

## sample.yaml
```
sample:
  description: Hardware validation application
  name: Hardware validation
common:
  tags:
    - validation
    - charger
    - epacket
    - gnss
    - imu
    - kv_store
    - led
    - logging
    - mcumgr
    - modem
    - modem_monitor
    - net
    - rpc
    - security
    - sensor
    - shared_device
    - states
    - tdf
  build_only: true
  required_snippets:
    - infuse
tests:
  sample.validation:
    integration_platforms:
      - auroch/nrf9151/ns
      - kudu/nrf54l15/cpuapp
      - thingy53/nrf5340/cpuapp
      - tauro/nrf9151/ns
      - tauro2/nrf9151/ns
      - nrf54l15tag/nrf54l15/cpuapp
  sample.validation.nrf70_test:
    platform_allow:
      - nrf7002dk/nrf5340/cpuapp
    integration_platforms:
      - nrf7002dk/nrf5340/cpuapp
    extra_configs:
      - CONFIG_NETWORKING=n
      - CONFIG_VALIDATION_NRF70_XO_TUNE=y
```

## prj.conf
```kconfig
CONFIG_INFUSE_SDK=y
CONFIG_INFUSE_VALIDATION=y
CONFIG_INFUSE_COMMON_BOOT=n
CONFIG_DATA_LOGGER=n
CONFIG_SENSOR=y
CONFIG_ASSERT=y
```

## src/main.c
```c
/**
 * @file
 * @copyright 2024 Embeint Holdings Pty Ltd
 * @author Jordan Yates <jordan@embeint.com>
 *
 * SPDX-License-Identifier: FSL-1.1-ALv2
 */

#include <stdio.h>

#include <zephyr/kernel.h>
#include <zephyr/logging/log.h>
#include <zephyr/sys/atomic.h>
#include <zephyr/sys/sys_heap.h>
#include <zephyr/drivers/led.h>

#include <infuse/security.h>
#include <infuse/identifiers.h>
#include <infuse/validation/bluetooth.h>
#include <infuse/validation/button.h>
#include <infuse/validation/core.h>
#include <infuse/validation/die_temp.h>
#include <infuse/validation/disk.h>
#include <infuse/validation/dmic.h>
#include <infuse/validation/env.h>
#include <infuse/validation/imu.h>
#include <infuse/validation/leds.h>
#include <infuse/validation/lora.h>
#include <infuse/validation/pwr.h>
#include <infuse/validation/flash.h>
#include <infuse/validation/gnss.h>
#include <infuse/validation/nrf_modem.h>
#include <infuse/validation/cellular_modem.h>
#include <infuse/validation/wifi.h>
#include <infuse/validation/nrf70_radio_test.h>

#ifdef CONFIG_NRF_MODEM_LIB
#include <modem/nrf_modem_lib.h>
#endif

LOG_MODULE_REGISTER(app, LOG_LEVEL_INF);

static K_SEM_DEFINE(task_complete, 0, INT_MAX);
static atomic_t validators_registered;
static atomic_t validators_passed;
static atomic_t validators_failed;
static atomic_t validators_complete;

#if DT_NODE_HAS_STATUS_OKAY(DT_ALIAS(imu0))
static int imu_validator(void *a, void *b, void *c)
{
	uint8_t imu_tests = VALIDATION_IMU_SELF_TEST;

	if (IS_ENABLED(CONFIG_VALIDATION_DRIVER_TESTS)) {
		imu_tests |= VALIDATION_IMU_DRIVER;
	}
	atomic_inc(&validators_registered);
	if (infuse_validation_imu(DEVICE_DT_GET(DT_ALIAS(imu0)), imu_tests) == 0) {
		atomic_inc(&validators_passed);
	} else {
		atomic_inc(&validators_failed);
	}
	atomic_inc(&validators_complete);
	k_sem_give(&task_complete);
	return 0;
}

K_THREAD_DEFINE(imu_thread, 2048, imu_validator, NULL, NULL, NULL, 5, 0, 0);
#endif /* DT_NODE_HAS_STATUS_OKAY(DT_ALIAS(imu0)) */

#if DT_NODE_HAS_STATUS_OKAY(DT_ALIAS(environmental0))

static void env_validation_run(const struct device *dev)
{
	if (infuse_validation_env(dev, VALIDATION_ENV_DRIVER) == 0) {
		atomic_inc(&validators_passed);
	} else {
		atomic_inc(&validators_failed);
	}
	atomic_inc(&validators_complete);
}

#endif /* DT_NODE_HAS_STATUS_OKAY(DT_ALIAS(environmental0)) */

static int simple_sensor_validator(void *a, void *b, void *c)
{
	if (IS_ENABLED(DT_NODE_HAS_STATUS_OKAY(DT_ALIAS(die_temp0)))) {
		atomic_inc(&validators_registered);
	}
	if (IS_ENABLED(DT_NODE_HAS_STATUS_OKAY(DT_ALIAS(environmental0)))) {
		atomic_inc(&validators_registered);
	}
	if (IS_ENABLED(DT_NODE_HAS_STATUS_OKAY(DT_ALIAS(environmental1)))) {
		atomic_inc(&validators_registered);
	}
	if (IS_ENABLED(DT_NODE_HAS_STATUS_OKAY(DT_ALIAS(fuel_gauge0)))) {
		atomic_inc(&validators_registered);
	}

#if DT_NODE_HAS_STATUS_OKAY(DT_ALIAS(die_temp0))
	if (infuse_validation_die_temperature(DEVICE_DT_GET(DT_ALIAS(die_temp0)),
					      VALIDATION_DIE_TEMP_TEMPERATURE) == 0) {
		atomic_inc(&validators_passed);
	} else {
		atomic_inc(&validators_failed);
	}
	atomic_inc(&validators_complete);
#endif /* DT_NODE_HAS_STATUS_OKAY(DT_ALIAS(die_temp0)) */

#if DT_NODE_HAS_STATUS_OKAY(DT_ALIAS(environmental0))
	env_validation_run(DEVICE_DT_GET(DT_ALIAS(environmental0)));
#endif /* DT_NODE_HAS_STATUS_OKAY(DT_ALIAS(environmental0)) */
#if DT_NODE_HAS_STATUS_OKAY(DT_ALIAS(environmental1))
	env_validation_run(DEVICE_DT_GET(DT_ALIAS(environmental1)));
#endif /* DT_NODE_HAS_STATUS_OKAY(DT_ALIAS(environmental1)) */

#if DT_NODE_HAS_STATUS_OKAY(DT_ALIAS(fuel_gauge0))
	/* Give the fuel gauge a second to settle to steady state */
	k_sleep(K_TIMEOUT_ABS_MS(1000));
	if (infuse_validation_pwr(DEVICE_DT_GET(DT_ALIAS(fuel_gauge0)),
				  VALIDATION_PWR_BATTERY_VOLTAGE | VALIDATION_PWR_BATTERY_CURRENT |
					  VALIDATION_PWR_BATTERY_SOC |
					  VALIDATION_PWR_BATTERY_TEMPERATURE) == 0) {
		atomic_inc(&validators_passed);
	} else {
		atomic_inc(&validators_failed);
	}
	atomic_inc(&validators_complete);
#endif /* DT_NODE_HAS_STATUS_OKAY(DT_ALIAS(environmental1)) */

	k_sem_give(&task_complete);
	return 0;
}

K_THREAD_DEFINE(sensor_thread, 2048, simple_sensor_validator, NULL, NULL, NULL, 5, 0, 0);

#if defined(CONFIG_SPI_NOR)
#define FLASH_COMPAT jedec_spi_nor
#elif defined(CONFIG_FLASH_MSPI_NOR)
#define FLASH_COMPAT jedec_nor
#elif defined(CONFIG_SPI_NAND)
#define FLASH_COMPAT jedec_spi_nand
#endif

#ifdef FLASH_COMPAT
static int flash_validator(void *a, void *b, void *c)
{
	atomic_inc(&validators_registered);
	if (infuse_validation_flash(DEVICE_DT_GET_ONE(FLASH_COMPAT), VALIDATION_FLASH_DRIVER) ==
	    0) {
		atomic_inc(&validators_passed);
	} else {
		atomic_inc(&validators_failed);
	}
	atomic_inc(&validators_complete);
	k_sem_give(&task_complete);
	return 0;
}

K_THREAD_DEFINE(flash_thread, 2048, flash_validator, NULL, NULL, NULL, 5, 0, 0);
#endif /* FLASH_COMPAT */

#if DT_NODE_HAS_STATUS_OKAY(DT_ALIAS(gnss)) && IS_ENABLED(CONFIG_GNSS_VALIDATION_SUPPORTED)
static int gnss_validator(void *a, void *b, void *c)
{
	atomic_inc(&validators_registered);
	if (infuse_validation_gnss(DEVICE_DT_GET(DT_ALIAS(gnss)), VALIDATION_GNSS_POWER_UP) == 0) {
		atomic_inc(&validators_passed);
	} else {
		atomic_inc(&validators_failed);
	}
	atomic_inc(&validators_complete);
	k_sem_give(&task_complete);
	return 0;
}

K_THREAD_DEFINE(gnss_thread, 2048, gnss_validator, NULL, NULL, NULL, 5, 0, 0);
#endif /* DT_NODE_HAS_STATUS_OKAY(DT_ALIAS(gnss)) && IS_ENABLED(CONFIG_GNSS_VALIDATION_SUPPORTED)  \
	*/

#ifdef CONFIG_DISK_DRIVER_SDMMC
static int disk_validator(void *a, void *b, void *c)
{
#ifdef CONFIG_SDMMC_STM32
	const char *const disk = DT_PROP(DT_COMPAT_GET_ANY_STATUS_OKAY(st_stm32_sdmmc), disk_name);
#else
	const char *const disk =
		DT_PROP(DT_COMPAT_GET_ANY_STATUS_OKAY(zephyr_sdmmc_disk), disk_name);
#endif

	atomic_inc(&validators_registered);
	if (infuse_validation_disk(disk, VALIDATION_DISK_DRIVER) == 0) {
		atomic_inc(&validators_passed);
	} else {
		atomic_inc(&validators_failed);
	}
	atomic_inc(&validators_complete);
	k_sem_give(&task_complete);
	return 0;
}

K_THREAD_DEFINE(disk_thread, 2048, disk_validator, NULL, NULL, NULL, 5, 0, 0);
#endif /* CONFIG_DISK_DRIVER_SDMMC */

#if DT_NODE_HAS_STATUS_OKAY(DT_ALIAS(modem))
static int cellular_modem_validator(void *a, void *b, void *c)
{
	const struct device *modem = DEVICE_DT_GET(DT_ALIAS(modem));
	uint8_t tests = VALIDATION_CELLULAR_MODEM_FW_VERSION | VALIDATION_CELLULAR_MODEM_SIM_CARD;

	atomic_inc(&validators_registered);
	if (infuse_validation_cellular_modem(modem, tests) == 0) {
		atomic_inc(&validators_passed);
	} else {
		atomic_inc(&validators_failed);
	}
	atomic_inc(&validators_complete);
	k_sem_give(&task_complete);
	return 0;
}

K_THREAD_DEFINE(cellular_modem_thread, 2048, cellular_modem_validator, NULL, NULL, NULL, 5, 0, 0);
#endif /* DT_NODE_HAS_STATUS_OKAY(DT_ALIAS(modem)) */

#if CONFIG_LORA
static void lora_validation_run(const struct device *dev)
{
	if (infuse_validation_lora(dev, VALIDATION_LORA_TX | VALIDATION_LORA_CAD) == 0) {
		atomic_inc(&validators_passed);
	} else {
		atomic_inc(&validators_failed);
	}
	atomic_inc(&validators_complete);
	k_sem_give(&task_complete);
}

static int lora_validator(void *a, void *b, void *c)
{
	atomic_inc(&validators_registered);
#if DT_NODE_HAS_STATUS_OKAY(DT_ALIAS(lora1))
	atomic_inc(&validators_registered);
	lora_validation_run(DEVICE_DT_GET(DT_ALIAS(lora1)));
#endif
	lora_validation_run(DEVICE_DT_GET(DT_ALIAS(lora0)));
	return 0;
}

K_THREAD_DEFINE(lora_thread, 2048, lora_validator, NULL, NULL, NULL, 5, 0, 0);
#endif /* CONFIG_LORA */

#if CONFIG_AUDIO_DMIC
static int dmic_validator(void *a, void *b, void *c)
{
	const struct device *microphone = DEVICE_DT_GET(DT_ALIAS(dmic_dev));

	atomic_inc(&validators_registered);
	if (infuse_validation_dmic(microphone, VALIDATION_DMIC_POWER_UP |
						       VALIDATION_DMIC_STATISTICAL_SAMPLE) == 0) {
		atomic_inc(&validators_passed);
	} else {
		atomic_inc(&validators_failed);
	}
	atomic_inc(&validators_complete);
	k_sem_give(&task_complete);
	return 0;
}

K_THREAD_DEFINE(dmic_thread, 2048, dmic_validator, NULL, NULL, NULL, 5, 0, 0);
#endif /* CONFIG_AUDIO_DMIC */

#ifdef CONFIG_WIFI
#ifdef CONFIG_NRF70_RADIO_TEST

static int wifi_validator(void *a, void *b, void *c)
{
	const struct device *dev = DEVICE_DT_GET(DT_COMPAT_GET_ANY_STATUS_OKAY(nordic_wlan));

	atomic_inc(&validators_registered);

	if (infuse_validation_nrf70_radio_test(dev, VALIDATION_NRF70_RADIO_TEST_XO_TUNE, 1) == 0) {
		atomic_inc(&validators_passed);
	} else {
		atomic_inc(&validators_failed);
	}

	atomic_inc(&validators_complete);
	k_sem_give(&task_complete);
	return 0;
}

#else

static int wifi_validator(void *a, void *b, void *c)
{
	struct net_if *iface;

	atomic_inc(&validators_registered);

	iface = net_if_get_first_wifi();
	if (iface == NULL) {
		VALIDATION_REPORT_ERROR("SYS", "Failed to retrieve WiFi interface");
		atomic_inc(&validators_failed);
		goto end;
	}

	if (infuse_validation_wifi(iface, VALIDATION_WIFI_POWER_UP | VALIDATION_WIFI_SSID_SCAN) ==
	    0) {
		atomic_inc(&validators_passed);
	} else {
		atomic_inc(&validators_failed);
	}
end:
	atomic_inc(&validators_complete);
	k_sem_give(&task_complete);
	return 0;
}

#endif /* CONFIG_NRF70_RADIO_TEST */

K_THREAD_DEFINE(wifi_thread, 6144, wifi_validator, NULL, NULL, NULL, 5, 0, 0);
#endif /* CONFIG_WIFI */

#ifdef CONFIG_INFUSE_VALIDATION_BUTTON_REQUIRE_MANUAL
static int button_validator(void *a, void *b, void *c)
{
	static const struct gpio_dt_spec button = GPIO_DT_SPEC_GET(DT_ALIAS(sw0), gpios);

	atomic_inc(&validators_registered);

	if (infuse_validation_button(&button, VALIDATION_BUTTON_MODE_BOTH) == 0) {
		atomic_inc(&validators_passed);
	} else {
		atomic_inc(&validators_failed);
	}
	atomic_inc(&validators_complete);
	k_sem_give(&task_complete);
	return 0;
}

K_THREAD_DEFINE(button_thread, 512, button_validator, NULL, NULL, NULL, 5, 0, 0);
#endif /* CONFIG_INFUSE_VALIDATION_BUTTON_REQUIRE_MANUAL */

#ifdef CONFIG_INFUSE_VALIDATION_LEDS_GPIO
#define GET_GPIO_SPEC(gpio_spec) GPIO_DT_SPEC_GET(gpio_spec, gpios)
static int leds_validator(void *a, void *b, void *c)
{
	/* clang-format off */
	const struct gpio_dt_spec leds[] = {
		DT_FOREACH_CHILD_STATUS_OKAY_SEP(DT_PATH(leds), GET_GPIO_SPEC, (,))};
	/* clang-format on */

	atomic_inc(&validators_registered);

	if (infuse_validation_leds_gpio(leds, ARRAY_SIZE(leds), VALIDATION_LEDS_OBSERVE_ONLY) ==
	    0) {
		atomic_inc(&validators_passed);
	} else {
		atomic_inc(&validators_failed);
	}
	atomic_inc(&validators_complete);
	k_sem_give(&task_complete);
	return 0;
}

K_THREAD_DEFINE(leds_thread, 1024, leds_validator, NULL, NULL, NULL, 5, 0, 0);
#endif /* CONFIG_INFUSE_VALIDATION_LEDS_GPIO */

#ifdef CONFIG_INFUSE_VALIDATION_LEDS_CONTROLLER
static int leds_validator(void *a, void *b, void *c)
{
	/* clang-format off */
	const struct led_dt_spec leds[] = {
		DT_FOREACH_CHILD_STATUS_OKAY_SEP(DT_ALIAS(led_controller0), LED_DT_SPEC_GET, (,))};
	/* clang-format on */

	atomic_inc(&validators_registered);

	if (infuse_validation_leds_controller(leds, ARRAY_SIZE(leds),
					      VALIDATION_LEDS_OBSERVE_ONLY) == 0) {
		atomic_inc(&validators_passed);
	} else {
		atomic_inc(&validators_failed);
	}
	atomic_inc(&validators_complete);
	k_sem_give(&task_complete);
	return 0;
}

K_THREAD_DEFINE(leds_thread, 1024, leds_validator, NULL, NULL, NULL, 5, 0, 0);
#endif /* CONFIG_INFUSE_VALIDATION_LEDS_CONTROLLER */

#if DT_NODE_EXISTS(DT_COMPAT_GET_ANY_STATUS_OKAY(embeint_epacket_bt_adv))
static int bt_validator(void *a, void *b, void *c)
{
	atomic_inc(&validators_registered);
	if (infuse_validation_bluetooth(VALIDATION_BLUETOOTH_ADV_TX) == 0) {
		atomic_inc(&validators_passed);
	} else {
		atomic_inc(&validators_failed);
	}
	atomic_inc(&validators_complete);
	k_sem_give(&task_complete);
	return 0;
}

K_THREAD_DEFINE(bt_thread, 2048, bt_validator, NULL, NULL, NULL, 5, 0, 0);
#endif /* DT_NODE_EXISTS(DT_COMPAT_GET_ANY_STATUS_OKAY(embeint_epacket_bt_adv)) */

static int validation_init(void)
{
	int rc;

#if defined(CONFIG_NRF_MODEM_LIB) && !defined(CONFIG_NRF_MODEM_LIB_NET_IF_AUTO_START)
	/* Some crypto functionality depends on the modem being initialised */
	VALIDATION_REPORT_INFO("SYS", "Initialising nRF modem library");
	rc = nrf_modem_lib_init();
	if (rc < 0) {
		VALIDATION_REPORT_ERROR("SYS", "Failed to initialise nRF modem library (%d)", rc);
	}
#endif /* defined(CONFIG_NRF_MODEM_LIB) && !defined(CONFIG_NRF_MODEM_LIB_NET_IF_AUTO_START) */

	rc = infuse_security_init();
	if (rc < 0) {
		VALIDATION_REPORT_ERROR("SYS", "Security init failed");
	}
	return 0;
}

SYS_INIT(validation_init, APPLICATION, 99);

int main(void)
{
	uint64_t device_id = infuse_device_id();

	VALIDATION_REPORT_INFO("SYS", "Starting");
	VALIDATION_REPORT_VALUE("SYS", "INFUSE_ID", "0x%016llx", device_id);

#if DT_NODE_HAS_STATUS_OKAY(DT_ALIAS(charger0))
	/* No API checking, just validate the device initialised correctly */
	const struct device *charger = DEVICE_DT_GET(DT_ALIAS(charger0));

	atomic_inc(&validators_registered);
	VALIDATION_REPORT_INFO("CHARGER", "DEV=%s", charger->name);

	if (device_is_ready(charger)) {
		VALIDATION_REPORT_INFO("CHARGER", "Device ready");
		VALIDATION_REPORT_PASS("CHARGER", "DEV=%s", charger->name);
		atomic_inc(&validators_passed);
	} else {
		VALIDATION_REPORT_ERROR("CHARGER", "Device not ready");
		atomic_inc(&validators_failed);
	}
	atomic_inc(&validators_complete);
#endif /* DT_NODE_HAS_STATUS_OKAY(DT_ALIAS(charger0)) */

	/* Delay to allow other tests to register */
	k_sleep(K_MSEC(10));

#if CONFIG_NRF_MODEM_LIB
	uint8_t nrf_modem_tests = VALIDATION_NRF_MODEM_FW_VERSION | VALIDATION_NRF_MODEM_SIM_CARD;

	if (IS_ENABLED(CONFIG_VALIDATION_DRIVER_TESTS)) {
		nrf_modem_tests |= VALIDATION_NRF_MODEM_LTE_SCAN;
	}
	atomic_inc(&validators_registered);
	if (infuse_validation_nrf_modem(nrf_modem_tests) == 0) {
		atomic_inc(&validators_passed);
	} else {
		atomic_inc(&validators_failed);
	}
	atomic_inc(&validators_complete);
	k_sem_give(&task_complete);
#endif /* CONFIG_NRF_MODEM_LIB */

	for (;;) {
		k_sem_take(&task_complete, K_FOREVER);
		if (validators_registered == validators_complete) {
			break;
		}
	}

#ifdef CONFIG_SYS_HEAP_RUNTIME_STATS
	struct sys_memory_stats heap_stats;
	struct sys_heap **heaps;
	int num_heaps;
	int rc;

	num_heaps = sys_heap_array_get(&heaps);
	for (int i = 0; i < num_heaps; i++) {
		rc = sys_heap_runtime_stats_get(heaps[i], &heap_stats);
		if ((rc != 0) || (heaps[i]->init_bytes == 0)) {
			continue;
		}
		VALIDATION_REPORT_INFO("SYS", "Heap %p= Current %6d Max %6d Size %6d", heaps[i],
				       heap_stats.allocated_bytes, heap_stats.max_allocated_bytes,
				       heaps[i]->init_bytes);
	}

#endif /* CONFIG_SYS_HEAP_RUNTIME_STATS */

	(void)validators_failed;
	if (validators_passed == validators_registered) {
		VALIDATION_REPORT_PASS("SYS", "Complete with %d/%d passed",
				       (int32_t)validators_passed, (int32_t)validators_registered);
	} else {
		VALIDATION_REPORT_ERROR("SYS", "Complete with %d/%d passed",
					(int32_t)validators_passed, (int32_t)validators_registered);
	}

	k_sleep(K_FOREVER);
	return 0;
}
```
