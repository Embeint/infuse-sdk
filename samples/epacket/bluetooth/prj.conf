## CMakeLists.txt
```
# SPDX-License-Identifier: Apache-2.0

cmake_minimum_required(VERSION 3.20.0)

# Infuse-IoT application
if(NOT infuse IN_LIST SNIPPET)
  set(SNIPPET infuse ${SNIPPET} CACHE STRING "" FORCE)
endif()

find_package(Zephyr REQUIRED HINTS $ENV{ZEPHYR_BASE})
project(epacket_bluetooth)

target_sources(app PRIVATE
  src/main.c
)
```

## sample.yaml
```
sample:
  description: ePacket Bluetooth sample
  name: Bluetooth advertising and GATT
common:
  tags:
    - epacket
    - data_logger
    - kv_store
    - logging
    - math
    - mcumgr
    - reboot
    - rpc
    - security
    - states
    - task_runner
    - tdf
    - version
    - watchdog
  build_only: true
  required_snippets:
    - infuse
tests:
  sample.epacket.bluetooth:
    platform_allow:
      - nrf52840dk/nrf52840
    integration_platforms:
      - nrf52840dk/nrf52840
  sample.epacket.bluetooth.sysbuild:
    sysbuild: true
    platform_allow:
      - nrf5340dk/nrf5340/cpuapp
      - nrf7002dk/nrf5340/cpuapp
      - thingy53/nrf5340/cpuapp
    integration_platforms:
      - nrf5340dk/nrf5340/cpuapp
```

## prj.conf
```kconfig
CONFIG_INFUSE_SDK=y
CONFIG_INFUSE_APPLICATION_ID=0x12345678

CONFIG_TASK_RUNNER=y
```

## boards/esp32c6_lcd_1_47_esp32c6_hpcore.overlay
```dts
/* SPDX-License-Identifier: FSL-1.1-ALv2 */

/* The pinned C6 radio driver cannot keep Bluetooth active in light sleep.
 * Retain the PM framework and device PM without entering that system state.
 */
&cpu0 {
	/delete-property/ cpu-power-states;
};
```

## src/main.c
```c
/**
 * @file
 * @copyright 2024 Embeint Holdings Pty Ltd
 * @author Jordan Yates <jordan@embeint.com>
 *
 * SPDX-License-Identifier: FSL-1.1-ALv2
 */

#include <stdio.h>

#include <zephyr/kernel.h>
#include <zephyr/device.h>
#include <zephyr/logging/log.h>
#include <zephyr/net/net_if.h>
#include <zephyr/net/net_mgmt.h>
#include <zephyr/net/wifi_mgmt.h>
#include <zephyr/sys/crc.h>

#include <infuse/fs/kv_store.h>
#include <infuse/fs/kv_types.h>
#include <infuse/version.h>
#include <infuse/epacket/interface.h>
#include <infuse/epacket/packet.h>
#include <infuse/data_logger/high_level/tdf.h>
#include <infuse/tdf/definitions.h>

LOG_MODULE_REGISTER(app, LOG_LEVEL_INF);

static void bt_periph_interface_state(uint16_t max_payload, void *user);

struct epacket_interface_cb bt_periph_interface_cb = {
	.interface_state = bt_periph_interface_state,
};

static void bt_periph_interface_state(uint16_t max_payload, void *user)
{
	ARG_UNUSED(user);

	LOG_INF("BT PERIPH: %d", max_payload);
}

int main(void)
{
	KV_KEY_TYPE(KV_KEY_REBOOTS) reboots;
	const struct device *epacket_bt_adv = DEVICE_DT_GET(DT_NODELABEL(epacket_bt_adv));
	const struct device *epacket_bt_periph = DEVICE_DT_GET(DT_NODELABEL(epacket_bt_peripheral));
	const struct device *epacket_serial = DEVICE_DT_GET(DT_NODELABEL(epacket_serial));
	struct infuse_version version = application_version_get();
	struct tdf_announce_v2 announce = {0};

	(void)KV_STORE_READ(KV_KEY_REBOOTS, &reboots);

	epacket_register_callback(epacket_bt_periph, &bt_periph_interface_cb);

	epacket_receive(epacket_serial, K_FOREVER);
	epacket_receive(epacket_bt_adv, K_FOREVER);

	announce.application = CONFIG_INFUSE_APPLICATION_ID;
	announce.reboots = reboots.count;
	announce.version.major = version.major;
	announce.version.minor = version.minor;
	announce.version.revision = version.revision;
	announce.version.build_num = version.build_num;
	announce.board_crc = crc16_ccitt(0x0000, CONFIG_BOARD_TARGET, strlen(CONFIG_BOARD_TARGET));

	for (;;) {
		announce.uptime = k_uptime_get() / 1000;

		TDF_DATA_LOGGER_LOG(TDF_DATA_LOGGER_BT_ADV | TDF_DATA_LOGGER_BT_PERIPHERAL,
				    TDF_ANNOUNCE_V2, 0, &announce);
		tdf_data_logger_flush(TDF_DATA_LOGGER_BT_ADV | TDF_DATA_LOGGER_BT_PERIPHERAL);
		LOG_INF("Sent announce %d on Advertising and GATT", announce.uptime);

		k_sleep(K_SECONDS(1));
	}
	return 0;
}
```
