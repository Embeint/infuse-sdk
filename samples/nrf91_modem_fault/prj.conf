## CMakeLists.txt
```
# SPDX-License-Identifier: Apache-2.0

cmake_minimum_required(VERSION 3.20.0)

# Infuse-IoT application
if(NOT infuse IN_LIST SNIPPET)
  set(SNIPPET infuse ${SNIPPET} CACHE STRING "" FORCE)
endif()

find_package(Zephyr REQUIRED HINTS $ENV{ZEPHYR_BASE})
project(modem_fault)

target_sources(app PRIVATE
  src/main.c
)
```

## prj.conf
```kconfig
# Demo options
CONFIG_EPACKET_PACKET_SIZE_MAX=1360

CONFIG_INFUSE_SDK=y
CONFIG_INFUSE_WATCHDOG=y

# Only query SNTP when requested
CONFIG_SNTP_AUTO_SYNC_POINTS=y

# Networking defaults
#    LTE-M only
CONFIG_LTE_NETWORK_MODE_LTE_M=y

# Enable console
CONFIG_CONSOLE=y
CONFIG_USE_SEGGER_RTT=y
CONFIG_UART_CONSOLE=y
CONFIG_LOG_BACKEND_RTT=n
CONFIG_RTT_CONSOLE=n
```

## app.overlay
```dts
/ {
	chosen {
		zephyr,console = &rtt0;
	};

	rtt0: rtt_chan0 {
		compatible = "segger,rtt-uart";
		status = "okay";
	};
};
```

## src/main.c
```c
/**
 * @file
 * @copyright 2026 Embeint Inc
 * @author Jordan Yates <jordan@embeint.com>
 *
 * SPDX-License-Identifier: LicenseRef-Embeint
 */

#include <zephyr/kernel.h>
#include <zephyr/logging/log.h>
#include <zephyr/net/conn_mgr_connectivity.h>

LOG_MODULE_REGISTER(app, LOG_LEVEL_INF);

int main(void)
{
	LOG_INF("Enable LTE for first time");
	conn_mgr_all_if_up(false);
	conn_mgr_all_if_connect(false);

	LOG_INF("Waiting 15 seconds to enter shipping mode...");
	k_sleep(K_SECONDS(15));

	LOG_INF("Bring down LTE for shipping mode");
	conn_mgr_all_if_disconnect(false);
	conn_mgr_all_if_down(false);

	int countdown = 65;
	while (countdown > 0) {
		LOG_INF("%d seconds to exit shipping mode", countdown);
		k_sleep(K_SECONDS(5));
		countdown -= 5;
	}

	LOG_INF("Exiting shipping mode");
	conn_mgr_all_if_up(false);
	conn_mgr_all_if_connect(false);

	k_sleep(K_FOREVER);
}
```
