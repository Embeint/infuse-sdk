## CMakeLists.txt
```
# SPDX-License-Identifier: Apache-2.0

cmake_minimum_required(VERSION 3.20.0)

# Infuse-IoT application
if(NOT infuse IN_LIST SNIPPET)
  set(SNIPPET infuse ${SNIPPET} CACHE STRING "" FORCE)
endif()

find_package(Zephyr REQUIRED HINTS $ENV{ZEPHYR_BASE})
project(zperf)

target_sources(app PRIVATE
  src/main.c
)
```

## Kconfig
```
# Disable low power QSPI, gives a few Mbps extra throughput
configdefault NRF70_QSPI_LOW_POWER
	default n

# Ensure we can test 1024 byte packets with nRF70
if NRF_WIFI_LOW_RAM
configdefault NRF_WIFI_IFACE_MTU
	default 1280
configdefault NRF70_TX_MAX_DATA_SIZE
	default 1348
configdefault NRF70_RX_MAX_DATA_SIZE
	default 1348
configdefault NRF_WIFI_DATA_HEAP_SIZE
	def_int 40000
endif

# Picolibc source builds are smaller
choice PICOLIBC_SOURCE
    default PICOLIBC_USE_MODULE
endchoice

# WiFi HaLow is ROM heavy and not CPU limited
choice COMPILER_OPTIMIZATIONS
    default SPEED_OPTIMIZATIONS if !WIFI_MORSEMICRO
endchoice

source "Kconfig.zephyr"
```

## sample.yaml
```
sample:
  description: Network performance measurement tool for Infuse-IoT
  name: infuse_zperf
common:
  tags:
    - net
    - epacket
    - kv_store
    - logging
    - modem_monitor
    - rpc
    - states
    - tdf
  build_only: true
  depends_on:
    - netif
  required_snippets:
    - infuse
  integration_platforms:
    - nrf7002dk/nrf5340/cpuapp
tests:
  sample.net.zperf: {}
```

## prj.conf
```kconfig
CONFIG_INFUSE_SDK=y
CONFIG_NETWORKING=y
CONFIG_NET_ZPERF=y
CONFIG_NET_LOG=y
CONFIG_NET_TCP=y
```

## boards/esp32c6_lcd_1_47_esp32c6_hpcore.overlay
```dts
/* SPDX-License-Identifier: FSL-1.1-ALv2 */

/* The pinned C6 radio driver does not coordinate light-sleep wakeup. */
&cpu0 {
	/delete-property/ cpu-power-states;
};
```

## src/main.c
```c
/**
 * @file
 * @copyright 2025 Embeint Holdings Pty Ltd
 * @author Jordan Yates <jordan@embeint.com>
 *
 * SPDX-License-Identifier: FSL-1.1-ALv2
 */

#include <stdio.h>

#ifdef CONFIG_SOC_NRF5340_CPUAPP
#ifdef CONFIG_CLOCK_CONTROL_NRF
#include <nrfx_clock.h>
#else
#include <nrfx_clock_hfclk.h>
#endif /* CONFIG_CLOCK_CONTROL_NRF */
#endif /* CONFIG_SOC_NRF5340_CPUAPP */

#include <zephyr/kernel.h>
#include <zephyr/logging/log.h>
#include <zephyr/net/conn_mgr_connectivity.h>

#include <infuse/epacket/interface.h>
#include <infuse/epacket/packet.h>

LOG_MODULE_REGISTER(app, LOG_LEVEL_INF);

int main(void)
{
#ifdef CONFIG_SOC_NRF5340_CPUAPP
	/* For optimal performance, the CPU frequency needs to be set to 128 MHz */
#ifdef CONFIG_CLOCK_CONTROL_NRF
	int err;

	err = nrfx_clock_divider_set(NRF_CLOCK_DOMAIN_HFCLK, NRF_CLOCK_HFCLK_DIV_1);
	if (err != 0) {
		LOG_WRN("Failed to set 128 MHz: 0x%08x", err);
	}
#else
	nrfx_clock_hfclk_divider_set(NRF_CLOCK_HFCLK_DIV_1);
#endif /* CONFIG_CLOCK_CONTROL_NRF */
#endif /* CONFIG_SOC_NRF5340_CPUAPP */

#if DT_NODE_HAS_STATUS_OKAY(DT_NODELABEL(epacket_serial))
	const struct device *epacket_serial = DEVICE_DT_GET(DT_NODELABEL(epacket_serial));

	/* Always listening on serial */
	epacket_receive(epacket_serial, K_FOREVER);

	/* Send key identifiers on boot */
	epacket_send_key_ids(epacket_serial, K_FOREVER);
#endif

	/* Always want network connectivity */
	conn_mgr_all_if_up(true);
	conn_mgr_all_if_connect(true);

	/* Loop forever, zperf runs from the RPC context */
	for (;;) {
		LOG_INF("Uptime: %6d seconds", k_uptime_seconds());
		k_sleep(K_SECONDS(1));
	}
	return 0;
}
```
