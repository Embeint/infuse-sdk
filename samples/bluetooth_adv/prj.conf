## sample.yaml
```
sample:
  description: ePacket Bluetooth advertising sample
  name: Bluetooth advertising
common:
  build_only: true
  required_snippets:
    - infuse
tests:
  sample.bluetooth_adv:
    tags: bluetooth
    platform_allow:
      - nrf52840dk_nrf52840
    integration_platforms:
      - nrf52840dk_nrf52840
  sample.bluetooth_adv.sysbuild:
    tags: bluetooth
    sysbuild: true
    platform_allow:
      - nrf5340dk_nrf5340_cpuapp
      - nrf7002dk_nrf5340_cpuapp
      - thingy53_nrf5340_cpuapp
    integration_platforms:
      - nrf5340dk_nrf5340_cpuapp
```

## prj.conf
```kconfig
CONFIG_INFUSE_SDK=y

CONFIG_BT=y
```

## src/main.c
```c
/**
 * @file
 * @copyright 2024 Embeint Inc
 * @author Jordan Yates <jordan@embeint.com>
 *
 * SPDX-License-Identifier: LicenseRef-Embeint
 */

#include <stdio.h>

#include <zephyr/kernel.h>
#include <zephyr/device.h>
#include <zephyr/logging/log.h>
#include <zephyr/net/net_if.h>
#include <zephyr/net/net_mgmt.h>
#include <zephyr/net/wifi_mgmt.h>

#include <infuse/epacket/interface.h>
#include <infuse/epacket/packet.h>
#include <infuse/data_logger/high_level/tdf.h>
#include <infuse/tdf/definitions.h>

LOG_MODULE_REGISTER(app, LOG_LEVEL_INF);

int main(void)
{
	const struct device *tdf_logger_bt_adv = DEVICE_DT_GET(DT_NODELABEL(tdf_logger_bt_adv));
	struct tdf_announce announce;

	for (;;) {
		announce.application = 0x1234;
		announce.reboots = 0;
		announce.uptime = k_uptime_get() / 1000;
		announce.version = (struct tdf_struct_mcuboot_img_sem_ver){
			.major = 1,
			.minor = 2,
			.revision = 3,
			.build_num = 4,
		};

		tdf_data_logger_log_dev(tdf_logger_bt_adv, TDF_ANNOUNCE, (sizeof(announce)), 0,
					&announce);
		tdf_data_logger_flush_dev(tdf_logger_bt_adv);

		LOG_INF("Sent announce %d on %s", announce.uptime, tdf_logger_bt_adv->name);
		k_sleep(K_SECONDS(1));
	}
	return 0;
}
```
