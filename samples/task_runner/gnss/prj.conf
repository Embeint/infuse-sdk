## CMakeLists.txt
```
# SPDX-License-Identifier: Apache-2.0

cmake_minimum_required(VERSION 3.20.0)

# Infuse-IoT application
if(NOT infuse IN_LIST SNIPPET)
  set(SNIPPET infuse ${SNIPPET} CACHE STRING "" FORCE)
endif()

find_package(Zephyr REQUIRED HINTS $ENV{ZEPHYR_BASE})
project(task_runner_gnss)

target_sources(app PRIVATE
  src/main.c
)
```

## sample.yaml
```
sample:
  description: GNSS task runner sample
  name: GNSS task runner
common:
  tags:
    - task_runner
    - auto
    - data_logger
    - epacket
    - gnss
    - imu
    - kv_store
    - logging
    - math
    - mcumgr
    - modem
    - modem_monitor
    - net
    - rpc
    - sensor
    - shared_device
    - states
    - tdf
    - time
    - version
    - watchdog
    - zbus
  filter: dt_alias_exists("gnss")
  build_only: true
  required_snippets:
    - infuse
tests:
  sample.task_runner.gnss:
    integration_platforms:
      - thingy91x/nrf9151/ns
      - tauro/nrf9151/ns
  sample.task_runner.gnss.api_compat:
    integration_platforms:
      - tauro/nrf9151/ns
    extra_configs:
      - CONFIG_GNSS_U_BLOX_NO_API_COMPAT=n
  sample.task_runner.gnss.sparkfun:
    sysbuild: true
    depends_on: arduino_i2c
    integration_platforms:
      - nrf52840dk/nrf52840
    extra_args:
      - task_runner_gnss_SHIELD=sparkfun_sam_m10
```

## prj.conf
```kconfig
# Logger options
CONFIG_INFUSE_SDK=y
CONFIG_INFUSE_WATCHDOG=y

CONFIG_ASSERT=y
CONFIG_GNSS=y

CONFIG_TASK_RUNNER=y
CONFIG_TASK_RUNNER_AUTO_ITERATE=y
CONFIG_TASK_RUNNER_TASK_GNSS=y
CONFIG_TASK_RUNNER_TASK_BATTERY=y
CONFIG_TASK_RUNNER_TASK_TDF_LOGGER=y

CONFIG_TASK_RUNNER_GNSS_SATELLITE_INFO=y

# Disable KV schedule storage for sample to simplify testing
CONFIG_KV_STORE_KEY_TASK_SCHEDULES=n
```

## src/main.c
```c
/**
 * @file
 * @copyright 2024 Embeint Holdings Pty Ltd
 * @author Jordan Yates <jordan@embeint.com>
 *
 * SPDX-License-Identifier: FSL-1.1-ALv2
 */

#include <zephyr/kernel.h>
#include <zephyr/logging/log.h>
#include <zephyr/drivers/sensor.h>
#include <zephyr/pm/device_runtime.h>
#include <zephyr/net/conn_mgr_connectivity.h>
#include <zephyr/drivers/gnss.h>

#include <infuse/drivers/watchdog.h>
#include <infuse/time/epoch.h>
#include <infuse/fs/kv_store.h>
#include <infuse/fs/kv_types.h>
#include <infuse/epacket/interface.h>
#include <infuse/epacket/packet.h>
#include <infuse/data_logger/high_level/tdf.h>
#include <infuse/tdf/definitions.h>
#include <infuse/auto/time_sync_log.h>

#include <infuse/task_runner/runner.h>
#include <infuse/task_runner/tasks/infuse_tasks.h>

LOG_MODULE_REGISTER(app, LOG_LEVEL_INF);

static const struct task_schedule schedules[] = {
	{
		.task_id = TASK_ID_GNSS,
		.validity = TASK_VALID_ALWAYS,
		.periodicity_type = TASK_PERIODICITY_FIXED,
		.timeout_s = 115,
		.periodicity.fixed.period_s = 10,
		.task_logging =
			{
				{
					.loggers = TDF_DATA_LOGGER_SERIAL,
					.tdf_mask = TASK_GNSS_LOG_PVT,
				},
			},
		.task_args.gnss =
			{
				.constellations =
					GNSS_SYSTEM_GPS | GNSS_SYSTEM_QZSS | GNSS_SYSTEM_SBAS,
				.flags = TASK_GNSS_FLAGS_PERFORMANCE_MODE |
					 TASK_GNSS_FLAGS_RUN_FOREVER,
				.accuracy_m = 5,
				.position_dop = 40,
				.dynamic_model = UBX_CFG_NAVSPG_DYNMODEL_PEDESTRIAN,
			},
	},
#if DT_NODE_HAS_STATUS_OKAY(DT_ALIAS(fuel_gauge0))
	{
		.task_id = TASK_ID_BATTERY,
		.validity = TASK_VALID_ALWAYS,
		.periodicity_type = TASK_PERIODICITY_FIXED,
		.periodicity.fixed.period_s = 2,
		.task_logging =
			{
				{
					.loggers = TDF_DATA_LOGGER_SERIAL,
					.tdf_mask = TASK_BATTERY_LOG_COMPLETE,
				},
			},
	},
#endif /* DT_NODE_HAS_STATUS_OKAY(DT_ALIAS(fuel_gauge0)) */
#ifdef CONFIG_BT
	{
		.task_id = TASK_ID_TDF_LOGGER,
		.validity = TASK_VALID_ALWAYS,
		.task_args.tdf_logger =
			{
				.loggers = TDF_DATA_LOGGER_BT_ADV,
				.logging_period_ms = 900,
				.random_delay_ms = 200,
				.tdfs = TASK_TDF_LOGGER_LOG_ANNOUNCE |
					TASK_TDF_LOGGER_LOG_LOCATION | TASK_TDF_LOGGER_LOG_BATTERY,
			},
	},
#endif /* CONFIG_BT */
};

#if DT_NODE_HAS_STATUS_OKAY(DT_ALIAS(fuel_gauge0))
#define BAT_TASK_DEFINE (BATTERY_TASK, DEVICE_DT_GET(DT_ALIAS(fuel_gauge0)))
#else
#define BAT_TASK_DEFINE
#endif /* DT_NODE_HAS_STATUS_OKAY(DT_ALIAS(fuel_gauge0)) */

TASK_SCHEDULE_STATES_DEFINE(states, schedules);
TASK_RUNNER_TASKS_DEFINE(app_tasks, app_tasks_data, (TDF_LOGGER_TASK, NULL), BAT_TASK_DEFINE,
			 (GNSS_TASK, DEVICE_DT_GET(DT_ALIAS(gnss))));

int main(void)
{
	/* Log time sync changes */
	auto_time_sync_log_configure(TDF_DATA_LOGGER_SERIAL, AUTO_TIME_SYNC_LOG_SYNCS);

	/* Start the watchdog */
	(void)infuse_watchdog_start();

	/* Initialise task runner */
	task_runner_init(schedules, states, ARRAY_SIZE(schedules), app_tasks, app_tasks_data,
			 ARRAY_SIZE(app_tasks));

	/* Start auto iteration */
	task_runner_start_auto_iterate();

	/* No more work to do in this context */
	k_sleep(K_FOREVER);
}
```
