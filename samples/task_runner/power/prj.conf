## CMakeLists.txt
```
# SPDX-License-Identifier: Apache-2.0

cmake_minimum_required(VERSION 3.20.0)

# Infuse-IoT application
if(NOT infuse IN_LIST SNIPPET)
  set(SNIPPET infuse ${SNIPPET} CACHE STRING "" FORCE)
endif()

find_package(Zephyr REQUIRED HINTS $ENV{ZEPHYR_BASE})
project(task_runner_imu)

target_sources(app PRIVATE
  src/main.c
)
```

## sample.yaml
```
sample:
  description: Power task runner sample
  name: Power task runner
common:
  tags:
    - task_runner
    - data_logger
    - epacket
    - gnss
    - imu
    - kv_store
    - logging
    - math
    - modem_monitor
    - rpc
    - states
    - tdf
    - time
    - version
    - watchdog
    - zbus
  filter: dt_alias_exists("fuel-gauge0") and dt_chosen_enabled("zephyr,bt-hci")
  build_only: true
  required_snippets:
    - infuse
tests:
  sample.task_runner.power:
    integration_platforms:
      - thingy53/nrf5340/cpuapp
```

## prj.conf
```kconfig
# Logger options
CONFIG_INFUSE_SDK=y
CONFIG_INFUSE_WATCHDOG=y

CONFIG_TASK_RUNNER=y
CONFIG_TASK_RUNNER_AUTO_ITERATE=y
CONFIG_TASK_RUNNER_TASK_TDF_LOGGER=y
CONFIG_TASK_RUNNER_TASK_BATTERY=y

# Disable KV schedule storage for sample to simplify testing
CONFIG_KV_STORE_KEY_TASK_SCHEDULES=n
```

## src/main.c
```c
/**
 * @file
 * @copyright 2025 Embeint Holdings Pty Ltd
 * @author Jordan Yates <jordan@embeint.com>
 *
 * SPDX-License-Identifier: FSL-1.1-ALv2
 */

#include <zephyr/kernel.h>
#include <zephyr/logging/log.h>
#include <zephyr/net/conn_mgr_connectivity.h>
#include <zephyr/drivers/charger.h>

#include <infuse/drivers/watchdog.h>
#include <infuse/time/epoch.h>
#include <infuse/epacket/interface.h>
#include <infuse/epacket/packet.h>
#include <infuse/data_logger/high_level/tdf.h>
#include <infuse/tdf/definitions.h>

#include <infuse/task_runner/runner.h>
#include <infuse/task_runner/tasks/infuse_tasks.h>

LOG_MODULE_REGISTER(app, LOG_LEVEL_INF);

static const struct task_schedule schedules[] = {
	{
		.task_id = TASK_ID_BATTERY,
		.validity = TASK_VALID_ALWAYS,
		.periodicity_type = TASK_PERIODICITY_FIXED,
		.periodicity.fixed.period_s = 2,
		.task_logging =
			{
				{
					.loggers = TDF_DATA_LOGGER_SERIAL | TDF_DATA_LOGGER_BT_ADV,
					.tdf_mask = TASK_BATTERY_LOG_COMPLETE,
				},
			},
	},
#ifdef CONFIG_BT
	{
		.task_id = TASK_ID_TDF_LOGGER,
		.validity = TASK_VALID_ALWAYS,
		.task_args.tdf_logger =
			{
				.loggers = TDF_DATA_LOGGER_BT_ADV,
				.logging_period_ms = 900,
				.random_delay_ms = 250,
				.tdfs = TASK_TDF_LOGGER_LOG_ANNOUNCE,
			},
	},
#endif /* CONFIG_BT */
};

TASK_SCHEDULE_STATES_DEFINE(states, schedules);
TASK_RUNNER_TASKS_DEFINE(app_tasks, app_tasks_data, (TDF_LOGGER_TASK, NULL),
			 (BATTERY_TASK, DEVICE_DT_GET(DT_ALIAS(fuel_gauge0))));

#if DT_NODE_HAS_STATUS_OKAY(DT_ALIAS(charger0))

static const char *const status_names[] = {
	[CHARGER_STATUS_UNKNOWN] = "Unknown",
	[CHARGER_STATUS_CHARGING] = "Charging",
	[CHARGER_STATUS_DISCHARGING] = "Discharging",
	[CHARGER_STATUS_NOT_CHARGING] = "Not charging",
	[CHARGER_STATUS_FULL] = "Full",
};
static const char *const online_names[] = {
	[CHARGER_ONLINE_OFFLINE] = "Not present",
	[CHARGER_ONLINE_FIXED] = "Present (fixed)",
	[CHARGER_ONLINE_PROGRAMMABLE] = "Present (programmable)",
};

static void charger_prop_status(enum charger_status status)
{
	LOG_INF("Charging status: %s", status_names[status]);
}

static void charger_prop_online(enum charger_online online)
{
	LOG_INF("Charger input: %s", online_names[online]);
}

static void charger_callback_setup(void)
{
	const struct device *charger = DEVICE_DT_GET(DT_ALIAS(charger0));
	union charger_propval propval;

	propval.status_notification = charger_prop_status;
	charger_set_prop(charger, CHARGER_PROP_STATUS_NOTIFICATION, &propval);
	propval.online_notification = charger_prop_online;
	charger_set_prop(charger, CHARGER_PROP_ONLINE_NOTIFICATION, &propval);
}

#endif /* DT_NODE_HAS_STATUS_OKAY(DT_ALIAS(charger0)) */

int main(void)
{
	/* Start the watchdog */
	(void)infuse_watchdog_start();

#ifdef CONFIG_NETWORKING
	conn_mgr_all_if_up(true);
	conn_mgr_all_if_connect(true);
#endif /* CONFIG_NETWORKING */

#if DT_NODE_HAS_STATUS_OKAY(DT_ALIAS(charger0))
	charger_callback_setup();
#endif /* DT_NODE_HAS_STATUS_OKAY(DT_ALIAS(charger0)) */

	/* Initialise task runner */
	task_runner_init(schedules, states, ARRAY_SIZE(schedules), app_tasks, app_tasks_data,
			 ARRAY_SIZE(app_tasks));

	/* Start auto iteration */
	task_runner_start_auto_iterate();

	/* No more work to do in this context */
	k_sleep(K_FOREVER);
}
```
