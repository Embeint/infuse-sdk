## CMakeLists.txt
```
# SPDX-License-Identifier: Apache-2.0

cmake_minimum_required(VERSION 3.20.0)

# Infuse-IoT application
if(NOT infuse IN_LIST SNIPPET)
  set(SNIPPET infuse ${SNIPPET} CACHE STRING "" FORCE)
endif()

find_package(Zephyr REQUIRED HINTS $ENV{ZEPHYR_BASE})
project(task_runner_dmic)

target_sources(app PRIVATE
  src/main.c
)
```

## sample.yaml
```
sample:
  description: Digital microphone task runner sample
  name: Digital microphone  task runner
common:
  tags:
    - task_runner
    - data_logger
    - epacket
    - imu
    - kv_store
    - math
    - modem_monitor
    - rpc
    - states
    - tdf
    - time
    - version
    - watchdog
    - zbus
  filter: dt_alias_exists("dmic-dev") and dt_chosen_enabled("zephyr,bt-hci")
  build_only: true
  required_snippets:
    - infuse
tests:
  sample.task_runner.audio_dmic: {}
```

## prj.conf
```kconfig
# Logger options
CONFIG_INFUSE_SDK=y
CONFIG_INFUSE_WATCHDOG=y

CONFIG_AUDIO=y
CONFIG_AUDIO_DMIC=y

CONFIG_TASK_RUNNER=y
CONFIG_TASK_RUNNER_AUTO_ITERATE=y
CONFIG_TASK_RUNNER_TASK_AUDIO_DMIC=y
CONFIG_TASK_RUNNER_TASK_BATTERY=y
CONFIG_TASK_RUNNER_TASK_TDF_LOGGER=y

CONFIG_TASK_AUDIO_DMIC_LOG_LEVEL_DBG=y

# Disable KV schedule storage for sample to simplify testing
CONFIG_KV_STORE_KEY_TASK_SCHEDULES=n
```

## src/main.c
```c
/**
 * @file
 * @copyright 2025 Embeint Holdings Pty Ltd
 * @author Jordan Yates <jordan@embeint.com>
 *
 * SPDX-License-Identifier: FSL-1.1-ALv2
 */

#include <zephyr/kernel.h>
#include <zephyr/logging/log.h>
#include <zephyr/net/conn_mgr_connectivity.h>
#include <zephyr/drivers/charger.h>

#include <infuse/drivers/watchdog.h>
#include <infuse/time/epoch.h>
#include <infuse/epacket/interface.h>
#include <infuse/epacket/packet.h>
#include <infuse/data_logger/high_level/tdf.h>
#include <infuse/tdf/definitions.h>

#include <infuse/task_runner/runner.h>
#include <infuse/task_runner/tasks/infuse_tasks.h>

LOG_MODULE_REGISTER(app, LOG_LEVEL_INF);

static const struct task_schedule schedules[] = {
	{
		.task_id = TASK_ID_AUDIO_DMIC,
		.validity = TASK_VALID_ALWAYS,
		.periodicity_type = TASK_PERIODICITY_LOCKOUT,
		/* Run for 8 seconds every 10 seconds */
		.periodicity.lockout.lockout_s = TASK_RUNNER_LOCKOUT_IGNORE_FIRST | 10,
		.timeout_s = 8,
		.task_args.audio_dmic =
			{
				.sample_rate_hz = 16000,
				.gain_db = 20,
			},
		.task_logging =
			{
				{
					.loggers = TDF_DATA_LOGGER_BT_PERIPHERAL,
					.tdf_mask = TASK_AUDIO_DMIC_LOG_METADATA |
						    TASK_AUDIO_DMIC_LOG_SAMPLES,
				},
			},
	},
#ifdef CONFIG_BT
	{
		.task_id = TASK_ID_TDF_LOGGER,
		.validity = TASK_VALID_ALWAYS,
		.task_args.tdf_logger =
			{
				.loggers = TDF_DATA_LOGGER_BT_ADV,
				.logging_period_ms = 900,
				.random_delay_ms = 250,
				.tdfs = TASK_TDF_LOGGER_LOG_ANNOUNCE,
			},
	},
#endif /* CONFIG_BT */
};

TASK_SCHEDULE_STATES_DEFINE(states, schedules);
TASK_RUNNER_TASKS_DEFINE(app_tasks, app_tasks_data, (TDF_LOGGER_TASK, NULL),
			 (AUDIO_DMIC_TASK, DT_ALIAS(dmic_dev)));

int main(void)
{
	/* Start the watchdog */
	(void)infuse_watchdog_start();

#ifdef CONFIG_NETWORKING
	conn_mgr_all_if_up(true);
	conn_mgr_all_if_connect(true);
#endif /* CONFIG_NETWORKING */

	/* Initialise task runner */
	task_runner_init(schedules, states, ARRAY_SIZE(schedules), app_tasks, app_tasks_data,
			 ARRAY_SIZE(app_tasks));

	/* Start auto iteration */
	task_runner_start_auto_iterate();

	/* No more work to do in this context */
	k_sleep(K_FOREVER);
}
```
