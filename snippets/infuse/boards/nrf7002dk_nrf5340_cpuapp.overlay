/*
 * Copyright (c) 2025 Embeint Holdings Pty Ltd
 * SPDX-License-Identifier: FSL-1.1-ALv2
 */

#include <common/nordic/infuse_nrf5340_cpuapp.dtsi>
#include "nrf7002dk_nrf5340_cpuapp_common.dtsi"

/* Merge the secure and non-secure images */
/delete-node/ &slot0_ns_partition;
/delete-node/ &slot1_ns_partition;

&slot0_partition {
	reg = <0x00010000 0xe0000>;
};

&slot1_partition {
	reg = <0x00000000 0xe0000>;
};
