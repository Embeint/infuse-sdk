## snippets/infuse/Kconfig
```kconfig
# Infuse snippet options

config SNIPPET_INFUSE
	bool "Application is compiling with Infuse snippet"

if SNIPPET_INFUSE

rsource "boards/auroch.defconfig"
rsource "boards/kudu.defconfig"
rsource "boards/mps2_an385.defconfig"
rsource "boards/nrf52_bsim.defconfig"
rsource "boards/nrf5340dk.defconfig"
rsource "boards/nrf7002dk.defconfig"
rsource "boards/nrf9151dk.defconfig"
rsource "boards/nrf9160dk.defconfig"
rsource "boards/nrf9161dk.defconfig"
rsource "boards/tauro.defconfig"
rsource "boards/thingy53.defconfig"
rsource "boards/thingy91x.defconfig"

endif # SNIPPET_INFUSE
```

## subsys/Kconfig
```kconfig
rsource "algorithms/Kconfig"
rsource "algorithm_runner/Kconfig"
rsource "bluetooth/Kconfig"
rsource "cpatch/Kconfig"
rsource "data_logger/Kconfig"
rsource "dfu/Kconfig"
rsource "epacket/Kconfig"
rsource "logging/backends/Kconfig"
rsource "tdf/Kconfig"
rsource "fs/Kconfig"
rsource "modem/backends/Kconfig"
rsource "mgmt/Kconfig"
rsource "net/Kconfig"
rsource "rpc/Kconfig"
rsource "task_runner/Kconfig"
rsource "validation/Kconfig"
rsource "zbus/Kconfig"
```

## subsys/algorithm_runner/algorithms/Kconfig
```kconfig
# Built-in Infuse-IoT algorithms

config ALGORITHM_RUNNER_ALG_STATIONARY_WINDOWED
	bool "Stationary device detection algorithm"
	depends on INFUSE_APPLICATION_STATES
	depends on INFUSE_ZBUS_CHAN_IMU_ACC_MAG
	select INFUSE_ZBUS_CHAN_MOVEMENT_STD_DEV

if ALGORITHM_RUNNER_ALG_STATIONARY_WINDOWED

module = ALG_STATIONARY_WINDOWED
module-str = ALG Stationary
source "subsys/logging/Kconfig.template.log_config"

endif # ALGORITHM_RUNNER_ALG_STATIONARY_WINDOWED

config ALGORITHM_RUNNER_ALG_TILT
	bool "Tilt calculation algorithm"
	depends on INFUSE_ZBUS_CHAN_IMU
	depends on KV_STORE
	depends on KV_STORE_KEY_GRAVITY_REFERENCE
	select INFUSE_ZBUS_CHAN_TILT

if ALGORITHM_RUNNER_ALG_TILT

module = ALG_TILT
module-str = ALG Tilt
source "subsys/logging/Kconfig.template.log_config"

endif # ALGORITHM_RUNNER_ALG_TILT

config ALGORITHM_RUNNER_ALG_MOVEMENT_THRESHOLD
	bool "Movement detection through static threshold algorithm"
	depends on INFUSE_APPLICATION_STATES
	depends on INFUSE_ZBUS_CHAN_IMU_ACC_MAG

if ALGORITHM_RUNNER_ALG_MOVEMENT_THRESHOLD

module = ALG_MOVEMENT_THRESHOLD
module-str = ALG Threshold
source "subsys/logging/Kconfig.template.log_config"

endif # ALGORITHM_RUNNER_ALG_MOVEMENT_THRESHOLD

config ALGORITHM_RUNNER_ALG_DEMO
	bool "Demo implementations of various algorithm types"
	depends on INFUSE_ZBUS_CHAN_IMU
```

## subsys/bluetooth/Kconfig
```kconfig
# Infuse-IoT Bluetooth libraries

config BT_CTLR_ONLY
	bool
	default y if HAS_BT_CTLR && !BT_HCI_HOST
	help
	  Helper symbol to detect controller only applications

config BT_CONTROLLER_MANAGER
	bool "Manage Bluetooth controller not part of main image"
	select INFUSE_RPC_CLIENT
	depends on BT_HCI_HOST
	depends on EPACKET_INTERFACE_HCI
	default y

config BT_CONN_AUTO_RSSI
	bool "Periodically query the RSSI of active Bluetooth connections"
	depends on BT_PERIPHERAL || BT_CENTRAL
	depends on BT_CTLR_CONN_RSSI || !HAS_BT_CTLR
	default y

config BT_INFUSE_ASSERT_HANDLER
	bool "Handle Bluetooth controller assertions"
	depends on INFUSE_REBOOT
	depends on HAS_BT_CTLR
	select BT_CTLR_ASSERT_HANDLER
	default y

if BT_CONN_AUTO_RSSI

config BT_CONN_AUTO_RSSI_INTERVAL_MS
	int "RSSI query interval in milliseconds"
	default 1000

endif # BT_CONN_AUTO_RSSI

if BT_HCI_HOST

config BT_INFUSE_LEGACY_ADV_INTERVAL_MIN
	int "Minimum interval for the Infuse-IoT legacy advertising set"
	range 30 10000
	default 1000
	help
	  Minimum advertising interval for the legacy Bluetooth advertising set
	  started by bluetooth_legacy_advertising_run. Valid range is from 30 ms
	  to 10'000 ms

config BT_INFUSE_LEGACY_ADV_INTERVAL_MAX
	int "Maximum interval for the Infuse-IoT legacy advertising set"
	range 60 10240
	default 1200
	help
	  Maximum advertising interval for the legacy Bluetooth advertising set
	  started by bluetooth_legacy_advertising_run. Valid range is from 10 ms
	  to 10'240 ms

endif # BT_HCI_HOST
```

## subsys/data_logger/Kconfig
```kconfig
# Infuse Data Logging

config DATA_LOGGER
	bool "Infuse-IoT data logging abstraction"
	depends on DT_HAS_EMBEINT_DATA_LOGGER_ENABLED
	help
	  Abstraction of logging Infuse-IoT payloads to arbitrary backends,
	  whether wireless interfaces (ePacket) or persistent storage (Flash).

if DATA_LOGGER

config DATA_LOGGER_OFFLOAD_WRITES
	bool "Offload block writes to a dedicated thread"
	select NET_BUF
	default y if !ZTEST
	help
	  Block writes can require a significant amount of stack space, depending
	  on the backend. This can be problematic given the wide variety of contexts
	  that writes can be triggered from. Enabling this option offloads that stack
	  requirement to a dedicated thread that can be appropriately sized. If enabled,
	  the data_logger_block_write function will return immediately without waiting
	  for the block to finish writing.

if DATA_LOGGER_OFFLOAD_WRITES

config DATA_LOGGER_OFFLOAD_MAX_BLOCK_SIZE
	int "Maximum size of a block that can be queued"
	default 512

config DATA_LOGGER_OFFLOAD_MAX_PENDING
	int "Maximum number of blocks that can be queued"
	default 2

config DATA_LOGGER_OFFLOAD_STACK_SIZE
	int "Stack size for offloaded write thread"
	default 8192 if COVERAGE_GCOV
	default 2048

endif # DATA_LOGGER_OFFLOAD_WRITES

config DATA_LOGGER_OFFLOAD_WATCHDOG
	bool "Install watchdog on the offloaded write thread"
	depends on INFUSE_WATCHDOG
	default y

config DATA_LOGGER_RAM_BUFFER
	bool "Enable support for buffering blocks in RAM before writing"
	help
	  Buffering blocks in RAM before writing can reduce the overhead of connecting
	  to or powering up the interface backend by sharing it across multiple
	  blocks. When enabled, must be configured for individual loggers with the
	  `extra-ram-buffer` devicetree property.

config DATA_LOGGER_BURST_WRITES
	bool
	depends on DATA_LOGGER_RAM_BUFFER
	help
	  When multiple blocks are stored contiguously in RAM buffers, more efficient
	  write operations may be available.

module = DATA_LOGGER
module-str = data logger
source "subsys/logging/Kconfig.template.log_config"

rsource "backends/Kconfig"

endif # DATA_LOGGER

config TDF_DATA_LOGGER
	bool "TDF data logging"
	depends on DT_HAS_EMBEINT_TDF_DATA_LOGGER_ENABLED
	depends on DATA_LOGGER
	depends on TDF
	default y

if TDF_DATA_LOGGER

module = TDF_DATA_LOGGER
module-str = TDF data logger
source "subsys/logging/Kconfig.template.log_config"

config TDF_DATA_LOGGER_SERIAL_DUMMY_BACKEND
	bool "Route `TDF_DATA_LOGGER_SERIAL to `dt_nodelabel(tdf_logger_dummy)"
	depends on ZTEST || BOARD_NRF52_BSIM

endif # TDF_DATA_LOGGER
```

## subsys/data_logger/backends/Kconfig
```kconfig
# Infuse Data Logging backends

config DATA_LOGGER_EPACKET
	bool "Logging to ePacket instance"
	depends on DT_HAS_EMBEINT_DATA_LOGGER_EPACKET_ENABLED
	depends on EPACKET
	default y

config DATA_LOGGER_SHIM
	bool "Shim backend"
	depends on DT_HAS_EMBEINT_DATA_LOGGER_SHIM_ENABLED
	depends on ZTEST || SOC_SERIES_BSIM_NRFXX
	default y

config DATA_LOGGER_FLASH_MAP
	bool "Logging to flash_map instance"
	depends on DT_HAS_EMBEINT_DATA_LOGGER_FLASH_MAP_ENABLED
	depends on FLASH_MAP
	default y

config DATA_LOGGER_DISK_ACCESS
	bool "Logging to raw disk"
	depends on DT_HAS_EMBEINT_DATA_LOGGER_DISK_ACCESS_ENABLED
	select DISK_ACCESS
	default y

if DATA_LOGGER_DISK_ACCESS

config DATA_LOGGER_DISK_ACCESS_MAX_SECTOR_SIZE
	int "Maximum sector size supported by the driver"
	default 512

config DATA_LOGGER_DISK_ACCESS_ERASE_SECTOR_CHUNKS
	int "Number of chunks to erase at a time in `reset`"
	default 256

module = DATA_LOGGER_DISK_ACCESS
module-str = Data Logger Disk Access
source "subsys/logging/Kconfig.template.log_config"

endif # DATA_LOGGER_DISK_ACCESS

config DATA_LOGGER_EXFAT
	bool "Logging to exFAT filesystem"
	depends on DT_HAS_EMBEINT_DATA_LOGGER_EXFAT_ENABLED
	select FILE_SYSTEM_LIB_LINK
	select DISK_ACCESS
	select FAT_FILESYSTEM_ELM
	select FS_FATFS_EXFAT
	select FS_FATFS_HAS_RTC
	select FS_FATFS_EXTRA_NATIVE_API
	imply DATA_LOGGER_BURST_WRITES
	default y
	help
	  Data is stored on an exFAT filesystem in `.bin` files. Note that the
	  exFAT filesystem is not resilient to power-loss. The backend attempts
	  to mitigate the chances of data corruption through minimising file
	  allocation table updates as much as possible. Updates can be tuned
	  through DATA_LOGGER_EXFAT_STORAGE_STRATEGY and
	  DATA_LOGGER_EXFAT_FILE_SIZE.

if DATA_LOGGER_EXFAT

module = DATA_LOGGER_EXFAT
module-str = Data Logger exFAT
source "subsys/logging/Kconfig.template.log_config"

choice DATA_LOGGER_EXFAT_STORAGE_STRATEGY
	prompt "How to store data on exFAT filesystem"
	default DATA_LOGGER_EXFAT_MULTI_FILE

config DATA_LOGGER_EXFAT_MULTI_FILE
	bool "Split data across multiple files"
	help
	  Split data across files of size DATA_LOGGER_EXFAT_FILE_SIZE. The
	  advantage of this format is that users can see at a glance how much
	  data has been logged and over what timespan. The downside is that there
	  are more opportunities for filesystem corruption as the FAT is updated
	  during deployment.

config DATA_LOGGER_EXFAT_SINGLE_FILE
	bool "Log all data to a single file"
	help
	  Log all data into a single file the size of the disk. The advantage of
	  this format is that the filesystem partitions are not touched after the
	  filesystem is created on first boot, making it extremely unlikely that
	  any corruption can occur.

endchoice

config DATA_LOGGER_EXFAT_FILE_SIZE
	int "Size of individual .bin files on filesystem"
	default 10485760
	help
	  Smaller file size provide finer visual indication of the amount of
	  data logged, at the cost of increased filesystem overhead. Default
	  size is 10MB.

endif
```

## subsys/dfu/Kconfig
```kconfig
# Infuse-IoT DFU libraries

config INFUSE_DFU_HELPERS
	bool "Firmware upgrade helpers"
	depends on FLASH_MAP
	depends on FLASH_PAGE_LAYOUT
	default y if MCUBOOT_IMG_MANAGER || INFUSE_RPC_COMMAND_BT_FILE_COPY_BASIC || SOC_SERIES_BSIM_NRFXX

if INFUSE_DFU_HELPERS

config INFUSE_DFU_HELPERS_ERASE_CHUNK_SIZE
	int "Number of bytes to erase in each call to `flash_area_flatten`"
	default 65536
	help
	  Erasing a large flash area can take a long time, break up large erases into
	  chunks of this size to provide an opportunity for watchdogs to be fed.

config INFUSE_DFU_EXFAT
	bool "Upgrade application images from an exFAT filesystem"
	depends on MCUBOOT_IMG_MANAGER
	depends on DATA_LOGGER_EXFAT
	default y
	help
	  Enable functions to automate the process of upgrading firmware from a
	  /dfu folder on a mounted filesystem.

endif # INFUSE_DFU_HELPERS
```

## subsys/epacket/Kconfig
```kconfig
# ePacket configuration

menuconfig EPACKET
	bool "ePacket subsystem"
	depends on NET_BUF
	select INFUSE_WORKQ
	select POLL

if EPACKET

module = EPACKET
module-str = epacket
source "subsys/logging/Kconfig.template.log_config"

config EPACKET_KEYS_EXTENSION_NETWORKS
	int "Number of alternate network keys that can be loaded for decoding"
	default 0
	help
	  This option controls how many alternate base network keys can be added
	  into the key module with epacket_key_network_add for decoding. May
	  require increasing MBEDTLS_PSA_KEY_SLOT_COUNT.

config EPACKET_PROCESS_THREAD_SPLIT
	bool "Dedicated threads for TX and RX packet processing"

config EPACKET_PROCESS_THREAD_STACK_SIZE
	int "Size of the stack for the thread that processes ePacket frames"
	default 4096 if COVERAGE
	default 2048

config EPACKET_INFUSE_WATCHDOG
	bool "Install watchdog on the ePacket processing thread"
	depends on INFUSE_WATCHDOG
	default y

config EPACKET_BUFFER_EXHAUSTION_TIMEOUT
	int "Timeout for detecting ePacket buffer exhaustion"
	default 60
	help
		If all buffers (TX or RX) have been claimed from the pool, require that
		at least one buffer is returned within this duration. This detects all
		buffers being held by contexts that wouldn't otherwise trigger a watchdog
		timeout.

config EPACKET_BUFFERS_TX
	int "Number of ePacket buffers for TX"
	range 1 16
	default 3

config EPACKET_BUFFERS_RX
	int "Number of ePacket buffers for RX"
	range 1 16
	default 3

config EPACKET_RATE_LIMIT_BUFFER_THRESHOLD
	int "Send a rate limit request when number of free TX buffers reaches this value"
	default 1

config EPACKET_RATE_LIMIT_REQ_DURATION_MS
	int "Duration of the rate limit request delays when running out of TX buffers"
	range 1 255
	default 100
	help
	  When forwarding packets, the gateway handler will automatically request connected
	  devices to pause transmissions for a short duration if it faces buffer starvation.
	  This option controls the duration of the requested pause, and can be tuned based on
	  how quickly the backhaul interface can free buffers.

config EPACKET_RECEIVE_GROUPING
	bool "Append multiple received packets into a single INFUSE_RECEIVED_EPACKET"

config EPACKET_RECEIVE_GROUPING_MAX_HOLD_MS
	int "Maximum duration to hold a INFUSE_RECEIVED_EPACKET waiting for more packets"
	depends on EPACKET_RECEIVE_GROUPING
	default 1000

config EPACKET_FORWARDING
	bool "Support for handling ePacket forwarding packets"
	depends on EPACKET_INTERFACE_BT_CENTRAL

config EPACKET_PACKET_SIZE_MAX
	int "Maximum supported ePacket packet size"
	range 64 2048
	default 555 if EPACKET_INTERFACE_SERIAL
	default 548 if NET_IPV4
	default 256
	help
	  512 byte serial payload + overhead = 555
	  IPv4 minimum MTU = 576 (28 byte IP + UDP header)
	  256 is sufficient for Bluetooth only devices.

config EPACKET_BUFFERS_TX_DELAYABLE_WORK
	bool
	help
	  Enable a per TX buffer delayable work item.

config EPACKET_FILTERING
	bool "ePacket filtering functions"
	depends on TDF

rsource "interfaces/Kconfig"

endif # EPACKET

config EPACKET_CRYPTO
	bool
	depends on INFUSE_SECURITY
	default y
```
