## subsys/epacket/interfaces/Kconfig
```kconfig
# ePacket interfaces

config EPACKET_INTERFACE_SERIAL
	bool

choice EPACKET_INTERFACE_SERIAL_BACKEND
	prompt "Backend for serial interface"
	depends on DT_HAS_EMBEINT_EPACKET_SERIAL_ENABLED
	depends on EPACKET_CRYPTO
	default EPACKET_INTERFACE_SERIAL_BACKEND_RTT if USE_SEGGER_RTT
	default EPACKET_INTERFACE_SERIAL_BACKEND_INT if USB_CDC_ACM
	default EPACKET_INTERFACE_SERIAL_BACKEND_ASYNC if UART_ASYNC_API
	default EPACKET_INTERFACE_SERIAL_BACKEND_INT

config EPACKET_INTERFACE_SERIAL_BACKEND_INT
	bool "ePacket serial interface using the interrupt driven API"
	depends on UART_INTERRUPT_DRIVEN
	select EPACKET_INTERFACE_SERIAL

config EPACKET_INTERFACE_SERIAL_BACKEND_ASYNC
	bool "ePacket serial interface using the asynchronous API"
	depends on UART_ASYNC_API
	select EPACKET_INTERFACE_SERIAL

config EPACKET_INTERFACE_SERIAL_BACKEND_RTT
	bool "ePacket serial interface over RTT"
	depends on USE_SEGGER_RTT
	select EPACKET_INTERFACE_SERIAL

endchoice

if EPACKET_INTERFACE_SERIAL

module = EPACKET_SERIAL
module-str = epacket_serial
source "subsys/logging/Kconfig.template.log_config"

endif # EPACKET_INTERFACE_SERIAL

config EPACKET_INTERFACE_SERIAL_BACKEND_INT_SINGLE_BYTE_SEND
	bool "Send serial ePacket frames one byte at a time"
	depends on EPACKET_INTERFACE_SERIAL_BACKEND_INT
	default y if UART_CMSDK_APB
	help
	  By default, serial ePacket frames can only be sent when the entire
	  frame can be transmitted at once, in order to prevent packet corruption
	  due to interleaved bytes. Enabling this option allows sending frames one
	  byte at a time, at the cost of introducing potential packet corruption.
	  By default this is only enabled for the emulated UART backend, as it
	  can send N bytes in a single IRQ loop due to its instantaneous send.

config EPACKET_INTERFACE_SERIAL_BACKEND_ASYNC_RX_BUFFER
	int "Size of the ePacket async receive buffers"
	depends on EPACKET_INTERFACE_SERIAL_BACKEND_ASYNC
	default 32
	help
	  Size of the asynchronous UART receive buffers.

config EPACKET_INTERFACE_UDP
	bool "ePacket UDP interface"
	depends on DT_HAS_EMBEINT_EPACKET_UDP_ENABLED
	depends on EPACKET_CRYPTO
	depends on INFUSE_DNS
	depends on NET_UDP
	depends on EVENTS
	default y

if EPACKET_INTERFACE_UDP

config EPACKET_INTERFACE_UDP_DEFAULT_URL
	string "ePacket UDP default server URL"
	default "udp.dev.infuse-iot.com"

config EPACKET_INTERFACE_UDP_DEFAULT_PORT
	int "ePacket UDP default server port"
	default 3001

config EPACKET_INTERFACE_UDP_ACK_PERIOD_SEC
	int "Request an ACK from the server after N seconds of not receiving"
	default 3600
	help
	  If the device has not heard from the server for this many seconds,
	  the `EPACKET_FLAGS_ACK_REQUEST` flag is set on packets until a packet
	  is received.  If no response is received after a further
	  EPACKET_INTERFACE_UDP_ACK_COUNTDOWN transmissions, the server is
	  assumed lost and is set up again. Default period is 1 hour.

config EPACKET_INTERFACE_UDP_ACK_COUNTDOWN
	int "Number of unanswered ACKs to send before dropping server"
	default 10

config EPACKET_INTERFACE_UDP_DECRYPT_TX_FAILURES
	bool "Decrypt encrypted payloads when a TX failure of an encrypted packet occurs"

config EPACKET_INTERFACE_UDP_DETECT_UNACKNOWLEDGED
	bool "Detect packets which request an ACK but don't receive one"
	select EPACKET_BUFFERS_TX_DELAYABLE_WORK
	imply EPACKET_INTERFACE_UDP_DECRYPT_TX_FAILURES

config EPACKET_INTERFACE_UDP_DETECT_UNACKNOWLEDGED_TIMEOUT_MS
	int "Timeout for the cloud to ACK a requested packet"
	default 2000

config EPACKET_INTERFACE_UDP_DOWNLINK_WATCHDOG
	bool "Software watchdog for receiving data from cloud UDP server"
	depends on INFUSE_REBOOT
	default y
	help
	  Enable a software watchdog that is fed each time a valid downlink packet
	  is received from the cloud UDP server. The intent of this watchdog is to
	  protect against networking hardware/drivers from entering a permanently
	  bad state that prevents UDP communications.

config EPACKET_INTERFACE_UDP_DOWNLINK_WATCHDOG_TIMEOUT
	int "Timeout duration for the cloud UDP server software watchdog"
	depends on EPACKET_INTERFACE_UDP_DOWNLINK_WATCHDOG
	default 259200
	help
	  Watchdog period in seconds. Default value is 3 days (3 * 86400)

config EPACKET_INTERFACE_UDP_RX_BUFFER_CLAIM_TIMEOUT
	int "Timeout duration to claim an ePacket receive buffer"
	default 120
	help
	  If this timeout expires, the device is rebooted. This is intended to be
	  an absolute last resort, other watchdogs should have picked up on blocked
	  threads by the time this expires.

module = EPACKET_UDP
module-str = epacket_udp
source "subsys/logging/Kconfig.template.log_config"

endif # EPACKET_INTERFACE_UDP

config EPACKET_INTERFACE_BT_ADV
	bool "ePacket Bluetooth advertising interface"
	depends on DT_HAS_EMBEINT_EPACKET_BT_ADV_ENABLED
	depends on EPACKET_CRYPTO
	depends on BT_BROADCASTER
	default y

if EPACKET_INTERFACE_BT_ADV

config EPACKET_INTERFACE_BT_ADV_SCAN_WATCHDOG_SEC
	int "If scanning, restart scanning if no advertising packets are seen in this period"
	default 600
	help
	  Automatically attempt to recover Bluetooth controllers where scanning can unexpectedly
	  stop. Default is 10 minutes.

config EPACKET_INTERFACE_BT_ADV_SCAN_WATCHDOG_MIN_REBOOT_AGE_SEC
	int "Minimum uptime to trigger a reboot if scanning fails"
	default 14400
	help
	  If restarting scanning does not result in advertising packets being observed, reboot
	  the device if the application has been running for at least this long. Default is
	  4 hours.

config EPACKET_INTERFACE_BT_ADV_FALLBACK_SCAN_CALLBACK
	bool "Allow applications to register a callback for all observing non-Infuse advertising packets"
	help
	  Callback is registered via `epacket_bt_adv_set_fallback_scan_callback`.

module = EPACKET_BT_ADV
module-str = epacket_bt_adv
source "subsys/logging/Kconfig.template.log_config"

endif # EPACKET_INTERFACE_BT_ADV

config EPACKET_INTERFACE_BT_GATT
	bool

config EPACKET_INTERFACE_BT_PERIPHERAL
	bool "ePacket Bluetooth GATT peripheral interface"
	depends on DT_HAS_EMBEINT_EPACKET_BT_PERIPHERAL_ENABLED
	depends on EPACKET_CRYPTO
	depends on BT_PERIPHERAL
	select EPACKET_INTERFACE_BT_GATT
	default y

if EPACKET_INTERFACE_BT_PERIPHERAL

module = EPACKET_BT_PERIPHERAL
module-str = epacket_bt_peripheral
source "subsys/logging/Kconfig.template.log_config"

endif # EPACKET_INTERFACE_BT_PERIPHERAL

config EPACKET_INTERFACE_BT_CENTRAL
	bool "ePacket Bluetooth GATT central interface"
	depends on DT_HAS_EMBEINT_EPACKET_BT_CENTRAL_ENABLED
	depends on EPACKET_CRYPTO
	depends on BT_CENTRAL
	select EPACKET_INTERFACE_BT_GATT
	default y

if EPACKET_INTERFACE_BT_CENTRAL

module = EPACKET_BT_CENTRAL
module-str = epacket_bt_central
source "subsys/logging/Kconfig.template.log_config"

endif # EPACKET_INTERFACE_BT_CENTRAL

config EPACKET_INTERFACE_HCI
	bool "ePacket Bluetooth HCI"
	depends on DT_HAS_EMBEINT_EPACKET_HCI_ENABLED
	depends on BT_HCI_RAW || BT_HCI_HOST
	default y

if EPACKET_INTERFACE_HCI

module = EPACKET_HCI
module-str = epacket_hci
source "subsys/logging/Kconfig.template.log_config"

endif # EPACKET_INTERFACE_HCI

config EPACKET_INTERFACE_DUMMY
	bool "ePacket dummy interface"
	depends on DT_HAS_EMBEINT_EPACKET_DUMMY_ENABLED
	default y

config EPACKET_INTERFACE_ZTEST_PACKETS
	bool "Compile in the packet construction functions without the interfaces"
	depends on ZTEST
```

## subsys/fs/Kconfig
```kconfig
rsource "kv_store/Kconfig"
rsource "littlefs/Kconfig"
rsource "secure_storage/Kconfig"
```

## subsys/fs/kv_store/Kconfig
```kconfig
# Infuse-IoT SDK key-value store

# Workaround for not being able to have commas in macro arguments
DT_CHOSEN_KV_PARTITION := infuse,kv-partition

config KV_STORE
	bool "Infuse-IoT key-value storage"
	depends on NVS || ZMS
	depends on FLASH_MAP
	depends on $(dt_chosen_enabled,$(DT_CHOSEN_KV_PARTITION))

if KV_STORE

choice KV_STORE_BACKEND
	prompt "Storage backend for the KV store API"

config KV_STORE_NVS
	bool "KV store through the NVS API"
	depends on NVS

config KV_STORE_ZMS
	bool "KV store through the ZMS API"
	depends on ZMS
	# Required for duplicate data detection
	select ZMS_NO_DOUBLE_WRITE

endchoice

module = KV_STORE
module-str = key-value store
source "subsys/logging/Kconfig.template.log_config"

config KV_STORE_INIT_PRIORITY
	int "Flash init priority"
	default 55
	help
	  KV store initialization priority. The default value of 55 is
	  later than the default FLASH_INIT_PRIORITY value (50).

config KV_STORE_ZMS_ID_PREFIX
	hex "Prefix to apply to 16bit KV store IDs"
	depends on KV_STORE_ZMS
	range 0x0000 0xFFFF
	default 0xEBEB
	help
	  For compatibility with the NVS API, the KV store only uses 16 bit
	  IDs. Since ZMS supports 32 bit IDs, this option allows shifting the
	  address space of the KV store within ZMS in order to allow co-existence
	  with other users of the same instance, if required.

endif # KV_STORE
```
