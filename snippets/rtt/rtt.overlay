/ {
	chosen {
		zephyr,console = &rtt0;
	};

	rtt0: rtt_chan0 {
		compatible = "segger,rtt-uart";
		status = "okay";
	};

	epacket_serial: epacket_serial {
		compatible = "embeint,epacket-serial";
		serial = <&rtt0>;
	};
};
