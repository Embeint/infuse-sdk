## boards/embeint/tauro2/board.yml
```yaml
board:
  name: tauro2
  full_name: Tauro 2
  vendor: embeint
  socs:
  - name: nrf9151
    variants:
    - name: 'ns'
  - name: nrf54l15
```

## boards/embeint/tauro2/tauro2_nrf54l15_cpuapp_defconfig
```kconfig
# Copyright (c) 2025 Embeint Inc
# SPDX-License-Identifier: Apache-2.0

# Enable GPIO
CONFIG_GPIO=y

# Enable MPU
CONFIG_ARM_MPU=y

# Enable hardware stack protection
CONFIG_HW_STACK_PROTECTION=y

# Enable uart driver
CONFIG_SERIAL=y

# Enable console
CONFIG_CONSOLE=y
CONFIG_USE_SEGGER_RTT=y
CONFIG_UART_CONSOLE=y
CONFIG_LOG_BACKEND_RTT=n
CONFIG_RTT_CONSOLE=n
```

## boards/embeint/tauro2/tauro2_nrf9151_defconfig
```kconfig
# SPDX-License-Identifier: Apache-2.0

# Enable MPU
CONFIG_ARM_MPU=y

# Enable hardware stack protection
CONFIG_HW_STACK_PROTECTION=y

# Enable GPIO
CONFIG_GPIO=y

# Enable UART driver
CONFIG_SERIAL=y

# Enable console
CONFIG_CONSOLE=y
CONFIG_USE_SEGGER_RTT=y
CONFIG_UART_CONSOLE=y
CONFIG_LOG_BACKEND_RTT=n
CONFIG_RTT_CONSOLE=n
```

## boards/nordic/nrf7002dk/Kconfig.nrf7002dk
```kconfig
# Copyright (c) 2024 Nordic Semiconductor
# SPDX-License-Identifier: LicenseRef-Nordic-5-Clause

config BOARD_NRF7002DK
	select SOC_NRF5340_CPUNET_QKAA if BOARD_NRF7002DK_NRF5340_CPUNET
	select SOC_NRF5340_CPUAPP_QKAA if BOARD_NRF7002DK_NRF5340_CPUAPP || BOARD_NRF7002DK_NRF5340_CPUAPP_NS
```

## boards/nordic/nrf7002dk/Kconfig.sysbuild
```kconfig
# Sysbuild configuration

config DOMAIN_CPUNET_BOARD
	string
	default "nrf7002dk/nrf5340/cpunet" if BOARD_NRF7002DK_NRF5340_CPUAPP || BOARD_NRF7002DK_NRF5340_CPUAPP_NS
	help
	  The board which will be used for CPUNET domain when creating a multi
	  image application where one or more images should be located on
	  another board. For example hci_ipc on the nRF5340_cpunet for
	  Bluetooth applications.
```

## boards/nordic/nrf7002dk/board.yml
```yaml
board:
  name: nrf7002dk
  vendor: nordic
  socs:
    - name: nrf5340
      variants:
        - name: ns
          cpucluster: cpuapp
```

## boards/nordic/thingy91x/Kconfig.defconfig
```kconfig
# Thingy:91 X board configuration

# Copyright (c) 2025 Embeint Holdings Pty Ltd
# SPDX-License-Identifier: Apache-2.0

if BOARD_THINGY91X_NRF9151 || BOARD_THINGY91X_NRF9151_NS

# For the secure version of the board the firmware is linked at the beginning
# of the flash, or into the code-partition defined in DT if it is intended to
# be loaded by MCUboot. If the secure firmware is to be combined with a non-
# secure image (TRUSTED_EXECUTION_SECURE=y), the secure FW image shall always
# be restricted to the size of its code partition.
# For the non-secure version of the board, the firmware
# must be linked into the code-partition (non-secure) defined in DT, regardless.
# Apply this configuration below by setting the Kconfig symbols used by
# the linker according to the information extracted from DT partitions.

# Workaround for not being able to have commas in macro arguments
DT_CHOSEN_Z_CODE_PARTITION := zephyr,code-partition

config FLASH_LOAD_SIZE
	default $(dt_chosen_reg_size_hex,$(DT_CHOSEN_Z_CODE_PARTITION))
	depends on BOARD_NRF9151DK_NRF9151 && TRUSTED_EXECUTION_SECURE

if BOARD_THINGY91X_NRF9151_NS

config FLASH_LOAD_OFFSET
	default $(dt_chosen_reg_addr_hex,$(DT_CHOSEN_Z_CODE_PARTITION))

config FLASH_LOAD_SIZE
	default $(dt_chosen_reg_size_hex,$(DT_CHOSEN_Z_CODE_PARTITION))

configdefault TFM_LOG_LEVEL_SILENCE
	default y

endif # BOARD_THINGY91X_NRF9151_NS

# nRF9151 only has RAM for scanning
choice WIFI_USAGE_MODE
	default WIFI_USAGE_MODE_SCAN_ONLY
endchoice # WIFI_USAGE_MODE

# nPM1300 multi-function device
configdefault MFD
	default y

# Load switch and BUCK regulator configuration
configdefault REGULATOR
	default y

# GPIO hogs must be initialized after nPM1300 (GPIO_NPM1300_INIT_PRIORITY)
config GPIO_HOGS_INIT_PRIORITY
	default 86

# nPM6001 must be initialized after it is powered from nPM1300 (REGULATOR_NPM1300_INIT_PRIORITY)
config MFD_NPM6001_INIT_PRIORITY
	default 87
config REGULATOR_NPM6001_INIT_PRIORITY
	default 88

endif # BOARD_THINGY91X_NRF9151 || BOARD_THINGY91X_NRF9151_NS

if BOARD_THINGY91X_NRF5340_CPUAPP

endif # BOARD_THINGY91X_NRF5340_CPUAPP
```

## boards/nordic/thingy91x/Kconfig.thingy91x
```kconfig
# Thingy:91 X board configuration

# Copyright (c) 2025 Embeint Holdings Pty Ltd
# SPDX-License-Identifier: Apache-2.0

config BOARD_THINGY91X
	select SOC_NRF9151_LACA if BOARD_THINGY91X_NRF9151 || BOARD_THINGY91X_NRF9151_NS
	select SOC_NRF5340_CPUAPP_QKAA if BOARD_THINGY91X_NRF5340_CPUAPP
	select SOC_NRF5340_CPUNET_QKAA if BOARD_THINGY91X_NRF5340_CPUNET
```

## boards/nordic/thingy91x/thingy91x_nrf5340_cpuapp_defconfig
```kconfig
# SPDX-License-Identifier: Apache-2.0

# Enable MPU
CONFIG_ARM_MPU=y

# Enable hardware stack protection
CONFIG_HW_STACK_PROTECTION=y

# Enable GPIO
CONFIG_GPIO=y

# Enable console
CONFIG_CONSOLE=y
CONFIG_RTT_CONSOLE=y
CONFIG_USE_SEGGER_RTT=y
```

## boards/shields/nrf7002eb/Kconfig.shield
```kconfig
#
# Copyright (c) 2023 Nordic Semiconductor ASA
#
# SPDX-License-Identifier: LicenseRef-Nordic-5-Clause
#
config SHIELD_NRF7002EB
	def_bool $(shields_list_contains,nrf7002eb)

if SHIELD_NRF7002EB

configdefault NETWORKING
	default y if !MCUBOOT

configdefault WIFI
	default y if !MCUBOOT

endif # SHIELD_NRF7002EB
```

## boards/shields/nrf7002ek/Kconfig.shield
```kconfig
# Copyright (c) 2024 Nordic Semiconductor ASA
# SPDX-License-Identifier: Apache-2.0

config SHIELD_NRF7002EK
	def_bool $(shields_list_contains,nrf7002ek)
```

## boards/shields/sparkfun_microsd/Kconfig.shield
```kconfig
#
# Copyright (c) 2024 Embeint Holdings Pty Ltd
#
# SPDX-License-Identifier: Apache-2.0
#
# https://www.sparkfun.com/products/12761

config SHIELD_SPARKFUN_MICROSD
	def_bool $(shields_list_contains,sparkfun_microsd)

if SHIELD_SPARKFUN_MICROSD && !MCUBOOT

configdefault DISK_DRIVERS
	default y

endif # SHIELD_SPARKFUN_MICROSD && !MCUBOOT
```

## boards/shields/sparkfun_sam_m10/Kconfig.shield
```kconfig
#
# Copyright (c) 2024 Embeint Holdings Pty Ltd
#
# SPDX-License-Identifier: Apache-2.0
#
# https://www.sparkfun.com/products/12761

config SHIELD_SPARKFUN_SAM_M10
	def_bool $(shields_list_contains,sparkfun_sam_m10)
```

## drivers/Kconfig
```kconfig
# Infuse-IoT driver configuration

rsource "fuel_gauge/Kconfig"
rsource "gnss/Kconfig"
rsource "imu/Kconfig"
rsource "led/Kconfig"
rsource "sensor/Kconfig"
rsource "shared_device/Kconfig"
rsource "watchdog/Kconfig"
rsource "wifi/Kconfig"
```

## drivers/audio/Kconfig
```kconfig
# Copyright (c) 2025 Embeint Holdings Pty Ltd
# SPDX-License-Identifier: Apache-2.0

menuconfig T5838
	bool "Invensense T5838 low power digital microphone"
	default y
	depends on DT_HAS_INVENSENSE_T5838_ENABLED
	depends on AUDIO_DMIC_NRFX_PDM
	help
	  Enable Invensense T5838 Digital Microphone Driver.

if T5838

module = T5838
module-str = T5838 microphone driver
source "subsys/logging/Kconfig.template.log_config"

endif # T5838
```

## drivers/fuel_gauge/Kconfig
```kconfig
# Battery fuel-gauge drivers

# Copyright (c) 2024 Embeint Holdings Pty Ltd
# SPDX-License-Identifier: Apache-2.0

config MAXIM_MAX17260
	bool "Maxim MAX17260 fuel gauge"
	default y
	depends on DT_HAS_MAXIM_MAX17260_ENABLED
	select I2C
	help
	  Enable driver for the Maxim MAX17260 fuel gauge device.

if MAXIM_MAX17260

module = MAX17260
module-str = max17260
source "subsys/logging/Kconfig.template.log_config"

endif # MAXIM_MAX17260
```

## drivers/gnss/Kconfig
```kconfig
# Infuse-IoT GNSS drivers

config GNSS_UBX_MODEM
	bool
	select NET_BUF
	help
	  UBX protocol wrappers

config GNSS_UBX_MODEM_EMUL
	bool
	help
	  Emulated device

if GNSS_UBX_MODEM

config GNSS_UBX_MODEM_MAX_CALLBACKS
	int "Maximum number of handler callbacks that can be run in response to a UBX message"
	default 8

config GNSS_UBX_M10
	bool
	help
	  U-blox M10 command interface (CFG-VALSET for configuration)

config GNSS_UBX_M8
	bool
	help
	  U-blox M8 command interface (Dedicated messages for configuration)

config GNSS_UBX_RAW_FRAME_HANDLER
	bool "Application raw UBX frame handling"

module = GNSS_UBX_MODEM
module-str = u-blox GNSS
source "subsys/logging/Kconfig.template.log_config"

config GNSS_U_BLOX_LARGE_MESSAGES
	bool "Support large UBX messages"
	help
	  Configure defaults for large messages. Intended for supporting optional
	  messages like NAV-PVT.

config GNSS_U_BLOX_PIPE_SIZE
	int "UBX modem pipe size"
	range 128 2048
	default 1024 if GNSS_U_BLOX_LARGE_MESSAGES
	default 512
	help
	  Maximum number of bytes that can be stored in the pipe buffer.

config GNSS_U_BLOX_MAX_MSG_SIZE
	int "UBX modem pipe size"
	range 128 512
	default 512 if GNSS_U_BLOX_LARGE_MESSAGES
	default 256
	help
	  Maximum size of a UBX message that driver can handle.

config GNSS_U_BLOX_NO_API_COMPAT
	bool "Drop compatibility with the Zephyr GNSS API"
	help
	  If working with the UBX modem backend directly, all API compatibility
	  except for timepulse can be disabled for ~2kB ROM savings.

config GNSS_U_BLOX_CONSTELLATION_API_COMPAT
	bool "Retain compatibility with the Zephyr GNSS constellation functions"
	depends on GNSS_U_BLOX_NO_API_COMPAT

config GNSS_U_BLOX_SATELLITES_COUNT
	int "Maximum satellite count"
	depends on GNSS_SATELLITES
	default 24
	help
	  Maximum number of satellite vehicles that the driver can report from
	  the GNSS device. This does not affect the number of devices that the
	  device is actually tracking, just how many of those can be reported
	  in the satellites callback.

endif # GNSS_UBX_MODEM

config GNSS_U_BLOX_M10_I2C
	bool "U-BLOX M10 I2C GNSS Module"
	default y
	depends on GNSS
	depends on DT_HAS_U_BLOX_M10_I2C_ENABLED
	select I2C
	select I2C_RTIO
	select MODEM_MODULES
	select MODEM_BACKEND_U_BLOX_I2C
	select GNSS_UBX_MODEM
	select GNSS_UBX_M10

config GNSS_U_BLOX_M8_SPI
	bool "U-BLOX M8 SPI GNSS Module"
	default y
	depends on GNSS
	depends on DT_HAS_U_BLOX_M8_SPI_ENABLED
	select SPI
	select SPI_ASYNC
	select MODEM_MODULES
	select MODEM_BACKEND_U_BLOX_SPI
	select GNSS_UBX_MODEM
	select GNSS_UBX_M8

config GNSS_U_BLOX_M8_EMUL
	bool "Emulated U-BLOX M8 GNSS Module"
	default y
	depends on GNSS
	depends on DT_HAS_U_BLOX_M8_EMUL_ENABLED
	select GNSS_UBX_MODEM
	select GNSS_UBX_MODEM_EMUL
	select GNSS_UBX_M8

config GNSS_NRF9X
	bool "Nordic nRF9x GNSS modem"
	default y
	depends on DT_HAS_NORDIC_NRF9X_GNSS_ENABLED

config GNSS_NRF9X_EMUL
	bool "Emulated Nordic nRF9x GNSS modem"
	default y
	depends on DT_HAS_NORDIC_NRF9X_GNSS_EMUL_ENABLED
```

## drivers/imu/Kconfig
```kconfig
# Infuse-IoT IMU driver configuration

config INFUSE_IMU
	bool "Infuse-IoT IMU driver API"
	depends on SENSOR

if INFUSE_IMU

config INFUSE_IMU_MAX_FIFO_SAMPLES
	int "Maximum number of samples pending in a FIFO that can be handled"
	default 32 if INFUSE_IMU_LIS2DW12
	default 128
	help
	  Save RAM by notifying drivers and application logic of the maximum number
	  of IMU samples they need to be able to handle in a single chunk.

config INFUSE_IMU_RESAMPLE
	bool "IMU resampling functions"

config INFUSE_IMU_SELF_TEST
	bool "Enable self-test functionality in drivers"

rsource "bma4xx/Kconfig"
rsource "bmi270/Kconfig"
rsource "emul/Kconfig"
rsource "lis2dw12/Kconfig"
rsource "lsm6dso/Kconfig"
rsource "lsm6dsv/Kconfig"

endif # INFUSE_IMU
```

## drivers/imu/bma4xx/Kconfig
```kconfig
# BMA4XX 3 Axis Accelerometer configuration

# Copyright (c) 2024 Embeint Holdings Pty Ltd
# SPDX-License-Identifier: Apache-2.0

menuconfig INFUSE_IMU_BMA4XX
	bool "BMA4XX Inertial measurement unit"
	default y
	depends on DT_HAS_BOSCH_BMA4XX_ENABLED
	select I2C if $(dt_compat_on_bus,$(DT_COMPAT_BOSCH_BMA4XX),i2c)
	select SPI if $(dt_compat_on_bus,$(DT_COMPAT_BOSCH_BMA4XX),spi)
	help
	  Enable driver for BMA4XX IMU sensor

# Zephyr and Infuse driver conflict
configdefault BMA4XX
	default n if INFUSE_IMU_BMA4XX

if INFUSE_IMU_BMA4XX

config BMA4XX_BUS_I2C
	bool
	default y
	depends on $(dt_compat_on_bus,$(DT_COMPAT_BOSCH_BMA4XX),i2c)

config BMA4XX_BUS_SPI
	bool
	default y
	depends on $(dt_compat_on_bus,$(DT_COMPAT_BOSCH_BMA4XX),spi)

endif # INFUSE_IMU_BMA4XX
```

## drivers/imu/bmi270/Kconfig
```kconfig
# BMI270 6 Axis IMU configuration

# Copyright (c) 2024 Embeint Holdings Pty Ltd
# SPDX-License-Identifier: Apache-2.0

menuconfig INFUSE_IMU_BMI270
	bool "BMI270 Inertial measurement unit"
	default y
	depends on DT_HAS_BOSCH_BMI270_ENABLED
	select I2C if $(dt_compat_on_bus,$(DT_COMPAT_BOSCH_BMI270),i2c)
	select SPI if $(dt_compat_on_bus,$(DT_COMPAT_BOSCH_BMI270),spi)
	help
	  Enable driver for BMI270 IMU sensor

# Zephyr and Infuse driver conflict
configdefault BMI270
	default n if INFUSE_IMU_BMI270

if INFUSE_IMU_BMI270

config BMI270_BUS_I2C
	bool
	default y
	depends on $(dt_compat_on_bus,$(DT_COMPAT_BOSCH_BMI270),i2c)

config BMI270_BUS_SPI
	bool
	default y
	depends on $(dt_compat_on_bus,$(DT_COMPAT_BOSCH_BMI270),spi)

endif # BMI270
```

## drivers/imu/emul/Kconfig
```kconfig
# Emulated IMU driver

config INFUSE_IMU_EMUL
	bool "Emulated IMU driver"
	depends on DT_HAS_EMBEINT_IMU_EMUL_ENABLED
	default y
```

## drivers/imu/lis2dw12/Kconfig
```kconfig
# LIS2DW12 3 Axis Accelerometer configuration

# Copyright (c) 2025 Embeint Holdings Pty Ltd
# SPDX-License-Identifier: Apache-2.0

menuconfig INFUSE_IMU_LIS2DW12
	bool "LIS2DW12 Inertial measurement unit"
	default y
	depends on DT_HAS_ST_LIS2DW12_ENABLED
	select I2C if $(dt_compat_on_bus,$(DT_COMPAT_ST_LIS2DW12),i2c)
	select SPI if $(dt_compat_on_bus,$(DT_COMPAT_ST_LIS2DW12),spi)
	help
	  Enable driver for LIS2DW12 IMU sensor

if INFUSE_IMU_LIS2DW12

# Zephyr and Infuse driver conflict
configdefault LIS2DW12
	default n

config LIS2DW12_BUS_I2C
	bool
	default y
	depends on $(dt_compat_on_bus,$(DT_COMPAT_ST_LIS2DW12),i2c)

config LIS2DW12_BUS_SPI
	bool
	default y
	depends on $(dt_compat_on_bus,$(DT_COMPAT_ST_LIS2DW12),spi)

endif # LIS2DW12
```

## drivers/imu/lsm6dso/Kconfig
```kconfig
# LSM6DSO 6 Axis IMU configuration

# Copyright (c) 2024 Embeint Holdings Pty Ltd
# SPDX-License-Identifier: Apache-2.0

menuconfig INFUSE_IMU_LSM6DSO
	bool "LSM6DSO Inertial measurement unit"
	default y
	depends on DT_HAS_ST_LSM6DSO_ENABLED
	select I2C if $(dt_compat_on_bus,$(DT_COMPAT_ST_LSM6DSO),i2c)
	select SPI if $(dt_compat_on_bus,$(DT_COMPAT_ST_LSM6DSO),spi)
	help
	  Enable driver for LSM6DSO IMU sensor

if INFUSE_IMU_LSM6DSO

# Zephyr and Infuse driver conflict
configdefault LSM6DSO
	default n

config LSM6DSO_BUS_I2C
	bool
	default y
	depends on $(dt_compat_on_bus,$(DT_COMPAT_ST_LSM6DSO),i2c)

config LSM6DSO_BUS_SPI
	bool
	default y
	depends on $(dt_compat_on_bus,$(DT_COMPAT_ST_LSM6DSO),spi)

endif # LSM6DSO
```

## drivers/imu/lsm6dsv/Kconfig
```kconfig
# LSM6DSV 6 Axis IMU configuration

# Copyright (c) 2024 Embeint Holdings Pty Ltd
# SPDX-License-Identifier: Apache-2.0

menuconfig INFUSE_IMU_LSM6DSV
	bool "LSM6DSV Inertial measurement unit"
	default y
	depends on DT_HAS_ST_LSM6DSV16X_ENABLED
	select I2C if $(dt_compat_on_bus,$(DT_COMPAT_ST_LSM6DSV16X),i2c)
	select SPI if $(dt_compat_on_bus,$(DT_COMPAT_ST_LSM6DSV16X),spi)
	help
	  Enable driver for LSM6DSV IMU sensor

if INFUSE_IMU_LSM6DSV

# Zephyr and Infuse driver conflict
configdefault LSM6DSV16X
	default n

config LSM6DSV_BUS_I2C
	bool
	default y
	depends on $(dt_compat_on_bus,$(DT_COMPAT_ST_LSM6DSV16X),i2c)

config LSM6DSV_BUS_SPI
	bool
	default y
	depends on $(dt_compat_on_bus,$(DT_COMPAT_ST_LSM6DSV16X),spi)

endif # LSM6DSV
```
