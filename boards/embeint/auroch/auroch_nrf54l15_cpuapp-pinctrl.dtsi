/*
 * Copyright (c) 2025 Embeint Inc
 * SPDX-License-Identifier: Apache-2.0
 */

&pinctrl {
	spi20_default: spi20_default {
		group1 {
			psels = <NRF_PSEL(SPIS_SCK, 1, 4)>,
				<NRF_PSEL(SPIS_MOSI, 1, 6)>,
				<NRF_PSEL(SPIS_MISO, 1, 5)>,
				<NRF_PSEL(SPIS_CSN, 1, 7)>;
		};
	};
};
