/*
 * Copyright (c) 2026 Embeint Holdings Pty Ltd
 * SPDX-License-Identifier: FSL-1.1-ALv2
 */

/dts-v1/;

#include <espressif/esp32c6/esp32c6_lpcore_wroom_n4.dtsi>
#include <espressif/partitions_0x0_default_8M.dtsi>

/ {
	model = "Waveshare ESP32-C6-LCD-1.47 8 MB LP core";
	compatible = "waveshare,esp32c6-lcd-1-47";
	chosen {
		zephyr,flash = &flash0;
		zephyr,sram = &ulp_ram;
		zephyr,code-partition = &slot0_lpcore_partition;
		zephyr,console = &lp_uart;
		zephyr,shell-uart = &lp_uart;
	};
};

&lp_uart {
	status = "okay";
	current-speed = <115200>;
};

&flash0 {
	reg = <0 DT_SIZE_M(8)>;
};
