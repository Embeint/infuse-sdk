/*
 * Copyright (c) 2025 Embeint Holdings Pty Ltd
 * SPDX-License-Identifier: Apache-2.0
 *
 * This differs substantially from the NCS view of the nRF5340 pins.
 * We join the shared SPI bus as a slave so that the nRF9151 can communicate with.
 * VCOM0 pins are re-purposed as CS and INT lines.
 */

&pinctrl {
	spi0_default: spi0_default {
		group1 {
			psels = <NRF_PSEL(SPIS_SCK, 0, 8)>,
				<NRF_PSEL(SPIS_MOSI, 0, 9)>,
				<NRF_PSEL(SPIS_MISO, 0, 10)>,
				<NRF_PSEL(SPIS_CSN, 0, 29)>;
		};
	};
};
