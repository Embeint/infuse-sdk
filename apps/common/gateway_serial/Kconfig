## apps/common/gateway_serial/Kconfig
```kconfig
# Common serial Bluetooth gateway options

# Default RPCs (if hardware supports)
configdefault INFUSE_RPC_COMMAND_BT_FILE_COPY_BASIC
	default y
```

## apps/gateway_uart/sample.yaml
```yaml
sample:
  description: Bluetooth <-> UART bridge
  name: gateway UART
common:
  tags:
    - app
    - auto
    - data_logger
    - epacket
    - gnss
    - imu
    - kv_store
    - logging
    - math
    - mcumgr
    - modem_monitor
    - rpc
    - serial
    - states
    - task_runner
    - tdf
    - watchdog
    - zbus
  build_only: true
  # Requires Bluetooth, and a serial backhaul that isn't RTT or USB (`gateway_usb`)
  filter: CONFIG_BT and not dt_compat_enabled("segger,rtt-uart") and
    not dt_compat_enabled("zephyr,cdc-acm-uart")
  required_snippets:
    - infuse
  platform_exclude:
    - native_sim
  integration_platforms:
    - nrf52840dk/nrf52840
    - xg24_dk2601b/efr32mg24b310f1536im48
tests:
  sample.app.gateway_uart: {}
  sample.app.gateway_uart.sysbuild:
    sysbuild: true
    filter: not CONFIG_BUILD_WITH_TFM
```

## drivers/charger/Kconfig
```kconfig
# Battery charger drivers

# Copyright (c) 2026 Embeint Holdings Pty Ltd
# SPDX-License-Identifier: Apache-2.0

config CHARGER_AEM15820
	bool "e-peas AEM15820 energy harvesting charger"
	default y
	depends on DT_HAS_EPEAS_AEM15820_CHARGER_ENABLED
	depends on CHARGER
	select MFD
	help
	  Enable the charger child device for the e-peas AEM15820. The
	  devicetree configuration is applied to the device at boot.

config CHARGER_BQ25798
	bool "TI BQ25798 charger status"
	default y
	depends on DT_HAS_TI_BQ25798_CHARGER_ENABLED
	depends on BQ25798
	depends on CHARGER
	help
	  Enable the charger child device for the TI BQ25798. This device
	  exposes the charge status and charge type reported by the BQ25798.
```

## drivers/imu/icm20689/Kconfig
```kconfig
# ICM-20689 6 Axis IMU configuration

# Copyright (c) 2026 Embeint Holdings Pty Ltd
# SPDX-License-Identifier: Apache-2.0

config INFUSE_IMU_ICM20689
	bool "ICM-20689 Inertial measurement unit"
	default y
	depends on DT_HAS_INVENSENSE_ICM20689_ENABLED
	select SPI
	select GPIO
	help
	  Enable driver for ICM-20689 IMU sensor
```

## drivers/imu/iis328dq/Kconfig
```kconfig
# IIS328DQ 3 Axis Accelerometer configuration

# Copyright (c) 2026 Embeint Holdings Pty Ltd
# SPDX-License-Identifier: Apache-2.0

DT_COMPAT_ST_IIS328DQ := st,iis328dq

menuconfig INFUSE_IMU_IIS328DQ
	bool "IIS328DQ Inertial measurement unit"
	default y
	depends on DT_HAS_ST_IIS328DQ_ENABLED
	select I2C if $(dt_compat_on_bus,$(DT_COMPAT_ST_IIS328DQ),i2c)
	select SPI if $(dt_compat_on_bus,$(DT_COMPAT_ST_IIS328DQ),spi)
	help
	  Enable driver for IIS328DQ IMU sensor. The device has no hardware FIFO,
	  samples are buffered in software from the data ready interrupt.

if INFUSE_IMU_IIS328DQ

# Zephyr and Infuse driver conflict
configdefault IIS328DQ
	default n

config IIS328DQ_BUS_I2C
	bool
	default y
	depends on $(dt_compat_on_bus,$(DT_COMPAT_ST_IIS328DQ),i2c)

config IIS328DQ_BUS_SPI
	bool
	default y
	depends on $(dt_compat_on_bus,$(DT_COMPAT_ST_IIS328DQ),spi)

config INFUSE_IMU_IIS328DQ_THREAD_STACK_SIZE
	int "Stack size of the sample reading thread"
	default 1024

config INFUSE_IMU_IIS328DQ_THREAD_PRIORITY
	int "Priority of the sample reading thread"
	default -2
	help
	  The thread must run within one sample period of the data ready interrupt
	  to avoid samples being overwritten. The thread only runs briefly to read
	  each sample, so defaults to a cooperative priority to avoid being starved
	  by long running computation in other threads.

endif # INFUSE_IMU_IIS328DQ
```

## drivers/mfd/Kconfig
```kconfig
# Infuse-IoT multi-function device drivers

# Copyright (c) 2026 Embeint Holdings Pty Ltd
# SPDX-License-Identifier: FSL-1.1-ALv2

config MFD_AEM15820
	bool "e-peas AEM15820 energy harvesting PMIC"
	default y
	depends on DT_HAS_EPEAS_AEM15820_ENABLED
	depends on MFD
	depends on GPIO || $(dt_compat_any_has_prop,$(DT_COMPAT_EPEAS_AEM15820),int-gpios) = n
	select I2C
	help
	  Enable the core driver for the e-peas AEM15820. The core driver
	  mediates register access and IRQ events for the child devices.

config MFD_AEM15820_INIT_PRIORITY
	int "AEM15820 MFD initialization priority"
	default MFD_INIT_PRIORITY
	depends on MFD_AEM15820
```

## drivers/sensor/Kconfig
```kconfig
# Infuse-IoT sensor drivers

config NRF9X_TEMP
	bool "nRF91x internal SoC temperature"
	depends on DT_HAS_NORDIC_NRF9X_TEMP_ENABLED
	depends on NRF_MODEM_LIB
	depends on SENSOR
	default y

config NRF9X_BATT
	bool "nRF91x battery voltage measurement"
	depends on DT_HAS_NORDIC_NRF9X_BATT_ENABLED
	depends on NRF_MODEM_LIB
	depends on SENSOR
	default y

config BQ25798
	bool "TI BQ25798 Buck-Boost Battery Charger"
	depends on DT_HAS_TI_BQ25798_ENABLED
	depends on SENSOR
	default y

if BQ25798

config BQ25798_FETCH_STATUS_CHECKS
	bool "Query status flags on fetch"
	default y

config BQ25798_FETCH_POOR_SOURCE_RETRY
	bool "Automatically retry poor sources on fetch"
	default y
	help
	   By default a poor source is only retried every 7 minutes.
	   Enabling this flag results in `sensor_fetch` retrying the
	   source qualification if the charger is in poor source mode.

config BQ25798_TS_ADC
	bool "Measure battery temperature through the TS ADC channel"
	default y if INFUSE_VALIDATION
	help
	  Convert the TS (thermistor) channel on each sample and report it
	  through SENSOR_CHAN_GAUGE_TEMP. Disabled by default as the channel
	  adds a conversion to every sample and keeps REGN powered in battery
	  only mode, which also raises the battery voltage required for the
	  ADC to run from 2.9V to 3.2V. JEITA charge temperature protection
	  uses separate comparators and is unaffected.

endif

config PAC194X
	bool "Microchip PAC194X single/multi-channel power monitor"
	depends on DT_HAS_MICROCHIP_PAC1941_1_ENABLED
	depends on SENSOR
	default y

config SENSOR_GENERIC_SIM
	bool "Generic simulated sensor"
	depends on DT_HAS_ZEPHYR_GENERIC_SIM_SENSOR_ENABLED
	depends on SENSOR
	default y
	help
	  Simulated sensor that can expose any configured channel.
```

## drivers/watchdog/Kconfig
```kconfig
# Infuse-IoT watchdog configuration

config INFUSE_WATCHDOG
	bool "Use watchdogs in core Infuse subsystems"
	depends on "$(dt_alias_enabled,watchdog0)"
	depends on WATCHDOG
	help
	  When enabled, Infuse subsystems register watchdogs against
	  the watchdog0 devicetree alias. The watchdog must still be
	  started with `infuse_watchdog_start` by the application.

if INFUSE_WATCHDOG

config INFUSE_WATCHDOG_INSTALL_INIT_PRIORITY
	int "POST_KERNEL init priority for installing subsystem watchdog channels"
	range 0 99
	default 99
	help
	  Init priority of the channels installed by `INFUSE_WATCHDOG_REGISTER_SYS_INIT`.
	  Must be after the `watchdog0` device has been initialised, as watchdog
	  drivers are not required to support API calls before initialisation.
	  Channels must also be installed before the watchdog is started with
	  `infuse_watchdog_start`, which must therefore not be called before the
	  APPLICATION init level. Channels are only used by threads, which start
	  after all init levels.

config INFUSE_WATCHDOG_SW_MULTICHANNEL
	bool "Emulate multiple watchdog channels in software"
	depends on INFUSE_WATCHDOG_SOFTWARE_WARNING
	default y if IWDG_STM32 || WDT_GECKO
	help
	  Multiple channels are emulated by feeding the hardware watchdog
	  once all software channels have been fed at least once.

config INFUSE_WATCHDOG_PERIOD_MS
	int "Watchdog period used by Infuse subsystems"
	range 2000 26214 if IWDG_STM32
	range 2000 120000
	default 20000 if IWDG_STM32
	default 35000

config INFUSE_WATCHDOG_FEED_EARLY_MS
	int "Time before expiry to feed the watchdog when idle"
	default 5000
	help
	  Threads that are idle most of the time need to periodically wake up to
	  feed their assigned watchdog channel. This option controls how soon before
	  expiry they do that. If this value is too small, the channel may expire
	  if the CPU is busy while the thread is waiting to wake.

config INFUSE_WATCHDOG_SOFTWARE_WARNING
	bool "Enable a software alarm that provides a pre-warning before hardware expiry"
	default y if SOC_FAMILY_NORDIC_NRF && INFUSE_MEMFAULT
	default y if HAS_WDT_NO_CALLBACKS
	# Callbacks are only supported without SoC reset
	default y if WDT_GECKO

config INFUSE_WATCHDOG_SOFTWARE_WARNING_MS
	int "Milliseconds before hardware expiry to trigger software warning"
	depends on INFUSE_WATCHDOG_SOFTWARE_WARNING
	default 2500

endif # INFUSE_WATCHDOG
```
