## dts/bindings/sensor/ti,bq25798.yaml
```yaml
# Copyright (c) 2025 Embeint Holdings Pty Ltd
# SPDX-License-Identifier: FSL-1.1-ALv2

description: TI BQ25798 Buck-Boost Battery Charger

compatible: "ti,bq25798"

include: [i2c-device.yaml]

bus: bq25798

properties:
  en-gpios:
    type: phandle-array
    required: true
    description: |
      Charger enable GPIO.

  int-gpios:
    type: phandle-array
    required: true
    description: |
      Charger interrupt GPIO.

  v-sys-min:
    type: int
    default: 3500
    description:
      Minimum system voltage in milliVolts. Supports 250mV steps
      from 2500 mV.
      Default is the POR value for a 1S battery.

  v-in-dpm:
    type: int
    enum: [
      3600, 3700, 3800, 3900, 4000, 4100, 4200, 4300, 4400, 4500,
      4600, 4700, 4800, 4900, 5000, 5100, 5200, 5300, 5400, 5500,
      5600, 5700, 5800, 5900, 6000, 6100, 6200, 6300, 6400, 6500,
      6600, 6700, 6800, 6900, 7000, 7100, 7200, 7300, 7400, 7500,
      7600, 7700, 7800, 7900, 8000, 8100, 8200, 8300, 8400, 8500,
      8600, 8700, 8800, 8900, 9000, 9100, 9200, 9300, 9400, 9500,
      9600, 9700, 9800, 9900, 10000, 10100, 10200, 10300, 10400, 10500,
      10600, 10700, 10800, 10900, 11000, 11100, 11200, 11300, 11400, 11500,
      11600, 11700, 11800, 11900, 12000, 12100, 12200, 12300, 12400, 12500,
      12600, 12700, 12800, 12900, 13000, 13100, 13200, 13300, 13400, 13500,
      13600, 13700, 13800, 13900, 14000, 14100, 14200, 14300, 14400, 14500,
      14600, 14700, 14800, 14900, 15000, 15100, 15200, 15300, 15400, 15500,
      15600, 15700, 15800, 15900, 16000, 16100, 16200, 16300, 16400, 16500,
      16600, 16700, 16800, 16900, 17000, 17100, 17200, 17300, 17400, 17500,
      17600, 17700, 17800, 17900, 18000, 18100, 18200, 18300, 18400, 18500,
      18600, 18700, 18800, 18900, 19000, 19100, 19200, 19300, 19400, 19500,
      19600, 19700, 19800, 19900, 20000, 20100, 20200, 20300, 20400, 20500,
      20600, 20700, 20800, 20900, 21000, 21100, 21200, 21300, 21400, 21500,
      21600, 21700, 21800, 21900, 22000
    ]
    default: 3600
    description:
      Minimum voltage target for the PMID supply in milliVolts.
      Supports 100mV steps from 3600mV to 22000mV.
      Default is the POR value.

  input-current-limit:
    type: int
    default: 3000
    description:
      Input current limit in milliAmps.
      Reducing this to 1A or less will give greater current resolution.
      Default is the POR value.

  constant-charge-current-max-microamp:
    type: int
    default: 1000000
    description:
      Maximum constant input current, resolution = 10 mA.
      Default is the POR value.

  charge-term-current-microamp:
    type: int
    default: 200000
    description:
      Current for charge termination phase, resolution = 40 mA.
      Default is the POR value.

  vac-ovp:
    type: int
    enum:
      - 26
      - 18
      - 12
      - 7
    default: 7
    description:
      Input voltage over-voltage protection limit. Default of 7V is the
      chip default.

  safety-timer:
    type: string
    enum:
      - "5h"
      - "8h"
      - "12h"
      - "24h"
      - "Disable"
    default: "12h"
    description:
      Fast charge safety timer duration. Charging is suspended if the safety
      timer expires before charge termination. Default is the POR value.

  mppt-ratio:
    type: int
    enum:
      - 56
      - 62
      - 68
      - 75
      - 81
      - 87
      - 93
      - 100
    description:
      Percentage of the open circuit voltage for the MPPT charger
      to aim for. Don't configure this property to disable MPPT.

  acdrv1-en:
    type: boolean
    description:
      Enable ACFET1-RBFET1 gate driver control

  acdrv2-en:
    type: boolean
    description:
      Enable ACFET2-RBFET2 gate driver control

  ts-rt1:
    type: int
    required: true
    description: |
      RT1 resistance in ohms.

  ts-rt2:
    type: int
    required: true
    description: |
      RT2 resistance in ohms.

  ntc-beta:
    type: int
    default: 3435
    description: |
      NTC Beta value. Default is for a 103AT-2 thermistor

  ntc-r0:
    type: int
    default: 10000
    description: |
      NTC R0 resistance in Ohms. Default is for a 103AT-2 thermistor

  ntc-t0:
    type: int
    default: 299
    description: |
      NTC T0 temperature in Kelvin. Default is for a 103AT-2 thermistor
```

## lib/crypto/tf-psa-crypto/Kconfig
```kconfig
# Crypto library configuration

config PSA_CRYPTO_DRIVER_OBERON
	# The Oberon driver is required to provide HKDF needed for protected storage and builtin keys
	prompt "Oberon PSA driver" if !TFM_PARTITION_PROTECTED_STORAGE
	bool
	depends on SOC_FAMILY_NORDIC_NRF
	default y
	help
	  This configuration enables the usage of the Oberon PSA driver.

config TF_PSA_CRYPTO_OBERON_ACCELERATOR
	bool "PSA crypto acceleration through the Oberon library"
	select TF_PSA_CRYPTO_EXTERNAL_ACCELERATOR_INTEGRATION
	depends on NRF_OBERON
	default y
	help
	  The integration does not attempt to accelerate every algorithm supported
	  by Oberon, only those commonly used by Infuse-IoT.

config TF_PSA_CRYPTO_CRACEN_CHACHA20_POLY1305
	bool "Accelerate ChaCha20-Poly1305 with the CRACEN CryptoMaster"
	depends on TF_PSA_CRYPTO_OBERON_ACCELERATOR
	depends on PSA_WANT_ALG_CHACHA20_POLY1305
	depends on NORDIC_CRACEN
	default y
	help
	  Run one-shot ChaCha20-Poly1305 operations on the CRACEN CryptoMaster
	  instead of the Oberon software implementation. Operations on buffers
	  that the CryptoMaster DMA cannot access continue to use Oberon. The
	  calling thread spins until the CryptoMaster completes (~1.6 cycles
	  per byte). Access to the CRACEN is synchronised by the
	  "nordic,nrf-cracen" device, see CONFIG_NORDIC_CRACEN_SYNC. The CRACEN
	  CTR size workarounds for the nRF54LM20, nRF54LV10 and nRF54LC10 only
	  apply to the AES engine and are not required for ChaCha20. Devices
	  without the BA417 engine are detected at runtime and use Oberon.

config TF_PSA_CRYPTO_CRACEN_CHACHA20_POLY1305_SW_POLY1305
	bool "Compute Poly1305 in software"
	depends on TF_PSA_CRYPTO_CRACEN_CHACHA20_POLY1305
	default y if SOC_NRF54LM20A || SOC_NRF54LM20B
	help
	  Run the CRACEN BA417 engine in plain ChaCha20 mode and compute the
	  Poly1305 authenticator in software. Required on the nRF54LM20, where
	  the combined ChaCha20-Poly1305 mode of the BA417 cannot be used.
	  Decryption where the plaintext overwrites the ciphertext falls back
	  to the Oberon implementation.

config TF_PSA_CRYPTO_OBERON_ACCELERATOR_SHA
	bool "Accelerate SHA algorithms"
	depends on TF_PSA_CRYPTO_OBERON_ACCELERATOR
	help
	  Accelerating SHA costs ~2.7kB of ROM if only SHA256 is enabled,
	  or ~10kB if SHA1, SHA224, SHA256, SHA384 and SHA512 are enabled.
	  Accelerated functions also require additional stack.

config TF_PSA_CRYPTO_OBERON_ACCELERATOR_KEY_AGREEMENT
	bool "Accelerate 'key_agreement' for ECDH Curve25519"
	depends on TF_PSA_CRYPTO_OBERON_ACCELERATOR
	help
	  Accelerating this function costs ~2.7kB of ROM as the builtin
	  implementation cannot be removed without significant other
	  functionality extensions.
```

## lib/libc/Kconfig
```kconfig
# Infuse-IoT C library tweaks

config INFUSE_LIBC_FAST_MEM_FUNCTIONS
	bool "Speed optimised memcpy and memset"
	depends on ARM
	depends on PICOLIBC_USE_TOOLCHAIN
	depends on SIZE_OPTIMIZATIONS
	default y
	help
	  When linking with -Os, GCC selects the size optimised ("space")
	  picolibc multilib from the toolchain, in which memcpy and memset
	  are implemented as byte-by-byte loops. Link the memcpy and memset
	  objects from the speed optimised multilib instead, which copy and
	  set memory a word at a time. The rest of the C library remains
	  size optimised.

	  This costs ~370 bytes of ROM on ARMv8-M.
```

## samples/low_power/sample.yaml
```yaml
sample:
  description: Low power application
  name: Low power
common:
  tags:
    - sample
    - epacket
    - kv_store
    - logging
    - mcumgr
    - rpc
    - states
    - tdf
  build_only: true
  required_snippets:
    - infuse
  integration_platforms:
    - nrf52840dk/nrf52840
    - nrf5340dk/nrf5340/cpuapp
    - nrf5340dk/nrf5340/cpuapp/ns
    - nrf54l15dk/nrf54l15/cpuapp
    - xg24_dk2601b/efr32mg24b310f1536im48
tests:
  sample.low_power: {}
  sample.low_power.rtt:
    filter: CONFIG_HAS_SEGGER_RTT
    required_snippets:
      - rtt
```

## tests/drivers/mfd/aem15820/testcase.yaml
```yaml
common:
  tags:
    - drivers
    - mfd
    - sensor
    - aem15820
  platform_allow:
    - native_sim
    - qemu_cortex_m3
  integration_platforms:
    - native_sim
    - qemu_cortex_m3
tests:
  drivers.mfd.aem15820: {}
  drivers.mfd.aem15820.debug_log:
    extra_configs:
      - CONFIG_LOG=y
      - CONFIG_MFD_LOG_LEVEL_DBG=y
      - CONFIG_SENSOR_LOG_LEVEL_DBG=y
```

## tests/lib/crypto/psa/testcase.yaml
```yaml
common:
  tags: crypto
  min_flash: 192
  min_ram: 64
  timeout: 120
tests:
  libraries.crypto.psa:
    platform_allow:
      - nrf9161dk/nrf9161/ns
      - nrf9151dk/nrf9151/ns
      - nrf54l15dk/nrf54l15/cpuapp
      - nrf54lm20dk/nrf54lm20b/cpuapp
    integration_platforms:
      - nrf9151dk/nrf9151/ns
      - nrf54l15dk/nrf54l15/cpuapp
      - nrf54lm20dk/nrf54lm20b/cpuapp
  libraries.crypto.psa.no_bounce:
    # CRACEN hash input that the DMA cannot access is processed one block per job
    platform_allow:
      - nrf54l15dk/nrf54l15/cpuapp
      - nrf54lm20dk/nrf54lm20b/cpuapp
    integration_platforms:
      - nrf54l15dk/nrf54l15/cpuapp
      - nrf54lm20dk/nrf54lm20b/cpuapp
    extra_configs:
      - CONFIG_TF_PSA_CRYPTO_CRACEN_HASH_BOUNCE_SIZE=0
```

## tests/subsys/epacket/interfaces/udp_ack/testcase.yaml
```yaml
common:
  tags:
    - epacket
    - kv_store
    - net
    - reboot
    - rpc
    - security
    - states
    - tdf
    - time
    - watchdog
  min_flash: 64
  min_ram: 32
  run_sequential: true
tests:
  epacket.interface.udp.ack:
    tags: external_service
    platform_allow:
      - native_sim
    integration_platforms:
      - native_sim
    extra_configs:
      # Local cloud relay, DNS server and control channel provided by pytest/conftest.py
      - CONFIG_INFUSE_SECURITY_CLOUD_PUBLIC_KEY_FILE="cloud_local.yaml"
      - CONFIG_DNS_SERVER_IP_ADDRESSES=y
      - CONFIG_DNS_SERVER1="127.0.0.1:15355"
      - CONFIG_TEST_SHIM_CONTROL_PORT=15312
    extra_args:
      - OVERLAY_CONFIG="overlay-nsos.conf"
    harness: pytest
```

## west.yml
```yaml
# The west manifest file for the Infuse SDK.
#
# SPDX-License-Identifier: FSL-1.1-ALv2

manifest:
  defaults:
    remote: embeint

  remotes:
    - name: embeint
      url-base: https://github.com/embeint
    - name: memfault
      url-base: https://github.com/memfault
    - name: ncs
      url-base: https://github.com/nrfconnect

  projects:
    - name: zephyr
      revision: fa53c449ee9745e9e087a5c943b79ccdc6a2d345
      # Limit imported repositories to reduce clone time
      import:
        name-allowlist:
          - cmsis-dsp
          - cmsis_6
          - hal_nordic
          - hal_st
          - hal_stm32
          - hostap
          - libmetal
          - littlefs
          - lora-basics-modem
          - loramac-node
          - fatfs
          - mbedtls
          - mbedtls-3.6 # Required for TF-M build until TF-M jumps to v2.3
          - open-amp
          - segger
          - nrf_wifi
          - tf-psa-crypto
          - tinycrypt
          - trusted-firmware-m
          - picolibc
          - zcbor
    - name: mcuboot
      revision: 88e5b0bd61bc354ce4c8e2d05113e3c5334930df
      path: bootloader/mcuboot
    - name: sdk-nrf
      path: modules/nrfconnect/sdk-nrf
      revision: bfeda0e2f1ddadce4f87e3e1ee7e5a26522940f4
      import: true
    - name: memfault-firmware-sdk
      path: modules/lib/memfault
      revision: 1.47.1
      remote: memfault

  self:
    path: infuse-sdk
    west-commands: scripts/west-commands.yml
    import: submanifests
```
