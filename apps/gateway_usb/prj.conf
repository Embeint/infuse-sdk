## CMakeLists.txt
```
# SPDX-License-Identifier: Apache-2.0

cmake_minimum_required(VERSION 3.20.0)

# Infuse-IoT application
if(NOT infuse IN_LIST SNIPPET)
  set(SNIPPET infuse ${SNIPPET} CACHE STRING "" FORCE)
endif()
if(NOT usb IN_LIST SNIPPET)
  # Force USB snippet to end to overwrite infuse defaults
  set(SNIPPET ${SNIPPET} usb CACHE STRING "" FORCE)
endif()

find_package(Zephyr REQUIRED HINTS $ENV{ZEPHYR_BASE})
project(gateway_usb)

target_sources(app PRIVATE
  src/main.c
)
```

## Kconfig
```
# USB Gateway specific options

# Default RPCs (if hardware supports)
configdefault INFUSE_RPC_COMMAND_BT_FILE_COPY_BASIC
	default y

source "Kconfig.zephyr"
```

## sample.yaml
```
sample:
  description: Bluetooth <-> USB bridge
  name: gateway USB
common:
  tags:
    - app
    - auto
    - data_logger
    - epacket
    - gnss
    - imu
    - kv_store
    - logging
    - math
    - mcumgr
    - modem_monitor
    - rpc
    - states
    - task_runner
    - tdf
    - usb
    - watchdog
    - zbus
  build_only: true
  required_snippets:
    - infuse
  depends_on:
    - usbd
  platform_exclude:
    - native_sim
  integration_platforms:
    - nrf52840dk/nrf52840
    - nrf5340dk/nrf5340/cpuapp
    - nrf5340dk/nrf5340/cpuapp/ns
    - nrf54lm20dk/nrf54lm20b/cpuapp
tests:
  sample.app.gateway_usb: {}
  sample.app.gateway_usb.sysbuild:
    sysbuild: true
    filter: not CONFIG_BUILD_WITH_TFM
```

## prj.conf
```kconfig
# USB Gateway options
CONFIG_INFUSE_SDK=y
CONFIG_INFUSE_WATCHDOG=y

CONFIG_EPACKET_FORWARDING=y
CONFIG_EPACKET_BUFFERS_TX=6
CONFIG_EPACKET_BUFFERS_RX=16

# Application does not send advertising payloads
CONFIG_EPACKET_INTERFACE_BT_ADV_CONNECTABLE_WATCHDOG_SEC=0

# Bluetooth
CONFIG_BT_CENTRAL=y

# USB
CONFIG_USB_DEVICE_STACK_NEXT=y
CONFIG_USBD_CDC_ACM_WORKQUEUE=y
CONFIG_INFUSE_CDC_ACM_SERIAL_INITIALIZE_AT_BOOT=y

# Tasks
CONFIG_TASK_RUNNER=y
CONFIG_TASK_RUNNER_AUTO_ITERATE=y
CONFIG_TASK_RUNNER_TASK_TDF_LOGGER=y
CONFIG_TASK_RUNNER_TASK_BATTERY=y

# Gateway RPCs
CONFIG_INFUSE_RPC_CLIENT=y
```

## app.overlay
```dts
#include "common/usb.dtsi"
```

## src/main.c
```c
/**
 * @file
 * @copyright 2024 Embeint Holdings Pty Ltd
 * @author Jordan Yates <jordan@embeint.com>
 *
 * SPDX-License-Identifier: FSL-1.1-ALv2
 */

#include <stdio.h>

#include <zephyr/kernel.h>
#include <zephyr/logging/log.h>
#include <zephyr/drivers/gpio.h>

#include <infuse/auto/bluetooth_conn_log.h>
#include <infuse/epacket/interface.h>
#include <infuse/epacket/packet.h>
#include <infuse/data_logger/high_level/tdf.h>
#include <infuse/tdf/definitions.h>
#include <infuse/drivers/watchdog.h>

#include <infuse/task_runner/runner.h>
#include <infuse/task_runner/tasks/infuse_tasks.h>

LOG_MODULE_REGISTER(app, LOG_LEVEL_INF);

GATEWAY_HANDLER_DEFINE(serial_backhaul_handler, DEVICE_DT_GET(DT_NODELABEL(epacket_serial)));

static const struct task_schedule schedules[] = {
	{
		.task_id = TASK_ID_TDF_LOGGER,
		.validity = TASK_VALID_ALWAYS,
		.periodicity_type = TASK_PERIODICITY_LOCKOUT,
		.periodicity.lockout.lockout_s = SEC_PER_MIN,
		.task_args.tdf_logger =
			{
				.loggers = TDF_DATA_LOGGER_SERIAL,
				.random_delay_ms = 1000,
				.tdfs = TASK_TDF_LOGGER_LOG_ANNOUNCE | TASK_TDF_LOGGER_LOG_BATTERY,
			},
	},
};

TASK_SCHEDULE_STATES_DEFINE(states, schedules);
TASK_RUNNER_TASKS_DEFINE(app_tasks, app_tasks_data, (TDF_LOGGER_TASK, NULL));

int main(void)
{
	const struct device *epacket_bt_adv = DEVICE_DT_GET(DT_NODELABEL(epacket_bt_adv));
	const struct device *epacket_bt_central = DEVICE_DT_GET(DT_NODELABEL(epacket_bt_central));
	const struct device *epacket_serial = DEVICE_DT_GET(DT_NODELABEL(epacket_serial));

	/* Log Bluetooth connection events */
	auto_bluetooth_conn_log_configure(TDF_DATA_LOGGER_SERIAL, AUTO_BT_CONN_LOG_EVENTS_FLUSH);

	/* Start watchdog */
	infuse_watchdog_start();

	/* Gateway receive handlers */
	epacket_set_receive_handler(epacket_serial, serial_backhaul_handler);
	epacket_set_receive_handler(epacket_bt_adv, serial_backhaul_handler);
	epacket_set_receive_handler(epacket_bt_central, serial_backhaul_handler);

	/* Always listening on Bluetooth advertising and serial */
	epacket_receive(epacket_serial, K_FOREVER);
	epacket_receive(epacket_bt_adv, K_FOREVER);

	/* Send key identifiers on boot */
	epacket_send_key_ids(epacket_serial, K_FOREVER);

	/* Initialise task runner */
	task_runner_init(schedules, states, ARRAY_SIZE(schedules), app_tasks, app_tasks_data,
			 ARRAY_SIZE(app_tasks));

	/* Start auto iteration */
	task_runner_start_auto_iterate();

#if DT_NODE_HAS_STATUS_OKAY(DT_ALIAS(led0))
	const struct gpio_dt_spec led = GPIO_DT_SPEC_GET(DT_ALIAS(led0), gpios);

	/* Blink LED once a second as proof of life */
	gpio_pin_configure_dt(&led, GPIO_OUTPUT_INACTIVE);
	while (1) {
		gpio_pin_set_dt(&led, 1);
		k_sleep(K_MSEC(10));
		gpio_pin_set_dt(&led, 0);
		k_sleep(K_MSEC(990));
	}
#else
	/* No more work to do in this context */
	k_sleep(K_FOREVER);
#endif
}
```
