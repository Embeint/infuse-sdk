## CMakeLists.txt
```
# SPDX-License-Identifier: Apache-2.0

cmake_minimum_required(VERSION 3.20.0)

# Infuse-IoT application
if(NOT infuse IN_LIST SNIPPET)
  set(SNIPPET infuse ${SNIPPET} CACHE STRING "" FORCE)
endif()

find_package(Zephyr REQUIRED HINTS $ENV{ZEPHYR_BASE})
project(data_logger)

target_sources(app PRIVATE
  src/main.c
)
```

## Kconfig
```
# Data logger application specific defaults

# nRF700x overflows flash with asserts enabled
configdefault ASSERT
	default y if !WIFI_NRF70

source "Kconfig.zephyr"
```

## sample.yaml
```
sample:
  description: Basic data logger
  name: Data Logger
common:
  tags:
    - app
    - auto
    - bluetooth
    - data_logger
    - dfu
    - epacket
    - gnss
    - imu
    - kv_store
    - logging
    - math
    - mcumgr
    - memfault
    - modem
    - modem_monitor
    - net
    - reboot
    - rpc
    - sensor
    - shared_device
    - states
    - task_runner
    - tdf
    - time
    - version
    - watchdog
    - zbus
  build_only: true
  required_snippets:
    - infuse
tests:
  sample.app.data_logger:
    platform_allow:
      - thingy53/nrf5340/cpuapp/ns
      - thingy53/nrf5340/cpuapp
      - tauro/nrf9151/ns
    integration_platforms:
      - thingy53/nrf5340/cpuapp/ns
      - thingy53/nrf5340/cpuapp
      - tauro/nrf9151/ns
  sample.app.data_logger.wifi:
    sysbuild: true
    filter: not CONFIG_BUILD_WITH_TFM
    extra_args:
      - data_logger_SHIELD=nrf7002eb
      - data_logger_EXTRA_DTC_OVERLAY_FILE=boards/shields/epacket_udp.overlay
    platform_allow:
      - thingy53/nrf5340/cpuapp/ns
      - thingy53/nrf5340/cpuapp
    integration_platforms:
      - thingy53/nrf5340/cpuapp/ns
      - thingy53/nrf5340/cpuapp
```

## prj.conf
```kconfig
# Logger options
CONFIG_INFUSE_SDK=y
CONFIG_INFUSE_WATCHDOG=y
# CONFIG_DATA_LOGGER_RAM_BUFFER=y

CONFIG_TASK_RUNNER=y
CONFIG_TASK_RUNNER_AUTO_ITERATE=y
CONFIG_TASK_RUNNER_TASK_TDF_LOGGER=y
CONFIG_TASK_RUNNER_TASK_IMU=y
CONFIG_TASK_RUNNER_TASK_BATTERY=y
CONFIG_TASK_RUNNER_TASK_ENVIRONMENTAL=y
CONFIG_TASK_RUNNER_TASK_GNSS=y

# Short data validity as application constantly logs
CONFIG_TASK_TDF_LOGGER_LOCATION_TIMEOUT_SEC=5
CONFIG_TASK_TDF_LOGGER_IMU_TIMEOUT_SEC=5
CONFIG_TASK_TDF_LOGGER_ENVIRONMENTAL_TIMEOUT_SEC=30

CONFIG_MEMFAULT=y
CONFIG_MEMFAULT_METRICS=y

CONFIG_SYSTEM_WORKQUEUE_STACK_SIZE=2048
CONFIG_BT_HCI_TX_STACK_SIZE_WITH_PROMPT=y
CONFIG_BT_HCI_TX_STACK_SIZE=2048
CONFIG_BT_RX_STACK_SIZE=2048

CONFIG_BT=y
CONFIG_BT_DEVICE_NAME="3D Acc"
CONFIG_HEAP_MEM_POOL_SIZE=8192
CONFIG_MAIN_STACK_SIZE=4096
# 2 is default
CONFIG_BT_EXT_ADV_MAX_ADV_SET=3
CONFIG_BT_MAX_CONN=4

CONFIG_BT_INFUSE_LEGACY_ADV_INTERVAL_MIN=2500
CONFIG_BT_INFUSE_LEGACY_ADV_INTERVAL_MAX=3000
CONFIG_TASK_RUNNER_TASK_IMU_LOG_IDX_ARRAY=y
```

## app.overlay
```dts
#include <mem.h>

/ {
	/* Batch writes to the SD card */
	data_logger_exfat {
		extra-ram-buffer = <DT_SIZE_K(8)>;
	};
};
```

## boards/tauro_nrf9151_ns.overlay
```dts
#include <mem.h>

/ {
	chosen {
		infuse,memfault-epacket-dump = &epacket_udp;
	};

	/* Batch writes to the SD card */
	data_logger_exfat {
		extra-ram-buffer = <DT_SIZE_K(8)>;
	};
};
```

## src/main.c
```c
/**
 * @file
 * @copyright 2024 Embeint Holdings Pty Ltd
 * @author Jordan Yates <jordan@embeint.com>
 *
 * SPDX-License-Identifier: FSL-1.1-ALv2
 */

#include <zephyr/kernel.h>
#include <zephyr/logging/log.h>
#include <zephyr/drivers/sensor.h>
#include <zephyr/pm/device_runtime.h>
#include <zephyr/net/conn_mgr_connectivity.h>

#include <infuse/reboot/tdf.h>
#include <infuse/version.h>
#include <infuse/auto/kv_update_log.h>
#include <infuse/auto/time_sync_log.h>
#include <infuse/bluetooth/legacy_adv.h>
#include <infuse/drivers/watchdog.h>
#include <infuse/dfu/exfat.h>
#include <infuse/time/epoch.h>
#include <infuse/fs/kv_store.h>
#include <infuse/fs/kv_types.h>
#include <infuse/epacket/interface.h>
#include <infuse/epacket/packet.h>
#include <infuse/lib/memfault.h>
#include <infuse/data_logger/high_level/tdf.h>
#include <infuse/tdf/definitions.h>

#include <infuse/task_runner/runner.h>
#include <infuse/task_runner/tasks/infuse_tasks.h>

LOG_MODULE_REGISTER(app, LOG_LEVEL_INF);

static void custom_tdf_logger(uint8_t tdf_loggers, uint64_t timestamp);

/* Log data to SD card if available, otherwise serial and UDP comms */
#if defined(CONFIG_DATA_LOGGER_EXFAT)
/* External SD card is the preferred logging backend */
#define STORAGE_LOGGER TDF_DATA_LOGGER_REMOVABLE
#elif defined(CONFIG_NRF_MODEM_LIB)
/* If UDP is implemented by LTE, don't use as it will chew up data quotas */
#define STORAGE_LOGGER TDF_DATA_LOGGER_SERIAL
#else
/* Otherwise use serial and UDP (WiFi)*/
#define STORAGE_LOGGER TDF_DATA_LOGGER_SERIAL | TDF_DATA_LOGGER_UDP
#endif /* CONFIG_DATA_LOGGER_EXFAT */

static const struct task_schedule schedules[] = {
#ifdef CONFIG_EPACKET_INTERFACE_UDP
	{
		.task_id = TASK_ID_TDF_LOGGER,
		.validity = TASK_VALID_ALWAYS,
		.periodicity_type = TASK_PERIODICITY_LOCKOUT,
		.periodicity.lockout.lockout_s = 5 * SEC_PER_MIN,
		.task_args.tdf_logger =
			{
				.loggers = TDF_DATA_LOGGER_UDP,
				.tdfs = TASK_TDF_LOGGER_LOG_ANNOUNCE | TASK_TDF_LOGGER_LOG_BATTERY |
					TASK_TDF_LOGGER_LOG_AMBIENT_ENV |
					TASK_TDF_LOGGER_LOG_LOCATION | TASK_TDF_LOGGER_LOG_ACCEL |
					TASK_TDF_LOGGER_LOG_NET_CONN | TASK_TDF_LOGGER_LOG_CUSTOM,
			},
	},
#endif /* CONFIG_EPACKET_INTERFACE_UDP */
	{
		.task_id = TASK_ID_TDF_LOGGER,
		.validity = TASK_VALID_ALWAYS,
		.periodicity_type = TASK_PERIODICITY_LOCKOUT,
		.periodicity.lockout.lockout_s = 2,
		.task_args.tdf_logger =
			{
				.loggers = TDF_DATA_LOGGER_BT_ADV | TDF_DATA_LOGGER_SERIAL,
				.random_delay_ms = 1000,
				.tdfs = TASK_TDF_LOGGER_LOG_ANNOUNCE | TASK_TDF_LOGGER_LOG_BATTERY |
					TASK_TDF_LOGGER_LOG_AMBIENT_ENV |
					TASK_TDF_LOGGER_LOG_LOCATION | TASK_TDF_LOGGER_LOG_ACCEL |
					TASK_TDF_LOGGER_LOG_NET_CONN,
			},
	},
	{
		.task_id = TASK_ID_IMU,
		.validity = TASK_VALID_ALWAYS,
		.task_logging =
			{
				{
					.loggers = STORAGE_LOGGER,
					.tdf_mask = TASK_IMU_LOG_ACC | TASK_IMU_LOG_GYR,
				},
			},
		.task_args.imu =
			{
				.accelerometer =
					{
						.range_g = 4,
						.rate_hz = 50,
					},
				.gyroscope =
					{
						.range_dps = 500,
						.rate_hz = 50,
					},
				.fifo_sample_buffer = 100,
			},
	},
#if DT_NODE_HAS_STATUS_OKAY(DT_ALIAS(gnss))
	{
		.task_id = TASK_ID_GNSS,
		.validity = TASK_VALID_ALWAYS,
		.battery_start.lower = 30,
		.battery_terminate.lower = 20,
		.task_logging =
			{
				{
					.loggers = STORAGE_LOGGER,
					.tdf_mask = TASK_GNSS_LOG_PVT,
				},
			},
		.task_args.gnss =
			{
				.flags = TASK_GNSS_FLAGS_RUN_FOREVER |
					 TASK_GNSS_FLAGS_PERFORMANCE_MODE,
				.dynamic_model = UBX_CFG_NAVSPG_DYNMODEL_PORTABLE,
			},
	},
#endif /* DT_NODE_HAS_STATUS_OKAY(DT_ALIAS(gnss)) */
	{
		.task_id = TASK_ID_BATTERY,
		.validity = TASK_VALID_ALWAYS,
		.periodicity_type = TASK_PERIODICITY_FIXED,
		.periodicity.fixed.period_s = 5,
		.task_logging =
			{
				{
					.loggers = STORAGE_LOGGER,
					.tdf_mask = TASK_BATTERY_LOG_COMPLETE,
				},
			},
	},
	{
		.task_id = TASK_ID_ENVIRONMENTAL,
		.validity = TASK_VALID_ALWAYS,
		.periodicity_type = TASK_PERIODICITY_FIXED,
		.periodicity.fixed.period_s = 5,
		.task_logging =
			{
				{
					.loggers = STORAGE_LOGGER,
					.tdf_mask = TASK_ENVIRONMENTAL_LOG_TPH,
				},
			},
	},
};

#if DT_NODE_HAS_STATUS_OKAY(DT_ALIAS(gnss))
#define GNSS_TASK_DEFINE (GNSS_TASK, DEVICE_DT_GET(DT_ALIAS(gnss)))
#else
#define GNSS_TASK_DEFINE
#endif

TASK_SCHEDULE_STATES_DEFINE(states, schedules);
TASK_RUNNER_TASKS_DEFINE(app_tasks, app_tasks_data, (TDF_LOGGER_TASK, custom_tdf_logger),
			 (IMU_TASK, DEVICE_DT_GET(DT_ALIAS(imu0))), GNSS_TASK_DEFINE,
			 (BATTERY_TASK, DEVICE_DT_GET(DT_ALIAS(fuel_gauge0))),
			 (ENVIRONMENTAL_TASK, DEVICE_DT_GET(DT_ALIAS(environmental0)),
			  DEVICE_DT_GET_OR_NULL(DT_ALIAS(environmental1))));

static void custom_tdf_logger(uint8_t tdf_loggers, uint64_t timestamp)
{
#if defined(CONFIG_INFUSE_MEMFAULT) && DT_NODE_EXISTS(DT_CHOSEN(infuse_memfault_epacket_dump))
	if (tdf_loggers & TDF_DATA_LOGGER_UDP) {
		/* Dump any pending Memfault chunks after the UDP TDF send */
		(void)infuse_memfault_queue_dump_all(K_MSEC(50));
	}
#endif
}

#ifdef CONFIG_INFUSE_DFU_EXFAT
static void dfu_progress_cb(uint32_t copied, uint32_t total)
{
	ARG_UNUSED(copied);
	ARG_UNUSED(total);

	/* Feed all the watchdogs */
	infuse_watchdog_feed_all();
}

static void dfu_exfat_run(void)
{
	const struct device *logger = DEVICE_DT_GET_ONE(embeint_data_logger_exfat);
	uint8_t upgrade_partition = PARTITION_ID(slot1_partition);
	struct infuse_version upgrade_version;

	if (dfu_exfat_app_upgrade_exists(logger, &upgrade_version) == 1) {
		LOG_INF("Upgrade image to %d.%d.%d", upgrade_version.major, upgrade_version.minor,
			upgrade_version.revision);
		if (dfu_exfat_app_upgrade_copy(logger, upgrade_version, upgrade_partition,
					       dfu_progress_cb, dfu_progress_cb) == 0) {
			LOG_INF("New image copied");
			if (boot_request_upgrade_multi(0, 0) == 0) {
				LOG_INF("Rebooting into new image");
				infuse_reboot(INFUSE_REBOOT_DFU, (uintptr_t)dfu_exfat_run, 0x00);
			}
		}
	}
}
#endif /* CONFIG_INFUSE_DFU_EXFAT */

int main(void)
{
	/* Start the watchdog */
	(void)infuse_watchdog_start();

#ifdef CONFIG_INFUSE_DFU_EXFAT
	dfu_exfat_run();
#endif /* CONFIG_INFUSE_DFU_EXFAT */

	/* Log reboot events */
	tdf_reboot_info_log(TDF_DATA_LOGGER_REMOVABLE | TDF_DATA_LOGGER_BT_ADV |
			    TDF_DATA_LOGGER_SERIAL | TDF_DATA_LOGGER_UDP);

	/* Configure time event logging */
	auto_time_sync_log_configure(STORAGE_LOGGER,
				     AUTO_TIME_SYNC_LOG_SYNCS | AUTO_TIME_SYNC_LOG_REBOOT_ON_SYNC);

	/* Start legacy Bluetooth advertising to workaround iOS and
	 * Nordic Softdevice connection issues.
	 */
	bluetooth_legacy_advertising_run();

#ifdef CONFIG_NETWORKING
	conn_mgr_all_if_up(true);
	conn_mgr_all_if_connect(true);
#endif /* CONFIG_NETWORKING */

	/* Initialise task runner */
	task_runner_init(schedules, states, ARRAY_SIZE(schedules), app_tasks, app_tasks_data,
			 ARRAY_SIZE(app_tasks));

	/* Log KV store changes to storage */
	auto_kv_update_log_configure(STORAGE_LOGGER);

	/* Start auto iteration */
	task_runner_start_auto_iterate();

	/* No more work to do in this context */
	k_sleep(K_FOREVER);
}
```

## src/battery.c
```c
/**
 * @file
 * @copyright 2024 Embeint Inc
 * @author Jordan Yates <jordan@embeint.com>
 *
 * SPDX-License-Identifier: LicenseRef-Embeint
 */

#include <zephyr/devicetree.h>
#include <zephyr/device.h>
#include <zephyr/drivers/sensor.h>
#include <zephyr/kernel.h>
#include <zephyr/logging/log.h>

#include <infuse/time/civil.h>
#include <infuse/tdf/definitions.h>
#include <infuse/data_logger/high_level/tdf.h>

LOG_MODULE_DECLARE(app);

static int bat_sampler(void *a, void *b, void *c)
{
	const struct device *bat = DEVICE_DT_GET(DT_NODELABEL(vbatt));
	struct tdf_battery_state tdf_battery;
	struct sensor_value value;
	int rc;

	uint64_t now = k_uptime_get();

	while (true) {
		now += 5000;
		/* Wait until the next sample time */
		k_sleep(K_TIMEOUT_ABS_MS(now));

		/* Trigger the sample */
		rc = sensor_sample_fetch(bat);
		if (rc < 0) {
			LOG_ERR("Failed to fetch %s (%d)", bat->name, rc);
			break;
		}

		/* Populate the output TDF */
		(void)sensor_channel_get(bat, SENSOR_CHAN_GAUGE_VOLTAGE, &value);
		tdf_battery.voltage_mv = sensor_value_to_milli(&value);
		(void)sensor_channel_get(bat, SENSOR_CHAN_GAUGE_STATE_OF_CHARGE, &value);
		tdf_battery.soc = sensor_value_to_centi(&value);
		tdf_battery.charge_ua = 0;

		/* Push the output TDF over serial */
		tdf_data_logger_log(TDF_DATA_LOGGER_SERIAL | TDF_DATA_LOGGER_UDP, TDF_BATTERY_STATE,
				    sizeof(tdf_battery), civil_time_now(), &tdf_battery);

		/* Print the measured values */
		LOG_INF("Sensor: %s", bat->name);
		LOG_INF("\t        Voltage: %6d mV", tdf_battery.voltage_mv);
		LOG_INF("\tState-of-charge: %6d %%", tdf_battery.soc / 100);
		LOG_INF("\t Charge Current: %6d uA", tdf_battery.charge_ua);
	}
	k_sleep(K_FOREVER);
	return 0;
}

K_THREAD_DEFINE(bat_sampler_thread, 2048, bat_sampler, NULL, NULL, NULL, 0, K_ESSENTIAL, 0);
```

## src/environmental.c
```c
/**
 * @file
 * @copyright 2024 Embeint Inc
 * @author Jordan Yates <jordan@embeint.com>
 *
 * SPDX-License-Identifier: LicenseRef-Embeint
 */

#include <zephyr/devicetree.h>
#include <zephyr/device.h>
#include <zephyr/drivers/sensor.h>
#include <zephyr/kernel.h>
#include <zephyr/logging/log.h>

#include <infuse/time/civil.h>
#include <infuse/tdf/definitions.h>
#include <infuse/data_logger/high_level/tdf.h>

LOG_MODULE_DECLARE(app);

static int env_sampler(void *a, void *b, void *c)
{
	const struct device *env = DEVICE_DT_GET(DT_NODELABEL(bme688));
	struct tdf_environmental tdf_env;
	struct sensor_value value;
	int rc;

	uint64_t now = k_uptime_get();

	while (true) {
		now += 5000;
		/* Wait until the next sample time */
		k_sleep(K_TIMEOUT_ABS_MS(now));

		/* Trigger the sample */
		rc = sensor_sample_fetch(env);
		if (rc < 0) {
			LOG_ERR("Failed to fetch %s (%d)", env->name, rc);
			break;
		}

		/* Populate the output TDF */
		rc = sensor_channel_get(env, SENSOR_CHAN_AMBIENT_TEMP, &value);
		tdf_env.temperature = sensor_value_to_milli(&value);
		rc = sensor_channel_get(env, SENSOR_CHAN_PRESS, &value);
		tdf_env.pressure = sensor_value_to_milli(&value);
		rc = sensor_channel_get(env, SENSOR_CHAN_HUMIDITY, &value);
		tdf_env.humidity = sensor_value_to_centi(&value);

		/* Push the output TDF over serial */
		tdf_data_logger_log(TDF_DATA_LOGGER_SERIAL | TDF_DATA_LOGGER_UDP, TDF_ENVIRONMENTAL,
				    sizeof(tdf_env), civil_time_now(), &tdf_env);

		/* Print the measured values */
		LOG_INF("Sensor: %s", env->name);
		LOG_INF("\tTemperature: %6d mDeg", tdf_env.temperature);
		LOG_INF("\t   Pressure: %6d Pa", tdf_env.pressure);
		LOG_INF("\t   Humidity: %6d %%", tdf_env.humidity / 100);
	}
	k_sleep(K_FOREVER);
	return 0;
}

K_THREAD_DEFINE(env_sampler_thread, 2048, env_sampler, NULL, NULL, NULL, 0, K_ESSENTIAL, 0);
```

## src/imu.c
```c
/**
 * @file
 * @copyright 2024 Embeint Inc
 * @author Jordan Yates <jordan@embeint.com>
 *
 * SPDX-License-Identifier: LicenseRef-Embeint
 */

#include <zephyr/devicetree.h>
#include <zephyr/device.h>
#include <zephyr/drivers/sensor.h>
#include <zephyr/kernel.h>
#include <zephyr/logging/log.h>

#include <infuse/time/civil.h>
#include <infuse/tdf/definitions.h>
#include <infuse/data_logger/high_level/tdf.h>
#include <infuse/drivers/imu.h>

#define IMU_SAMPLE_ARRAY_LEN 256
IMU_SAMPLE_ARRAY_CREATE(imu_sample_buffer, IMU_SAMPLE_ARRAY_LEN);

/* Validate IMU and TDFs match */
BUILD_ASSERT(sizeof(struct imu_sample) == sizeof(struct tdf_acc_4g));

LOG_MODULE_DECLARE(app);

static void imu_sample_handler(struct imu_sample_array *samples)
{
	struct imu_sample *last_acc, *last_gyr;
	uint64_t civil_time;

	/* Print last sample from each array */
	last_acc = &imu_sample_buffer->samples[imu_sample_buffer->accelerometer.offset +
					       imu_sample_buffer->accelerometer.num - 1];
	last_gyr = &imu_sample_buffer->samples[imu_sample_buffer->gyroscope.offset +
					       imu_sample_buffer->gyroscope.num - 1];
	if (imu_sample_buffer->accelerometer.num) {
		LOG_INF("ACC [%3d] %6d %6d %6d", imu_sample_buffer->accelerometer.num - 1,
			last_acc->x, last_acc->y, last_acc->z);
	}
	if (imu_sample_buffer->gyroscope.num) {
		LOG_INF("GYR [%3d] %6d %6d %6d", imu_sample_buffer->gyroscope.num - 1, last_gyr->x,
			last_gyr->y, last_gyr->z);
	}

	/* Log data as TDFs */
	if (imu_sample_buffer->accelerometer.num) {
		civil_time =
			civil_time_from_ticks(imu_sample_buffer->accelerometer.timestamp_ticks);
		tdf_data_logger_log_array(
			TDF_DATA_LOGGER_SERIAL | TDF_DATA_LOGGER_UDP, TDF_ACC_4G,
			sizeof(struct imu_sample), imu_sample_buffer->accelerometer.num, civil_time,
			civil_period_from_ticks(imu_sample_buffer->accelerometer.period_ticks),
			&imu_sample_buffer->samples[imu_sample_buffer->accelerometer.offset]);
	}
	if (imu_sample_buffer->gyroscope.num) {
		civil_time = civil_time_from_ticks(imu_sample_buffer->gyroscope.timestamp_ticks);
		tdf_data_logger_log_array(
			TDF_DATA_LOGGER_SERIAL | TDF_DATA_LOGGER_UDP, TDF_GYR_500DPS,
			sizeof(struct imu_sample), imu_sample_buffer->gyroscope.num, civil_time,
			civil_period_from_ticks(imu_sample_buffer->gyroscope.period_ticks),
			&imu_sample_buffer->samples[imu_sample_buffer->gyroscope.offset]);
	}
}

static int imu_sampler(void *a, void *b, void *c)
{
	const struct device *imu = DEVICE_DT_GET(DT_NODELABEL(bmi270));
	struct imu_config config = {
		.accelerometer =
			{
				.full_scale_range = 4,
				.sample_rate_hz = 50,
				.low_power = false,
			},
		.gyroscope =
			{
				.full_scale_range = 500,
				.sample_rate_hz = 50,
				.low_power = false,
			},
		.fifo_sample_buffer = 100,
	};
	struct imu_config_output config_output;
	k_timeout_t interrupt_timeout;
	int rc;

	rc = imu_configure(imu, &config, &config_output);

	LOG_WRN("%d Acc period: %d us Gyr period: %d us Int period: %d us", rc,
		config_output.accelerometer_period_us, config_output.gyroscope_period_us,
		config_output.expected_interrupt_period_us);

	interrupt_timeout = K_USEC(2 * config_output.expected_interrupt_period_us);
	while (true) {
		/* Wait for the next IMU interrupt */
		rc = imu_data_wait(imu, interrupt_timeout);
		if (rc < 0) {
			LOG_ERR("Timed out waiting for data");
			break;
		}

		/* Read IMU samples */
		rc = imu_data_read(imu, imu_sample_buffer, IMU_SAMPLE_ARRAY_LEN);
		if (rc < 0) {
			LOG_ERR("Failed to read IMU samples (%d)", rc);
			break;
		}

		/* Handle the samples */
		imu_sample_handler(imu_sample_buffer);
	}

	/* Put IMU back into low power mode */
	(void)imu_configure(imu, NULL, NULL);
	k_sleep(K_FOREVER);
	return 0;
}

K_THREAD_DEFINE(imu_sampler_thread, 2048, imu_sampler, NULL, NULL, NULL, 0, K_ESSENTIAL, 0);
```
