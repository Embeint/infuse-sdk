## CMakeLists.txt
```
# SPDX-License-Identifier: Apache-2.0

cmake_minimum_required(VERSION 3.20.0)

# Infuse-IoT application
if(NOT infuse IN_LIST SNIPPET)
  set(SNIPPET infuse ${SNIPPET} CACHE STRING "" FORCE)
endif()

find_package(Zephyr REQUIRED HINTS $ENV{ZEPHYR_BASE})
project(gateway_wifi)

target_sources(app PRIVATE
  src/main.c
)
```

## Kconfig
```
# WiFi Gateway specific options/defaults

# Default RPCs (if hardware supports)
configdefault INFUSE_RPC_COMMAND_BT_FILE_COPY_BASIC
	default y
configdefault INFUSE_RPC_COMMAND_BT_FILE_COPY_COAP
	default y

# Disable the packet discarding behaviour of the nRF70 driver
configdefault NRF70_MAX_TX_PENDING_QLEN
	default 32768

source "Kconfig.zephyr"
```

## sample.yaml
```
sample:
  description: Bluetooth <-> WiFi bridge
  name: gateway WiFi
common:
  tags:
    - app
    - auto
    - bluetooth
    - data_logger
    - epacket
    - gnss
    - imu
    - kv_store
    - logging
    - math
    - mcumgr
    - modem_monitor
    - net
    - rpc
    - states
    - task_runner
    - tdf
    - watchdog
    - zbus
  build_only: true
  filter: not CONFIG_BUILD_WITH_TFM
  required_snippets:
    - infuse
  depends_on:
    - netif
    - wifi
  integration_platforms:
    - nrf7002dk/nrf5340/cpuapp
tests:
  sample.app.gateway_wifi: {}
  sample.app.gateway_wifi.sysbuild:
    sysbuild: true
```

## prj.conf
```kconfig
# WiFi Gateway options
CONFIG_INFUSE_SDK=y
CONFIG_INFUSE_WATCHDOG=y
CONFIG_EPACKET_FORWARDING=y
CONFIG_EPACKET_PACKET_SIZE_MAX=1360
CONFIG_EPACKET_BUFFERS_TX=10
CONFIG_EPACKET_BUFFERS_RX=8
CONFIG_MAIN_STACK_SIZE=4096

# TDF announce sending
CONFIG_TASK_RUNNER=y
CONFIG_TASK_RUNNER_AUTO_ITERATE=y
CONFIG_TASK_RUNNER_TASK_TDF_LOGGER=y

# Bluetooth
CONFIG_BT_CENTRAL=y
CONFIG_BT_DEVICE_NAME="WiFi Gateway"

# WiFi
CONFIG_NETWORKING=y
CONFIG_WIFI=y
CONFIG_WIFI_USAGE_MODE_STA=y

# WiFi throughput testing
CONFIG_NET_ZPERF=y
CONFIG_INFUSE_RPC_COMMAND_ZPERF_UPLOAD=y

# Throughput tends to be CPU limited
CONFIG_PICOLIBC_USE_MODULE=y
CONFIG_SPEED_OPTIMIZATIONS=y

# Group packets for TX efficiency
CONFIG_EPACKET_RECEIVE_GROUPING=y
CONFIG_EPACKET_RECEIVE_GROUPING_MAX_HOLD_MS=250

# Only connects when we request
CONFIG_CONN_MGR_WIFI_KV_STORE_AUTO_CONNECT=n
CONFIG_CONN_MGR_WIFI_KV_STORE_PERSISTENT=y

# As a high-throughput gateway we want more frequent ACKs
CONFIG_EPACKET_INTERFACE_UDP_ACK_PERIOD_SEC=300

# Gateway RPCs
CONFIG_INFUSE_RPC_CLIENT=y
```

## src/main.c
```c
/**
 * @file
 * @copyright 2024 Embeint Holdings Pty Ltd
 * @author Jordan Yates <jordan@embeint.com>
 *
 * SPDX-License-Identifier: FSL-1.1-ALv2
 */

#include <stdio.h>

#ifdef CONFIG_SOC_NRF5340_CPUAPP
#ifdef CONFIG_CLOCK_CONTROL_NRF
#include <nrfx_clock.h>
#else
#include <nrfx_clock_hfclk.h>
#endif /* CONFIG_CLOCK_CONTROL_NRF */
#endif /* CONFIG_SOC_NRF5340_CPUAPP */

#include <zephyr/kernel.h>
#include <zephyr/device.h>
#include <zephyr/drivers/gpio.h>
#include <zephyr/logging/log.h>
#include <zephyr/net/net_if.h>
#include <zephyr/net/net_mgmt.h>
#include <zephyr/net/wifi_mgmt.h>
#include <zephyr/net/conn_mgr_connectivity.h>
#include <zephyr/zbus/zbus.h>

#include <infuse/auto/bluetooth_conn_log.h>
#include <infuse/auto/wifi_conn_log.h>
#include <infuse/bluetooth/legacy_adv.h>
#include <infuse/epacket/interface.h>
#include <infuse/epacket/interface/epacket_udp.h>
#include <infuse/epacket/packet.h>
#include <infuse/data_logger/high_level/tdf.h>
#include <infuse/tdf/definitions.h>
#include <infuse/drivers/watchdog.h>
#include <infuse/zbus/channels.h>

#include <infuse/task_runner/runner.h>
#include <infuse/task_runner/tasks/infuse_tasks.h>

LOG_MODULE_REGISTER(app, LOG_LEVEL_INF);

static const struct task_schedule schedules[] = {
	{
		.task_id = TASK_ID_TDF_LOGGER,
		.validity = TASK_VALID_ALWAYS,
		.periodicity_type = TASK_PERIODICITY_LOCKOUT,
		.periodicity.lockout.lockout_s = 5,
		.task_args.tdf_logger =
			{
				.loggers = TDF_DATA_LOGGER_UDP,
				.tdfs = TASK_TDF_LOGGER_LOG_ANNOUNCE | TASK_TDF_LOGGER_LOG_NET_CONN,
			},
	},
	{
		.task_id = TASK_ID_TDF_LOGGER_ALT1,
		.validity = TASK_VALID_PERMANENTLY_RUNS,
		.task_args.tdf_logger =
			{
				.loggers = TDF_DATA_LOGGER_BT_ADV,
				.logging_period_ms = 4500,
				.random_delay_ms = 1000,
				.tdfs = TASK_TDF_LOGGER_LOG_ANNOUNCE | TASK_TDF_LOGGER_LOG_NET_CONN,
			},
	},
};

TASK_SCHEDULE_STATES_DEFINE(states, schedules);
TASK_RUNNER_TASKS_DEFINE(app_tasks, app_tasks_data, (TDF_LOGGER_TASK, NULL),
			 (TDF_LOGGER_ALT1_TASK, NULL));

INFUSE_ZBUS_CHAN_DEFINE(INFUSE_ZBUS_CHAN_BATTERY);

GATEWAY_HANDLER_DEFINE(udp_backhaul_handler, DEVICE_DT_GET(DT_NODELABEL(epacket_udp)));

#if DT_NODE_HAS_STATUS_OKAY(DT_ALIAS(led0))
static const struct gpio_dt_spec led0 = GPIO_DT_SPEC_GET(DT_ALIAS(led0), gpios);
#endif

static void udp_interface_state(uint16_t current_max_payload, void *user_ctx)
{
#if DT_NODE_HAS_STATUS_OKAY(DT_ALIAS(led0))
	/* Set LED according to WiFi connection state */
	(void)gpio_pin_set_dt(&led0, current_max_payload > 0);
#endif /* DT_NODE_HAS_STATUS_OKAY(DT_ALIAS(led0)) */
}

int main(void)
{
	const struct device *epacket_bt_adv = DEVICE_DT_GET(DT_NODELABEL(epacket_bt_adv));
	const struct device *epacket_bt_central = DEVICE_DT_GET(DT_NODELABEL(epacket_bt_central));
	const struct device *epacket_serial = DEVICE_DT_GET(DT_NODELABEL(epacket_serial));
	const struct device *epacket_udp = DEVICE_DT_GET(DT_NODELABEL(epacket_udp));
	struct epacket_interface_cb udp_interface_cb = {
		.interface_state = udp_interface_state,
	};

#ifdef CONFIG_SOC_NRF5340_CPUAPP
	/* For optimal performance, the CPU frequency needs to be set to 128 MHz */
#ifdef CONFIG_CLOCK_CONTROL_NRF
	int err;

	err = nrfx_clock_divider_set(NRF_CLOCK_DOMAIN_HFCLK, NRF_CLOCK_HFCLK_DIV_1);
	if (err != 0) {
		LOG_WRN("Failed to set 128 MHz: 0x%08x", err);
	}
#else
	nrfx_clock_hfclk_divider_set(NRF_CLOCK_HFCLK_DIV_1);
#endif /* CONFIG_CLOCK_CONTROL_NRF */
#endif /* CONFIG_SOC_NRF5340_CPUAPP */

#if DT_NODE_HAS_STATUS_OKAY(DT_ALIAS(led0))
	(void)gpio_pin_configure_dt(&led0, GPIO_OUTPUT_INACTIVE);
#endif /* DT_NODE_HAS_STATUS_OKAY(DT_ALIAS(led0)) */

	/* Constant ePacket flags */
	epacket_global_flags_set(EPACKET_FLAGS_CLOUD_FORWARDING | EPACKET_FLAGS_CLOUD_SELF);
	epacket_udp_flags_set(EPACKET_FLAGS_UDP_ALWAYS_RX);

	/* Log Bluetooth connection events */
	auto_bluetooth_conn_log_configure(TDF_DATA_LOGGER_SERIAL, AUTO_BT_CONN_LOG_EVENTS_FLUSH);

	/* Log WiFi connection events */
	auto_wifi_conn_log_configure(TDF_DATA_LOGGER_SERIAL,
				     AUTO_WIFI_LOG_ALL | AUTO_WIFI_LOG_EVENTS_FLUSH);

	/* Start legacy Bluetooth advertising */
	bluetooth_legacy_advertising_run();

	/* Setup UDP callbacks */
	epacket_register_callback(epacket_udp, &udp_interface_cb);

	/* Start watchdog */
	infuse_watchdog_start();

	/* Gateway receive handlers */
	epacket_set_receive_handler(epacket_serial, udp_backhaul_handler);
	epacket_set_receive_handler(epacket_bt_adv, udp_backhaul_handler);
	epacket_set_receive_handler(epacket_bt_central, udp_backhaul_handler);
	epacket_set_receive_handler(epacket_udp, udp_backhaul_handler);

	/* Always listening on Bluetooth advertising, serial and UDP */
	epacket_receive(epacket_serial, K_FOREVER);
	epacket_receive(epacket_bt_adv, K_FOREVER);
	epacket_receive(epacket_udp, K_FOREVER);

	/* Send key identifiers on boot */
	epacket_send_key_ids(epacket_serial, K_FOREVER);

	/* Turn on the interface */
	conn_mgr_all_if_up(true);
	conn_mgr_all_if_connect(true);

	/* Initialise task runner */
	task_runner_init(schedules, states, ARRAY_SIZE(schedules), app_tasks, app_tasks_data,
			 ARRAY_SIZE(app_tasks));

	/* Start auto iteration */
	task_runner_start_auto_iterate();

	/* Nothing further to do */
	k_sleep(K_FOREVER);
	return 0;
}
```
