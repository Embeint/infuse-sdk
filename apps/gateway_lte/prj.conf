## CMakeLists.txt
```
# SPDX-License-Identifier: Apache-2.0

cmake_minimum_required(VERSION 3.20.0)

# Infuse-IoT application
if(NOT infuse IN_LIST SNIPPET)
  set(SNIPPET infuse ${SNIPPET} CACHE STRING "" FORCE)
endif()

find_package(Zephyr REQUIRED HINTS $ENV{ZEPHYR_BASE})
project(gateway_lte)

target_sources(app PRIVATE
  src/main.c
)
```

## Kconfig
```
# LTE Gateway specific options
#   PSM: Disabled
#  eDRX: 20.48 sec cycle

config LTE_GATEWAY_DEFAULT_MAXIMUM_UPLINK_THROUGHPUT_KBPS
	int "Expected maximum throughput of the LTE link with good signal"
	# Theoretical maximum LTE-M uplink for the nRF91 is 375 kbps
	default 175 if SOC_SERIES_NRF91
	default 0

config LTE_GATEWAY_DEFERRED_START_BATTERY_MV
	int "Battery voltage required before enabling LTE and Bluetooth scanning (mV)"
	depends on TASK_RUNNER_TASK_BATTERY
	default 0
	help
	  When non-zero, the LTE interface is not brought up and Bluetooth
	  advertising reception (scanning) is not started until the battery
	  task reports a voltage greater than or equal to this value.
	  Once the threshold has been reached the interfaces remain enabled,
	  regardless of later battery measurements.
	  A value of 0 enables the interfaces immediately on boot.

# Default RPCs (if hardware supports)
configdefault INFUSE_RPC_COMMAND_BT_FILE_COPY_BASIC
	default y
configdefault INFUSE_RPC_COMMAND_BT_FILE_COPY_COAP
	default y

#
# Defaults for native nRF91 gateways
#
choice LTE_NETWORK_MODE
	default LTE_NETWORK_MODE_LTE_M
endchoice
choice INFUSE_NRF_MODEM_MONITOR_MOBILITY
	default INFUSE_NRF_MODEM_MONITOR_MOBILITY_NORDIC_PROPRIETARY
endchoice
configdefault LTE_PSM_REQ
	default n
configdefault LTE_EDRX_REQ
	default y
config LTE_EDRX_REQ_VALUE_LTE_M
	default "0010"
configdefault INFUSE_NRF_MODEM_DATA_PROFILE_DEFAULT
	default 4

#
# Defaults for Modem Cellular gateways
#
configdefault MODEM_CELLULAR_REQUEST_EDRX
	default y
configdefault MODEM_CELLULAR_REQUEST_EDRX_VALUE_LTE
	default "0010"

# Constant latency to improve UART stability & responsiveness.
# According to the datasheet this increases idle power consumption by 530 uA (nRF54L).
# This is negligible compared to the consumption of the LTE modem in gateway mode.
configdefault SOC_NRF_FORCE_CONSTLAT
	default y
configdefault NRFX_POWER
	default y
configdefault NRF_SYS_EVENT
	default y

#
# Defaults for offloaded modem_cellular gateways
#
configdefault BT_CTLR_SDC_PERIPHERAL_COUNT
	default 2
configdefault MODEM_CMUX_MTU
	default 1500
configdefault MODEM_CELLULAR_UART_BUFFER_SIZES
	default 1500
configdefault MODEM_CELLULAR_CHAT_BUFFER_SIZE
	default 256
configdefault MODEM_CELLULAR_USER_PIPE_BUFFER_SIZES
	default 256
# Huge impact on RAM consumption of the application
# Limit it to 768, i.e. 2 buffers can contain our maximum packet size
configdefault NET_BUF_DATA_SIZE
	default 768 if !NRF_MODEM_LIB
configdefault MODEM_PPP_NET_BUF_FRAG_SIZE
	default 512

source "Kconfig.zephyr"
```

## sample.yaml
```
sample:
  description: Bluetooth <-> LTE bridge
  name: gateway LTE
common:
  tags:
    - app
    - auto
    - bluetooth
    - charger
    - data_logger
    - epacket
    - gnss
    - imu
    - kv_store
    - led
    - logging
    - math
    - mcumgr
    - memfault
    - modem
    - modem_monitor
    - net
    - reboot
    - rpc
    - sensor
    - shared_device
    - states
    - task_runner
    - tdf
    - watchdog
    - zbus
  build_only: true
  required_snippets:
    - infuse
  depends_on:
    - netif
    - modem
    - ble
  integration_platforms:
    - auroch/nrf9151/ns
    - bonasus@0/nrf54l15/cpuapp
    - kudu/nrf54l15/cpuapp
    - nrf93m1dk/nrf54l15/cpuapp
tests:
  sample.app.gateway_lte: {}
  sample.app.gateway_lte.deferred_start:
    extra_configs:
      - CONFIG_LTE_GATEWAY_DEFERRED_START_BATTERY_MV=3600
  sample.app.gateway_lte.sysbuild:
    sysbuild: true
    filter: not CONFIG_BUILD_WITH_TFM
```

## prj.conf
```kconfig
# LTE Gateway options
CONFIG_INFUSE_SDK=y
CONFIG_INFUSE_APPLICATION_ID=0xEBE10010
CONFIG_INFUSE_WATCHDOG=y
CONFIG_EPACKET_PROCESS_THREAD_SPLIT=y
CONFIG_EPACKET_PACKET_SIZE_MAX=1360
CONFIG_EPACKET_FILTERING=y
CONFIG_EPACKET_FORWARDING=y
CONFIG_EPACKET_BUFFERS_TX=10
CONFIG_EPACKET_BUFFERS_RX=6
CONFIG_EPACKET_INTERFACE_BT_CENTRAL_BUFFERS_RX=4
CONFIG_EPACKET_RATE_LIMIT_BUFFER_THRESHOLD=4
CONFIG_EPACKET_RATE_LIMIT_REQ_DURATION_MS=250

# UDP downlink watchdog of 4 hours
CONFIG_EPACKET_INTERFACE_UDP_DOWNLINK_WATCHDOG_TIMEOUT=14400

# Bluetooth
CONFIG_BT_DEVICE_NAME="LTE GW"
CONFIG_BT_CENTRAL=y
CONFIG_BT_MAX_CONN=4

# LTE
CONFIG_NETWORKING=y
CONFIG_INFUSE_MODEM_MONITOR_CONN_STATE_LOG=y

# Group packets for TX efficiency
CONFIG_EPACKET_RECEIVE_GROUPING=y
CONFIG_EPACKET_RECEIVE_GROUPING_MAX_HOLD_MS=1000

# Task Runner
CONFIG_TASK_RUNNER=y
CONFIG_TASK_RUNNER_AUTO_ITERATE=y
CONFIG_TASK_RUNNER_DEFAULT_SCHEDULES_ID=6
CONFIG_TASK_RUNNER_TASK_TDF_LOGGER=y
CONFIG_TASK_RUNNER_TASK_BATTERY=y
CONFIG_TASK_RUNNER_TASK_GNSS=y
CONFIG_TASK_RUNNER_TASK_ENVIRONMENTAL=y

# Memfault
CONFIG_MEMFAULT=y
CONFIG_MEMFAULT_METRICS=y
CONFIG_MEMFAULT_METRICS_HEARTBEAT_INTERVAL_SECS=7200
CONFIG_MEMFAULT_COREDUMP_COLLECT_DATA_REGIONS=n
CONFIG_MEMFAULT_RAM_BACKED_COREDUMP_SIZE=16384

# Gateway RPCs
CONFIG_INFUSE_RPC_CLIENT=y

# Gateway KV
CONFIG_KV_STORE_KEY_BLUETOOTH_THROUGHPUT_LIMIT=y
CONFIG_KV_STORE_KEY_GATEWAY_BLUETOOTH_FORWARD_OPTIONS=y
```

## app.overlay
```dts
/ {
	chosen {
		infuse,memfault-epacket-dump = &epacket_udp;
	};
};
```

## src/main.c
```c
/**
 * @file
 * @copyright 2025 Embeint Holdings Pty Ltd
 * @author Jordan Yates <jordan@embeint.com>
 *
 * SPDX-License-Identifier: FSL-1.1-ALv2
 */

#include <stdio.h>

#include <zephyr/kernel.h>
#include <zephyr/device.h>
#include <zephyr/drivers/gpio.h>
#include <zephyr/logging/log.h>
#include <zephyr/net/net_if.h>
#include <zephyr/net/net_mgmt.h>
#include <zephyr/net/conn_mgr_connectivity.h>
#include <zephyr/pm/device_runtime.h>
#include <zephyr/zbus/zbus.h>

#include <infuse/auto/bluetooth_conn_log.h>
#include <infuse/auto/time_sync_log.h>
#include <infuse/bluetooth/legacy_adv.h>
#include <infuse/data_logger/high_level/tdf.h>
#include <infuse/drivers/watchdog.h>
#include <infuse/epacket/interface.h>
#include <infuse/epacket/interface/epacket_udp.h>
#include <infuse/epacket/filter.h>
#include <infuse/epacket/packet.h>
#include <infuse/fs/kv_store.h>
#include <infuse/fs/kv_types.h>
#include <infuse/lib/lte_modem_monitor.h>
#include <infuse/lib/memfault.h>
#include <infuse/reboot/tdf.h>
#include <infuse/states.h>
#include <infuse/tdf/definitions.h>
#include <infuse/zbus/channels.h>

#include <infuse/task_runner/runner.h>
#include <infuse/task_runner/tasks/infuse_tasks.h>

LOG_MODULE_REGISTER(app, LOG_LEVEL_INF);

static void custom_tdf_logger(uint8_t tdf_loggers, uint64_t timestamp);

enum {
	APP_STATES_GNSS_TRIGGER = INFUSE_STATES_APP_START,
};

static const struct task_schedule schedules[] = {
	{
		.task_id = TASK_ID_TDF_LOGGER,
		.validity = TASK_VALID_ALWAYS,
		.periodicity_type = TASK_PERIODICITY_LOCKOUT,
		.periodicity.lockout.lockout_s = 5 * SEC_PER_MIN,
		.task_args.tdf_logger =
			{
				.loggers = TDF_DATA_LOGGER_UDP,
				.tdfs = TASK_TDF_LOGGER_LOG_ANNOUNCE | TASK_TDF_LOGGER_LOG_BATTERY |
					TASK_TDF_LOGGER_LOG_AMBIENT_ENV |
					TASK_TDF_LOGGER_LOG_LOCATION |
					TASK_TDF_LOGGER_LOG_NET_CONN | TASK_TDF_LOGGER_LOG_CUSTOM,
			},
	},
	{
		.task_id = TASK_ID_TDF_LOGGER_ALT1,
		.validity = TASK_VALID_PERMANENTLY_RUNS,
		.task_args.tdf_logger =
			{
				.loggers = TDF_DATA_LOGGER_BT_ADV,
				.logging_period_ms = 1000,
				.random_delay_ms = 1000,
				.tdfs = TASK_TDF_LOGGER_LOG_ANNOUNCE | TASK_TDF_LOGGER_LOG_BATTERY |
					TASK_TDF_LOGGER_LOG_NET_CONN |
					TASK_TDF_LOGGER_LOG_LOCATION |
					TASK_TDF_LOGGER_LOG_AMBIENT_ENV,
			},
	},
	{
		.task_id = TASK_ID_BATTERY,
		.validity = TASK_VALID_ALWAYS,
		.periodicity_type = TASK_PERIODICITY_LOCKOUT,
		.periodicity.lockout.lockout_s = TASK_RUNNER_LOCKOUT_IGNORE_FIRST | 30,
	},
#if DT_NODE_HAS_STATUS_OKAY(DT_ALIAS(environmental0))
	{
		.task_id = TASK_ID_ENVIRONMENTAL,
		.validity = TASK_VALID_ALWAYS,
		.periodicity_type = TASK_PERIODICITY_FIXED,
		.periodicity.fixed.period_s = 30,
	},
#endif /* DT_NODE_HAS_STATUS_OKAY(DT_ALIAS(environmental0)) */
#if DT_NODE_HAS_STATUS_OKAY(DT_ALIAS(gnss))
	{
		.task_id = TASK_ID_GNSS,
		.validity = TASK_VALID_ALWAYS,
		.boot_lockout_minutes = 5,
		.periodicity_type = TASK_PERIODICITY_LOCKOUT,
		.periodicity.lockout.lockout_s =
			TASK_RUNNER_LOCKOUT_IGNORE_FIRST | (30 * SEC_PER_MIN),
		.timeout_s = 2 * SEC_PER_MIN,
		.task_logging =
			{
				{
					.loggers = TDF_DATA_LOGGER_FLASH,
					.tdf_mask = TASK_GNSS_LOG_LLHA | TASK_GNSS_LOG_FIX_INFO,
				},
			},
		.task_args.gnss =
			{
				.flags = TASK_GNSS_FLAGS_RUN_TO_LOCATION_FIX |
					 TASK_GNSS_FLAGS_PERFORMANCE_MODE,
				/* FIX_OK: 1m accuracy, 10.0 PDOP */
				.accuracy_m = 1,
				.position_dop = 100,
				.mode.run_to_fix =
					{
						/* 1 minute to get some location knowledge */
						.any_fix_timeout = SEC_PER_MIN,
						/* Accuracy must improve by at least 1m every 10
						 * seconds after hitting 50m.
						 */
						.fix_plateau =
							{
								.min_accuracy_m = 50,
								.min_accuracy_improvement_m = 1,
								.timeout = 10,
							},
					},
				/* Gateways not expected to move */
				.dynamic_model = UBX_CFG_NAVSPG_DYNMODEL_STATIONARY,
			},
	},
	{
		.task_id = TASK_ID_GNSS,
		.validity = TASK_VALID_ALWAYS,
		.timeout_s = 2 * SEC_PER_MIN,
		.states_start = TASK_STATES_DEFINE(APP_STATES_GNSS_TRIGGER),
		.task_args.gnss =
			{
				.flags = TASK_GNSS_FLAGS_RUN_TO_LOCATION_FIX |
					 TASK_GNSS_FLAGS_PERFORMANCE_MODE,
				/* FIX_OK: 1m accuracy, 10.0 PDOP */
				.accuracy_m = 1,
				.position_dop = 100,
				/* Gateways not expected to move */
				.dynamic_model = UBX_CFG_NAVSPG_DYNMODEL_STATIONARY,
			},

	},
#endif /* DT_NODE_HAS_STATUS_OKAY(DT_ALIAS(gnss)) */
};

#if DT_NODE_HAS_STATUS_OKAY(DT_ALIAS(environmental0))
#define ENV_TASK_DEFINE                                                                            \
	(ENVIRONMENTAL_TASK, DEVICE_DT_GET(DT_ALIAS(environmental0)),                              \
	 DEVICE_DT_GET_OR_NULL(DT_ALIAS(environmental1)))
#else
#define ENV_TASK_DEFINE
#endif
#if DT_NODE_HAS_STATUS_OKAY(DT_ALIAS(gnss))
#define GNSS_TASK_DEFINE (GNSS_TASK, DEVICE_DT_GET(DT_ALIAS(gnss)))
#else
#define GNSS_TASK_DEFINE
#endif

TASK_SCHEDULE_STATES_DEFINE(states, schedules);
TASK_RUNNER_TASKS_DEFINE(app_tasks, app_tasks_data, (TDF_LOGGER_TASK, custom_tdf_logger),
			 (TDF_LOGGER_ALT1_TASK, NULL),
			 (BATTERY_TASK, DEVICE_DT_GET(DT_ALIAS(fuel_gauge0))), ENV_TASK_DEFINE,
			 GNSS_TASK_DEFINE);

GATEWAY_HANDLER_DEFINE(udp_backhaul_handler, DEVICE_DT_GET(DT_NODELABEL(epacket_udp)));

static const struct gpio_dt_spec led0 = GPIO_DT_SPEC_GET_OR(DT_ALIAS(led0), gpios, {0});
static const struct gpio_dt_spec led1 = GPIO_DT_SPEC_GET_OR(DT_ALIAS(led1), gpios, {0});
static const struct gpio_dt_spec led2 = GPIO_DT_SPEC_GET_OR(DT_ALIAS(led2), gpios, {0});

/* Forward 25% of all Bluetooth packets by default, RSSI if whole packet dropped */
static const struct kv_gateway_bluetooth_forward_options bt_forwarding_options_default = {
	.flags = FILTER_FORWARD_RSSI_FALLBACK,
	.percent = 256 / 4,
};
static struct kv_gateway_bluetooth_forward_options bt_forwarding_options;
/* UDP backhaul is currently connected */
static atomic_t udp_backhaul_active;
/* Serialise updates to the Bluetooth scanning state */
static K_MUTEX_DEFINE(bt_scan_lock);

#if CONFIG_LTE_GATEWAY_DEFERRED_START_BATTERY_MV > 0
static void new_battery_data(const struct zbus_channel *chan);

INFUSE_ZBUS_CHAN_DECLARE(INFUSE_ZBUS_CHAN_BATTERY);
ZBUS_LISTENER_DEFINE(battery_listener, new_battery_data);
ZBUS_CHAN_ADD_OBS(INFUSE_ZBUS_NAME(INFUSE_ZBUS_CHAN_BATTERY), battery_listener, 5);

static K_SEM_DEFINE(battery_threshold_reached, 0, 1);

static void new_battery_data(const struct zbus_channel *chan)
{
	const struct tdf_battery_state *battery = zbus_chan_const_msg(chan);

	if (battery->voltage_mv >= CONFIG_LTE_GATEWAY_DEFERRED_START_BATTERY_MV) {
		/* Threshold reached, no further notifications required */
		(void)zbus_obs_set_enable(&battery_listener, false);
		k_sem_give(&battery_threshold_reached);
	}
}
#endif /* CONFIG_LTE_GATEWAY_DEFERRED_START_BATTERY_MV > 0 */

static void custom_tdf_logger(uint8_t tdf_loggers, uint64_t timestamp)
{
	ARG_UNUSED(timestamp);

	if (tdf_loggers & TDF_DATA_LOGGER_UDP) {
		/* Dump any pending Memfault chunks each time we send a UDP TDF */
		(void)infuse_memfault_queue_dump_all(K_MSEC(50));
	}
}

static void bt_scan_update(void)
{
	const struct device *bt_adv = DEVICE_DT_GET(DT_NODELABEL(epacket_bt_adv));
	static bool scanning;
	bool desired;
	int rc;

	k_mutex_lock(&bt_scan_lock, K_FOREVER);
	/* Only scan while packets can be forwarded and the uplink is not being prioritised */
	desired = atomic_get(&udp_backhaul_active) &&
		  !infuse_state_get(INFUSE_STATE_HIGH_PRIORITY_UPLINK);
	if (desired != scanning) {
		rc = epacket_receive(bt_adv, desired ? K_FOREVER : K_NO_WAIT);
		LOG_INF("Bluetooth scanning %s (%d)", desired ? "started" : "stopped", rc);
		if (rc == 0) {
			scanning = desired;
		}
	}
	k_mutex_unlock(&bt_scan_lock);
}

static void udp_interface_state(uint16_t current_max_payload, void *user_ctx)
{
	static bool first_conn = true;

	/* Bluetooth scanning only runs while the backhaul is active */
	atomic_set(&udp_backhaul_active, current_max_payload > 0);
	bt_scan_update();

	if (current_max_payload > 0 && first_conn) {
		LOG_INF("Reboot announce");
		/* When we first connect to the network, push an announce packet */
		task_tdf_logger_manual_run(
			TDF_DATA_LOGGER_UDP, 0,
			TASK_TDF_LOGGER_LOG_ANNOUNCE | TASK_TDF_LOGGER_LOG_BATTERY |
				TASK_TDF_LOGGER_LOG_LOCATION | TASK_TDF_LOGGER_LOG_NET_CONN,
			NULL);
		tdf_data_logger_flush(TDF_DATA_LOGGER_UDP);
		first_conn = false;
	}
}

static void state_set(enum infuse_state state, bool already, uint16_t timeout, void *user_ctx)
{
	if ((state != INFUSE_STATE_HIGH_PRIORITY_UPLINK) || already) {
		return;
	}

	/* Pause scanning to prioritise the uplink */
	bt_scan_update();
}

static void state_cleared(enum infuse_state state, void *user_ctx)
{
	if (state != INFUSE_STATE_HIGH_PRIORITY_UPLINK) {
		return;
	}

	/* Resume scanning if the backhaul is active */
	bt_scan_update();
}

static void kv_value_changed(uint16_t key, const void *data, size_t data_len, void *user_ctx)
{
	const struct kv_gateway_bluetooth_forward_options *options = data;

	if (key != KV_KEY_GATEWAY_BLUETOOTH_FORWARD_OPTIONS) {
		return;
	}

	if ((data == NULL) || (data_len != sizeof(bt_forwarding_options))) {
		/* Revert to the defaults */
		bt_forwarding_options = bt_forwarding_options_default;
	} else {
		/* Use configured values */
		bt_forwarding_options.flags = options->flags;
		bt_forwarding_options.percent = options->percent;
	}
}

static void bluetooth_adv_handler(struct net_buf *buf)
{
	const struct device *udp = DEVICE_DT_GET(DT_NODELABEL(epacket_udp));

	/* Forward 25% of Bluetooth advertising packets (0.25 * 255) */
	if (epacket_gateway_forward_filter(bt_forwarding_options.flags,
					   bt_forwarding_options.percent, buf)) {
		/* Forward packets that pass the filter */
		epacket_gateway_receive_handler(udp, buf);
	} else {
		if (bt_forwarding_options.flags & FILTER_FORWARD_RSSI_FALLBACK) {
			struct epacket_rx_metadata *meta = net_buf_user_data(buf);
			struct tdf_infuse_bluetooth_rssi tdf_rssi = {
				.infuse_id = meta->packet_device_id,
				.rssi = meta->rssi,
			};

			/* Log the RSSI */
			TDF_DATA_LOGGER_LOG(TDF_DATA_LOGGER_UDP, TDF_INFUSE_BLUETOOTH_RSSI,
					    epoch_time_now(), &tdf_rssi);
		}

		/* Drop packets that don't */
		net_buf_unref(buf);
	}
}

static void leds_init(void)
{
	if (led0.port) {
		(void)gpio_pin_configure_dt(&led0, GPIO_OUTPUT_INACTIVE);
	}
	if (led1.port) {
		(void)gpio_pin_configure_dt(&led1, GPIO_OUTPUT_INACTIVE);
	}
	if (led2.port) {
		(void)gpio_pin_configure_dt(&led2, GPIO_OUTPUT_INACTIVE);
	}
}

static void led_set_dt(const struct gpio_dt_spec *spec, int value)
{
	if (spec->port == NULL) {
		return;
	}
	gpio_pin_set_dt(spec, value);
}

static void led_pulse_dt(const struct gpio_dt_spec *spec, k_timeout_t pulse_duration)
{
	if (spec->port == NULL) {
		return;
	}
	gpio_pin_set_dt(spec, 1);
	k_sleep(pulse_duration);
	gpio_pin_set_dt(spec, 0);
}

static void radios_enable(void)
{
	const struct device *udp = DEVICE_DT_GET(DT_NODELABEL(epacket_udp));

	/* Listen on UDP, Bluetooth advertising is enabled once the backhaul is active */
	epacket_receive(udp, K_FOREVER);

#ifdef CONFIG_MODEM_CELLULAR
#if defined(CONFIG_NRF_MODEM_LIB)
	struct net_if *iface = net_if_get_first_by_type(&(NET_L2_GET_NAME(OFFLOADED_NETDEV)));
#elif defined(CONFIG_NET_L2_PPP)
	struct net_if *iface = net_if_get_first_by_type(&(NET_L2_GET_NAME(PPP)));
#else
#error Unknown LTE modem network interface
#endif
	/* For now the Cellular Modem abstraction is not linked to a connection manager */
	net_if_up(iface);
#else
	/* Turn on the interface */
	conn_mgr_all_if_up(true);
	conn_mgr_all_if_connect(true);
#endif /* CONFIG_MODEM_CELLULAR */
}

int main(void)
{
	const struct device *bt_adv = DEVICE_DT_GET(DT_NODELABEL(epacket_bt_adv));
	const struct device *bt_central = DEVICE_DT_GET(DT_NODELABEL(epacket_bt_central));
	const struct device *udp = DEVICE_DT_GET(DT_NODELABEL(epacket_udp));
	struct epacket_interface_cb udp_interface_cb = {
		.interface_state = udp_interface_state,
	};
	struct infuse_state_cb state_cb = {
		.state_set = state_set,
		.state_cleared = state_cleared,
	};
	struct kv_store_cb kv_cb = {
		.value_changed = kv_value_changed,
	};
	struct lte_modem_monitor_config modem_monitor_config = {
		.conn_status_logger_mask = TDF_DATA_LOGGER_FLASH,
	};
	struct lte_modem_network_state lte_state;
	uint16_t udp_payload_size;
	bool lte_modem_active;
	int rc;

#if CONFIG_LTE_GATEWAY_DEFAULT_MAXIMUM_UPLINK_THROUGHPUT_KBPS > 0
	/* Set the default throughput to request from connected devices if it doesn't exist */
	if (!kv_store_key_exists(KV_KEY_BLUETOOTH_THROUGHPUT_LIMIT)) {
		struct kv_bluetooth_throughput_limit limit = {
			CONFIG_LTE_GATEWAY_DEFAULT_MAXIMUM_UPLINK_THROUGHPUT_KBPS,
		};

		KV_STORE_WRITE(KV_KEY_BLUETOOTH_THROUGHPUT_LIMIT, &limit);
	}
#endif /* CONFIG_LTE_GATEWAY_DEFAULT_MAXIMUM_UPLINK_THROUGHPUT_KBPS > 0 */

	/* Setup Bluetooth forwarding configuration */
	rc = kv_store_read_fallback(KV_KEY_GATEWAY_BLUETOOTH_FORWARD_OPTIONS,
				    &bt_forwarding_options, sizeof(bt_forwarding_options),
				    &bt_forwarding_options_default,
				    sizeof(bt_forwarding_options_default));
	if (rc < 0) {
		LOG_WRN("Setting Bluetooth forwarding options failed (%d)", rc);
		memcpy(&bt_forwarding_options, &bt_forwarding_options_default,
		       sizeof(bt_forwarding_options));
	}

	/* Set up LEDs */
	leds_init();

	/* KV store callbacks */
	kv_store_register_callback(&kv_cb);

	/* State callbacks */
	infuse_state_register_callback(&state_cb);

	/* Constant ePacket flags */
	epacket_global_flags_set(EPACKET_FLAGS_CLOUD_FORWARDING | EPACKET_FLAGS_CLOUD_SELF);
	epacket_udp_flags_set(EPACKET_FLAGS_UDP_ALWAYS_RX);

	/* Start watchdog */
	infuse_watchdog_start();

	/* Log reboot events */
	tdf_reboot_info_log(TDF_DATA_LOGGER_FLASH | TDF_DATA_LOGGER_BT_ADV | TDF_DATA_LOGGER_UDP);

	/* Log LTE connection events */
	lte_modem_monitor_configure(&modem_monitor_config);

	/* Configure time event logging */
	auto_time_sync_log_configure(TDF_DATA_LOGGER_FLASH,
				     AUTO_TIME_SYNC_LOG_SYNCS | AUTO_TIME_SYNC_LOG_REBOOT_ON_SYNC);
	auto_bluetooth_conn_log_configure(TDF_DATA_LOGGER_FLASH, 0);

	/* Start legacy Bluetooth advertising to workaround iOS and
	 * Nordic Softdevice connection issues.
	 */
	bluetooth_legacy_advertising_run();

	/* Setup reboot reporting */
	epacket_register_callback(udp, &udp_interface_cb);

	/* Gateway receive handlers */
	epacket_set_receive_handler(bt_adv, bluetooth_adv_handler);
	epacket_set_receive_handler(bt_central, udp_backhaul_handler);
	epacket_set_receive_handler(udp, udp_backhaul_handler);

	/* Initialise task runner */
	task_runner_init(schedules, states, ARRAY_SIZE(schedules), app_tasks, app_tasks_data,
			 ARRAY_SIZE(app_tasks));

	/* Start auto iteration */
	task_runner_start_auto_iterate();

#if CONFIG_LTE_GATEWAY_DEFERRED_START_BATTERY_MV > 0
	/* Wait for the battery task to report sufficient voltage */
	LOG_INF("Waiting for battery >= %d mV", CONFIG_LTE_GATEWAY_DEFERRED_START_BATTERY_MV);
	while (k_sem_take(&battery_threshold_reached, K_SECONDS(5)) != 0) {
		/* Indicate that we are waiting */
		led_pulse_dt(&led0, K_MSEC(50));
	}
	LOG_INF("Battery threshold reached, enabling LTE and Bluetooth scanning");
#endif /* CONFIG_LTE_GATEWAY_DEFERRED_START_BATTERY_MV > 0 */

	/* Enable LTE, Bluetooth scanning starts once the backhaul connects */
	radios_enable();

	/* Boot LED sequence */
	for (int i = 0; i < 5; i++) {
		led_set_dt(&led0, 1);
		led_set_dt(&led1, 1);
		led_set_dt(&led2, 1);
		k_sleep(K_MSEC(200));
		led_set_dt(&led0, 0);
		led_set_dt(&led1, 0);
		led_set_dt(&led2, 0);
		k_sleep(K_MSEC(200));
	}

	/* Periodic LEDs based on connection state */
	while (true) {
		k_sleep(K_SECONDS(5));

		lte_modem_monitor_network_state(&lte_state);
		switch (lte_state.nw_reg_status) {
		case CELLULAR_REGISTRATION_SEARCHING:
		case CELLULAR_REGISTRATION_REGISTERED_HOME:
		case CELLULAR_REGISTRATION_REGISTERED_ROAMING:
		case CELLULAR_REGISTRATION_DENIED:
			lte_modem_active = true;
			break;
		default:
			lte_modem_active = false;
		}

		udp_payload_size = epacket_interface_max_packet_size(udp);
		if (!lte_modem_active) {
			led_pulse_dt(&led0, K_SECONDS(1));
		} else if (udp_payload_size > 0) {
			led_pulse_dt(&led1, K_MSEC(200));
		} else {
			led_pulse_dt(&led2, K_MSEC(200));
		}
	}
}
```
