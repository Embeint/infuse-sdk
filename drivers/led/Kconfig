## drivers/led/Kconfig
```kconfig
# Copyright (c) 2025 Embeint Holdings Pty Ltd
# SPDX-License-Identifier: Apache-2.0

config LP581X
	bool "LP581X LED driver"
	default y
	depends on DT_HAS_TI_LP5814_ENABLED ||DT_HAS_TI_LP5815_ENABLED || \
		DT_HAS_TI_LP5816_ENABLED || DT_HAS_TI_LP5817_ENABLED
	select I2C
	help
	  Enable LED driver for LP581X.

	  LP581X LED drivers have 3 (LP5815/LP5817) or 4 (LP5814/LP5816)
	  channels. Each channel can drive up to 25.5 mA per LED.
```

## drivers/sensor/Kconfig
```kconfig
# Infuse-IoT sensor drivers

config NRF9X_TEMP
	bool "nRF91x internal SoC temperature"
	depends on DT_HAS_NORDIC_NRF9X_TEMP_ENABLED
	depends on NRF_MODEM_LIB
	depends on SENSOR
	default y

config NRF9X_BATT
	bool "nRF91x battery voltage measurement"
	depends on DT_HAS_NORDIC_NRF9X_BATT_ENABLED
	depends on NRF_MODEM_LIB
	depends on SENSOR
	default y

config BQ25798
	bool "TI BQ25798 Buck-Boost Battery Charger"
	depends on DT_HAS_TI_BQ25798_ENABLED
	depends on SENSOR
	default y

if BQ25798

config BQ25798_FETCH_STATUS_CHECKS
	bool "Query status flags on fetch"
	default y

config BQ25798_FETCH_POOR_SOURCE_RETRY
	bool "Automatically retry poor sources on fetch"
	default y
	help
	   By default a poor source is only retried every 7 minutes.
	   Enabling this flag results in `sensor_fetch` retrying the
	   source qualification if the charger is in poor source mode.

endif

config PAC194X
	bool "Microchip PAC194X single/multi-channel power monitor"
	depends on DT_HAS_MICROCHIP_PAC1941_1_ENABLED
	depends on SENSOR
	default y

config SENSOR_GENERIC_SIM
	bool "Generic simulated sensor"
	depends on DT_HAS_ZEPHYR_GENERIC_SIM_SENSOR_ENABLED
	depends on SENSOR
	default y
	help
	  Simulated sensor that can expose any configured channel.
```

## drivers/shared_device/Kconfig
```kconfig
# Infuse-IoT switch driver configuration

config SHARED_DEVICE
	bool "Zephyr shared device API"

if SHARED_DEVICE

config ZEPHYR_SPDT_SWITCH
	bool "Generic single-pole double-throw GPIO controlled switch"
	depends on DT_HAS_ZEPHYR_SPDT_SWITCH_ENABLED
	depends on GPIO
	default y

module = SHARED_DEVICE
module-str = shared device
source "subsys/logging/Kconfig.template.log_config"

config SHARED_DEVICE_INIT_PRIORITY
	int "Shared device init priority"
	default 76
	help
	  Shared device initialization priority.

endif # SHARED_DEVICE
```

## drivers/watchdog/Kconfig
```kconfig
# Infuse-IoT watchdog configuration

config INFUSE_WATCHDOG
	bool "Use watchdogs in core Infuse subsystems"
	depends on "$(dt_alias_enabled,watchdog0)"
	depends on WATCHDOG
	help
	  When enabled, Infuse subsystems register watchdogs against
	  the watchdog0 devicetree alias. The watchdog must still be
	  started with `infuse_watchdog_start` by the application.

if INFUSE_WATCHDOG

config INFUSE_WATCHDOG_SW_MULTICHANNEL
	bool "Emulate multiple watchdog channels in software"
	depends on INFUSE_WATCHDOG_SOFTWARE_WARNING
	default y if IWDG_STM32
	help
	  Multiple channels are emulated by feeding the hardware watchdog
	  once all software channels have been fed at least once.

config INFUSE_WATCHDOG_PERIOD_MS
	int "Watchdog period used by Infuse subsystems"
	range 2000 26214 if IWDG_STM32
	range 2000 120000
	default 20000 if IWDG_STM32
	default 35000

config INFUSE_WATCHDOG_FEED_EARLY_MS
	int "Time before expiry to feed the watchdog when idle"
	default 5000
	help
	  Threads that are idle most of the time need to periodically wake up to
	  feed their assigned watchdog channel. This option controls how soon before
	  expiry they do that. If this value is too small, the channel may expire
	  if the CPU is busy while the thread is waiting to wake.

config INFUSE_WATCHDOG_SOFTWARE_WARNING
	bool "Enable a software alarm that provides a pre-warning before hardware expiry"
	default y if SOC_FAMILY_NORDIC_NRF && INFUSE_MEMFAULT
	default y if HAS_WDT_NO_CALLBACKS

config INFUSE_WATCHDOG_SOFTWARE_WARNING_MS
	int "Milliseconds before hardware expiry to trigger software warning"
	depends on INFUSE_WATCHDOG_SOFTWARE_WARNING
	default 2500

endif # INFUSE_WATCHDOG
```

## drivers/wifi/Kconfig
```kconfig
# Infuse-IoT watchdog configuration

config WIFI_SIM
	bool "Simulated WiFi device"
	select WIFI_OFFLOAD

if WIFI_SIM

config WIFI_SIM_AP_SSID
	string "Network name that results in a connection to the network"
	default "nsos_sim_network"

config WIFI_SIM_AP_PSK
	string "Network pre-shared-key that results in a connection to the network"
	default "nsos_sim_password"

config WIFI_SIM_IF_AUTO_START
	bool "Automatically start the interface"

endif # WIFI_SIM
```

## dts/bindings/audio/invensense,t5838.yaml
```yaml
# Copyright (c) 2025 Embeint Pty Ttd
# SPDX-License-Identifier: Apache-2.0

description: T5838 microphone driver

compatible: "invensense,t5838"

include: [base.yaml, pinctrl-device.yaml, pdm-dmic.yaml]

properties:
  reg:
    required: true

  en-gpios:
    type: phandle-array
    description: Enable GPIO

  thsel-gpios:
    type: phandle-array
    required: true
    description: thsel pin

  wake-gpios:
    type: phandle-array
    required: true
    description: wake pin

  pdmclk-gpios:
    type: phandle-array
    required: true
    description: pdmclk pin
```

## dts/bindings/data_logger/data-logger-base.yaml
```yaml
# Copyright (c) 2024 Jordan Yates <jordan@embeint.com>
# SPDX-License-Identifier: FSL-1.1-ALv2

include: base.yaml

properties:
  extra-ram-buffer:
    type: int
    default: 0
    description:
      When a block fills, buffer it in RAM until additional blocks
      fill. This allows multiple blocks to be written one after the
      other, amortising the power-up and power-down costs associated
      with an interface.
```

## dts/bindings/data_logger/embeint,data-logger-disk-access.yaml
```yaml
# Copyright (c) 2026 Jordan Yates <jordan@embeint.com>
# SPDX-License-Identifier: FSL-1.1-ALv2

description: Data logging backend using the disk access API

compatible: "embeint,data-logger-disk-access"

include: data-logger-base.yaml

properties:
  disk:
    type: phandle
    required: true
    description: |
      Disk to use for data logger.
```

## dts/bindings/data_logger/embeint,data-logger-epacket.yaml
```yaml
# Copyright (c) 2024 Jordan Yates <jordan@embeint.com>
# SPDX-License-Identifier: FSL-1.1-ALv2

description: Data logging backend using the ePacket API

compatible: "embeint,data-logger-epacket"

include: data-logger-base.yaml

properties:
  epacket:
    type: phandle
    required: true
    description: |
      ePacket instance to log data to.
```

## dts/bindings/data_logger/embeint,data-logger-exfat.yaml
```yaml
# Copyright (c) 2024 Jordan Yates <jordan@embeint.com>
# SPDX-License-Identifier: FSL-1.1-ALv2

description: Data logging backend using a dedicated exFAT filesystem

compatible: "embeint,data-logger-exfat"

include: data-logger-base.yaml

properties:
  disk:
    type: phandle
    required: true
    description: |
      Disk to use for filesystem.
```

## dts/bindings/data_logger/embeint,data-logger-flash-map.yaml
```yaml
# Copyright (c) 2024 Jordan Yates <jordan@embeint.com>
# SPDX-License-Identifier: FSL-1.1-ALv2

description: Data logging backend using the flash_map API

compatible: "embeint,data-logger-flash-map"

include: data-logger-base.yaml

properties:
  partition:
    type: phandle
    required: true
    description: |
      Flash Map partition to log data to.

  block-size:
    type: int
    default: 512
    description: |
      Size of blocks on the underlying flash map device
```

## dts/bindings/data_logger/embeint,data-logger-shim.yaml
```yaml
# Copyright (c) 2025 Jordan Yates <jordan@embeint.com>
# SPDX-License-Identifier: FSL-1.1-ALv2

description: Data logging shim backend

compatible: "embeint,data-logger-shim"

include: data-logger-base.yaml

properties:
  physical-blocks:
    type: int
    required: true
    description:
      Number of physical blocks to report.
```

## dts/bindings/data_logger/embeint,data-logger.yaml
```yaml
# Copyright (c) 2024 Jordan Yates <jordan@embeint.com>
# SPDX-License-Identifier: FSL-1.1-ALv2

description: |
  Data logging parent class. It is also used to enumerate higher
  level logging abstractions.

    data_logger_udp: data_logger_udp {
      compatible = "embeint,data-logger-epacket", "embeint,data-logger";
      epacket = <&epacket_udp>;

      tdf_logger_udp: tdf_logger_udp {
          compatible = "embeint,tdf-data-logger";
      };
    };

compatible: "embeint,data-logger"

include: data-logger-base.yaml
```

## dts/bindings/data_logger/embeint,tdf-data-logger.yaml
```yaml
# Copyright (c) 2024 Jordan Yates <jordan@embeint.com>
# SPDX-License-Identifier: FSL-1.1-ALv2

description: |
  TDF Data logging. Must be a child node of "embeint,data-logger"

compatible: "embeint,tdf-data-logger"

include: base.yaml

properties:
  tdf-remote:
    type: boolean
    description: |
      TDF logger is for logging TDFs from remote devices. This swaps the
      block type from INFUSE_TDF to INFUSE_TDF_REMOTE and reserves a 64bit
      header on each block for the remote device ID.
```

## dts/bindings/epacket/embeint,epacket_bt_adv.yaml
```yaml
# Copyright (c) 2024 Jordan Yates <jordan@embeint.com>
# SPDX-License-Identifier: FSL-1.1-ALv2

description: ePacket Bluetooth advertising interface

compatible: "embeint,epacket-bt-adv"

include: "epacket-base.yaml"

properties:
  depends-on:
    default: "CONFIG_EPACKET_INTERFACE_BT_ADV"
  max-packet-size:
    default: 103
  header-size:
    default: 23
  footer-size:
    default: 16
```

## dts/bindings/epacket/embeint,epacket_bt_central.yaml
```yaml
# Copyright (c) 2024 Jordan Yates <jordan@embeint.com>
# SPDX-License-Identifier: FSL-1.1-ALv2

description: ePacket Bluetooth GATT central interface

compatible: "embeint,epacket-bt-central"

include: "epacket-base.yaml"

properties:
  depends-on:
    default: "CONFIG_EPACKET_INTERFACE_BT_CENTRAL"
  max-packet-size:
    default: 244
  header-size:
    default: 23
  footer-size:
    default: 16
```

## dts/bindings/epacket/embeint,epacket_bt_peripheral.yaml
```yaml
# Copyright (c) 2024 Jordan Yates <jordan@embeint.com>
# SPDX-License-Identifier: FSL-1.1-ALv2

description: ePacket Bluetooth GATT peripheral interface

compatible: "embeint,epacket-bt-peripheral"

include: "epacket-base.yaml"

properties:
  depends-on:
    default: "CONFIG_EPACKET_INTERFACE_BT_PERIPHERAL"
  max-packet-size:
    default: 244
  header-size:
    default: 23
  footer-size:
    default: 16
```

## dts/bindings/epacket/embeint,epacket_dummy.yaml
```yaml
# Copyright (c) 2024 Jordan Yates <jordan@embeint.com>
# SPDX-License-Identifier: FSL-1.1-ALv2

description: ePacket dummy interface

compatible: "embeint,epacket-dummy"

include: "epacket-base.yaml"

properties:
  depends-on:
    default: "CONFIG_EPACKET_INTERFACE_DUMMY"
  header-size:
    default: 4
  footer-size:
    default: 0
```

## dts/bindings/epacket/embeint,epacket_hci.yaml
```yaml
# Copyright (c) 2024 Jordan Yates <jordan@embeint.com>
# SPDX-License-Identifier: FSL-1.1-ALv2

description: ePacket HCI interface

compatible: "embeint,epacket-hci"

include: "epacket-base.yaml"

properties:
  depends-on:
    default: "CONFIG_EPACKET_INTERFACE_HCI"
  max-packet-size:
    default: 251
  header-size:
    default: 5
  footer-size:
    default: 0
```

## dts/bindings/epacket/embeint,epacket_serial.yaml
```yaml
# Copyright (c) 2024 Jordan Yates <jordan@embeint.com>
# SPDX-License-Identifier: FSL-1.1-ALv2

description: ePacket serial interface

compatible: "embeint,epacket-serial"

include: "epacket-base.yaml"

properties:
  serial:
    type: phandle
    required: true
    description: |
      Serial port backend supporting interrupt driven API.
  depends-on:
    default: "CONFIG_EPACKET_INTERFACE_SERIAL"
  header-size:
    default: 27
  footer-size:
    default: 16
```

## dts/bindings/epacket/embeint,epacket_udp.yaml
```yaml
# Copyright (c) 2024 Jordan Yates <jordan@embeint.com>
# SPDX-License-Identifier: FSL-1.1-ALv2

description: ePacket UDP interface

compatible: "embeint,epacket-udp"

include: "epacket-base.yaml"

properties:
  depends-on:
    default: "CONFIG_EPACKET_INTERFACE_UDP"
  max-packet-size:
    default: 1500
  header-size:
    default: 22
  footer-size:
    default: 16
```

## dts/bindings/epacket/embeint,epacket_usb.yaml
```yaml
# Copyright (c) 2024 Jordan Yates <jordan@embeint.com>
# SPDX-License-Identifier: LicenseRef-Embeint

description: ePacket USB interface

compatible: "embeint,epacket-usb"

include: "epacket-base.yaml"

properties:
  cdc-acm:
    type: phandle
    required: true
    description: |
        USB CDC-ACM backend.
  header-size:
    default: 23
  footer-size:
    default: 16
```

## dts/bindings/epacket/epacket-base.yaml
```yaml
# Copyright (c) 2024 Jordan Yates <jordan@embeint.com>
# SPDX-License-Identifier: FSL-1.1-ALv2

include: base.yaml

properties:
  depends-on:
    type: string
    description: |
      Kconfig symbol that instance depends on in order to be compiled into
      build. This is required so devicetree nodes can permanently exist
      with `status=okay` while enabling users to determine whether it is
      safe to get a compile-time reference with `DEVICE_DT_GET`. Otherwise
      every application would require board specific overlays to set `status`
      depending on the Kconfig features enabled.
  max-packet-size:
    type: int
    description: |
      Maximum packet size (header + payload + footer) supported
      by the interface. If not set, supports arbitrary sized
      payloads (limited by CONFIG_EPACKET_PACKET_SIZE_MAX).
  header-size:
    type: int
    description: |
      Size of the interface header in bytes.
      Do NOT modify defaults.
  footer-size:
    type: int
    description: |
      Size of the interface footer in bytes
      Do NOT modify defaults.
```

## dts/bindings/fuel-gauge/maxim,max17260.yaml
```yaml
# Copyright (c) 2024 Embeint Holdings Pty Ltd
# SPDX-License-Identifier: FSL-1.1-ALv2

description: Maxim MAX17260 Fuel Gauge

compatible: "maxim,max17260"

include: [fuel-gauge.yaml, battery.yaml, i2c-device.yaml]

properties:
  device-chemistry:
    required: true

  ocv-capacity-table-0:
    required: true

  sense-resistor-milli-ohms:
    type: int
    required: true
    description: Value of the sense resistor in milli-ohms
```

## dts/bindings/gnss/nordic,nrf9x-gnss-emul.yaml
```yaml
# Copyright (c) 2025 Embeint Holdings Pty Ltd
# SPDX-License-Identifier: FSL-1.1-ALv2

description: Emulated nRF9x GNSS interface

compatible: "nordic,nrf9x-gnss-emul"
```
